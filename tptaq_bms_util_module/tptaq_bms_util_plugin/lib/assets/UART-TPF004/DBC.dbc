NS_ :

BS_:

BU_: Project test

BO_ 1857 Client_SMP: 8 test
 SG_ Client_SMP_command M : 24|16@1+ (1,0) [0|65535] ""  Project
 SG_ Client_SMP_HW_Ver m1 : 56|16@1+ (1,0) [0|65535] "Ver"  Project
 SG_ Client_SMP_FW_Ver m1 : 72|16@1+ (1,0) [0|65535] "Ver"  Project
 SG_ Client_SMP_ModName_1 m2 : 56|32@1+ (1,0) [0|4294967295] "ASCII"  Project
 SG_ Client_SMP_ModName_2 m128 : 56|16@1+ (1,0) [0|65535] "ASCII"  Project
 SG_ Client_SMP_ModType_1 m3 : 56|24@1+ (1,0) [0|16777215] "ASCII"  Project
 SG_ Client_SMP_ModType_2 m129 : 56|24@1+ (1,0) [0|16777215] "ASCII"  Project
 SG_ Client_SMP_ProductionDate m4 : 56|24@1+ (1,0) [0|16777215] "YMD"  Project
 SG_ Client_SMP_ProductionYear m4 : 56|8@1+ (1,0) [0|255] "Y"  Project
 SG_ Client_SMP_ProductionMonth m4 : 64|8@1+ (1,0) [0|255] "M"  Project
 SG_ Client_SMP_ProductionDay m4 : 72|8@1+ (1,0) [0|255] "D"  Project
 SG_ Client_SMP_PackCellSize_S m5 : 56|8@1+ (1,0) [0|255] "Number"  Project
 SG_ Client_SMP_PackCellSize_P m5 : 64|8@1+ (1,0) [0|255] "Number"  Project
 SG_ Client_SMP_LastChgDate m6 : 56|24@1+ (1,0) [0|16777215] "YMD"  Project
 SG_ Client_SMP_CurrChgDate m7 : 56|24@1+ (1,0) [0|16777215] "YMD"  Project
 SG_ Client_SMP_LastChgDateMax m8 : 56|24@1+ (1,0) [0|16777215] "YMD"  Project
 SG_ Client_SMP_CurrentChgDateMax m9 : 56|24@1+ (1,0) [0|16777215] "YMD"  Project
 SG_ Client_SMP_FirstChgTime m12 : 56|32@1+ (1,0) [0|4294967295] "DateTime"  Project
 SG_ Client_SMP_MaxUnchgDuration m10 : 56|32@1+ (0.001,0) [0|4294967.295] "Days"  Project
 SG_ Client_SMP_FirstWakeupTime m13 : 56|32@1+ (1,0) [0|4294967295] "DateTime"  Project
 SG_ Client_SMP_ProductionSN1 m16 : 56|32@1+ (1,0) [0|4294967295] "ASCII"  Project
 SG_ Client_SMP_ProductionSN2 m17 : 56|32@1+ (1,0) [0|4294967295] "ASCII"  Project
 SG_ Client_SMP_ProductionSN3 m18 : 56|32@1+ (1,0) [0|4294967295] "ASCII"  Project
 SG_ Client_SMP_ProductionSN4 m19 : 56|32@1+ (1,0) [0|4294967295] "ASCII"  Project
 SG_ Client_SMP_ProductionSN5 m20 : 56|32@1+ (1,0) [0|4294967295] "ASCII"  Project
 SG_ Client_SMP_ProductionSN6 m21 : 56|32@1+ (1,0) [0|4294967295] "ASCII"  Project
 SG_ Client_SMP_ProductionSN7 m22 : 56|32@1+ (1,0) [0|4294967295] "ASCII"  Project
 SG_ Client_SMP_ProductionSN8 m23 : 56|16@1+ (1,0) [0|65535] "ASCII"  Project
 SG_ Client_SMP_BtLoaderVer m27 : 56|16@1+ (1,0) [0|65535] "Hex"  Project
 SG_ Client_SMP_CustomerSN1 m32 : 56|32@1+ (1,0) [0|4294967295] "ASCII"  Project
 SG_ Client_SMP_CustomerSN2 m33 : 56|32@1+ (1,0) [0|4294967295] "ASCII"  Project
 SG_ Client_SMP_CustomerSN3 m34 : 56|32@1+ (1,0) [0|4294967295] "ASCII"  Project
 SG_ Client_SMP_CustomerSN4 m35 : 56|32@1+ (1,0) [0|4294967295] "ASCII"  Project
 SG_ Client_SMP_CustomerSN5 m36 : 56|32@1+ (1,0) [0|4294967295] "ASCII"  Project
 SG_ Client_SMP_CustomerSN6 m37 : 56|32@1+ (1,0) [0|4294967295] "ASCII"  Project
 SG_ Client_SMP_CustomerSN7 m38 : 56|32@1+ (1,0) [0|4294967295] "ASCII"  Project
 SG_ Client_SMP_CustomerSN8 m39 : 56|16@1+ (1,0) [0|65535] "ASCII"  Project
 SG_ Client_SMP_ShippingDate m48 : 56|24@1+ (1,0) [0|16777215] "YMD"  Project
 SG_ Client_SMP_ShippingYear m48 : 56|8@1+ (1,0) [0|255] "Y"  Project
 SG_ Client_SMP_ShippingMonth m48 : 64|8@1+ (1,0) [0|255] "M"  Project
 SG_ Client_SMP_ShippingDay m48 : 72|8@1+ (1,0) [0|255] "D"  Project
 SG_ Client_SMP_OVP m49 : 56|16@1+ (1,0) [0|65535] "mV"  Project
 SG_ Client_SMP_OVPR m49 : 72|16@1+ (1,0) [0|65535] "mV"  Project
 SG_ Client_SMP_OVPWT m50 : 56|8@1+ (1,0) [0|255] "Sec"  Project
 SG_ Client_SMP_UVP m51 : 56|16@1+ (1,0) [0|65535] "mV"  Project
 SG_ Client_SMP_UVPR m51 : 72|16@1+ (1,0) [0|65535] "mV"  Project
 SG_ Client_SMP_UVPWT m52 : 56|8@1+ (1,0) [0|255] "Sec"  Project
 SG_ Client_SMP_COC m53 : 56|32@1- (1,0) [-2147483648|2147483647] "mA"  Project
 SG_ Client_SMP_COCWT m54 : 56|32@1+ (0.01,0) [0|42949672.95] "Sec"  Project
 SG_ Client_SMP_DOC m55 : 56|32@1- (1,0) [-2147483648|2147483647] "mA"  Project
 SG_ Client_SMP_DOCWT m56 : 56|32@1+ (0.01,0) [0|42949672.95] "Sec"  Project
 SG_ Client_SMP_DOT m57 : 56|8@1- (1,0) [-128|127] "degC"  Project
 SG_ Client_SMP_DOTR m57 : 64|8@1- (1,0) [-128|127] "degC"  Project
 SG_ Client_SMP_DUT m58 : 56|8@1- (1,0) [-128|127] "degC"  Project
 SG_ Client_SMP_DUTR m58 : 64|8@1- (1,0) [-128|127] "degC"  Project
 SG_ Client_SMP_COT m59 : 56|8@1- (1,0) [-128|127] "degC"  Project
 SG_ Client_SMP_COTR m59 : 64|8@1- (1,0) [-128|127] "degC"  Project
 SG_ Client_SMP_CUT m60 : 56|8@1- (1,0) [-128|127] "degC"  Project
 SG_ Client_SMP_CUTR m60 : 64|8@1- (1,0) [-128|127] "degC"  Project
 SG_ Client_SMP_FirstWakeupType m14 : 56|8@1+ (1,0) [0|255] "Hex"  Project
 SG_ Client_SMP_DesignCapacity m15 : 72|16@1+ (1,0) [0|65535] "mAh"  Project
 SG_ Client_SMP_TotalChgCapacity m63 : 56|32@1+ (0.1,0) [0|429496729.5] "Ah"  Project
 SG_ Client_SMP_LastChgCapacity m11 : 56|16@1- (1,0) [-32768|32767] "mAh"  Project
 SG_ Client_SMP_StateOfHealth m65 : 56|8@1+ (1,0) [0|255] "%"  Project
 SG_ Client_SMP_RSOC m67 : 56|8@1+ (1,0) [0|255] "%"  Project
 SG_ Client_SMP_FCC m68 : 56|16@1+ (1,0) [0|65535] "mAh"  Project
 SG_ Client_SMP_RC m69 : 56|16@1+ (1,0) [0|65535] "mAh"  Project
 SG_ Client_SMP_SafetyStatus2 m70 : 56|8@1+ (1,0) [0|255] "Hex"  Project
 SG_ Client_SMP_PackVoltage m71 : 56|32@1+ (1,0) [0|4294967295] "mV"  Project
 SG_ Client_SMP_PackCurrent m72 : 56|32@1- (1,0) [-2147483648|2147483647] "mA"  Project
 SG_ Client_SMP_CycleCount m74 : 56|16@1+ (1,0) [0|65535] "Times"  Project
 SG_ Client_SMP_RTC m75 : 56|32@1+ (1,0) [0|4294967295] "DateTime"  Project
 SG_ Client_SMP_BatteryStatus m130 : 56|16@1+ (1,0) [0|65535] "Hex"  Project
 SG_ Client_SMP_PFStatus m76 : 72|16@1+ (1,0) [0|65535] "Hex"  Project
 SG_ Client_SMP_SafetyStatus m77 : 56|16@1+ (1,0) [0|65535] "Hex"  Project
 SG_ Client_SMP_WarnStatus m77 : 72|16@1+ (1,0) [0|65535] "Hex"  Project
 SG_ Client_SMP_CBStatus m78 : 56|16@1+ (1,0) [0|65535] "Hex"  Project
 SG_ Client_SMP_Temp1 m80 : 56|16@1- (0.1,0) [-3276.8|3276.7] "degC"  Project
 SG_ Client_SMP_Temp2 m80 : 72|16@1- (0.1,0) [-3276.8|3276.7] "degC"  Project
 SG_ Client_SMP_Temp3 m81 : 56|16@1- (0.1,0) [-3276.8|3276.7] "degC"  Project
 SG_ Client_SMP_MOSTemp1 m84 : 56|16@1- (0.1,0) [-3276.8|3276.7] "degC"  Project
 SG_ Client_SMP_MOSTemp2 m84 : 72|16@1- (0.1,0) [-3276.8|3276.7] "degC"  Project
 SG_ Client_SMP_UsageCapacity m85 : 56|16@1+ (1,0) [0|65535] "mAh"  Project
 SG_ Client_SMP_CellVolt1 m96 : 56|16@1+ (1,0) [0|65535] "mV"  Project
 SG_ Client_SMP_CellVolt2 m97 : 56|16@1+ (1,0) [0|65535] "mV"  Project
 SG_ Client_SMP_CellVolt3 m98 : 56|16@1+ (1,0) [0|65535] "mV"  Project
 SG_ Client_SMP_CellVolt4 m99 : 56|16@1+ (1,0) [0|65535] "mV"  Project
 SG_ Client_SMP_CellVolt5 m100 : 56|16@1+ (1,0) [0|65535] "mV"  Project
 SG_ Client_SMP_CellVolt6 m101 : 56|16@1+ (1,0) [0|65535] "mV"  Project
 SG_ Client_SMP_CellVolt7 m102 : 56|16@1+ (1,0) [0|65535] "mV"  Project
 SG_ Client_SMP_CellVolt8 m103 : 56|16@1+ (1,0) [0|65535] "mV"  Project
 SG_ Client_SMP_CellVolt9 m104 : 56|16@1+ (1,0) [0|65535] "mV"  Project
 SG_ Client_SMP_CellVolt10 m105 : 56|16@1+ (1,0) [0|65535] "mV"  Project
 SG_ Client_SMP_CellVolt11 m106 : 56|16@1+ (1,0) [0|65535] "mV"  Project
 SG_ Client_SMP_CellVolt12 m107 : 56|16@1+ (1,0) [0|65535] "mV"  Project
 SG_ Client_SMP_CellVolt13 m108 : 56|16@1+ (1,0) [0|65535] "mV"  Project
 SG_ Client_SMP_CellVolt14 m109 : 56|16@1+ (1,0) [0|65535] "mV"  Project
 SG_ Client_SMP_CellVolt15 m110 : 56|16@1+ (1,0) [0|65535] "mV"  Project
 SG_ Client_SMP_CellVolt16 m111 : 56|16@1+ (1,0) [0|65535] "mV"  Project
 SG_ Client_SMP_CustomerFUN1 m256 : 56|32@1+ (1,0) [0|4294967295] "HEX"  Project
 SG_ Client_SMP_CustomerFUN2 m257 : 56|32@1+ (1,0) [0|4294967295] "HEX"  Project
 SG_ Client_SMP_CustomerFUN3 m258 : 56|32@1+ (1,0) [0|4294967295] "HEX"  Project
 SG_ Client_SMP_CustomerFUN4 m259 : 56|32@1+ (1,0) [0|4294967295] "HEX"  Project
 SG_ Client_SMP_CustomerFUN5 m260 : 56|32@1+ (1,0) [0|4294967295] "HEX"  Project
BO_ 1887 AFE: 8 test
 SG_ AFE_command M : 24|16@1+ (1,0) [0|65535] ""  Project
 SG_ AFE_AFEREG_03 m3 : 40|8@1+ (1,0) [0|255] "Hex"  Project
 SG_ AFE_AFEREG_04 m4 : 40|8@1+ (1,0) [0|255] "Hex"  Project
 SG_ AFE_AFEREG_05 m5 : 40|8@1+ (1,0) [0|255] "Hex"  Project
 SG_ AFE_AFEREG_06 m6 : 40|8@1+ (1,0) [0|255] "Hex"  Project
 SG_ AFE_AFEREG_07 m7 : 40|8@1+ (1,0) [0|255] "Hex"  Project
 SG_ AFE_AFEREG_08 m8 : 40|8@1+ (1,0) [0|255] "Hex"  Project
 SG_ AFE_AFEREG_09 m9 : 40|8@1+ (1,0) [0|255] "Hex"  Project
 SG_ AFE_AFEREG_0A m10 : 40|8@1+ (1,0) [0|255] "Hex"  Project
 SG_ AFE_AFEREG_0B m11 : 40|8@1+ (1,0) [0|255] "Hex"  Project
 SG_ AFE_AFEREG_0C m12 : 40|8@1+ (1,0) [0|255] "Hex"  Project
 SG_ AFE_AFEREG_0D m13 : 40|8@1+ (1,0) [0|255] "Hex"  Project
 SG_ AFE_AFEREG_0E m14 : 40|8@1+ (1,0) [0|255] "Hex"  Project
 SG_ AFE_AFEREG_0F m15 : 40|8@1+ (1,0) [0|255] "Hex"  Project
 SG_ AFE_AFEREG_10 m16 : 40|8@1+ (1,0) [0|255] "Hex"  Project
 SG_ AFE_AFEREG_11 m17 : 40|8@1+ (1,0) [0|255] "Hex"  Project
 SG_ AFE_AFEREG_12 m18 : 40|8@1+ (1,0) [0|255] "Hex"  Project
 SG_ AFE_AFEREG_13 m19 : 40|8@1+ (1,0) [0|255] "Hex"  Project
 SG_ AFE_AFEREG_14 m20 : 40|8@1+ (1,0) [0|255] "Hex"  Project
 SG_ AFE_AFEREG_18 m24 : 40|8@1+ (1,0) [0|255] "Hex"  Project
 SG_ AFE_AFEREG_19 m25 : 40|8@1+ (1,0) [0|255] "Hex"  Project
 SG_ AFE_AFEREG_1A m26 : 40|8@1+ (1,0) [0|255] "Hex"  Project
 SG_ AFE_AFEREG_1B m27 : 40|8@1+ (1,0) [0|255] "Hex"  Project
 SG_ AFE_AFEREG_1C m28 : 40|8@1+ (1,0) [0|255] "Hex"  Project
 SG_ AFE_AFEREG_1D m29 : 40|8@1+ (1,0) [0|255] "Hex"  Project
 SG_ AFE_AFEREG_1E m30 : 40|8@1+ (1,0) [0|255] "Hex"  Project
 SG_ AFE_AFEREG_1F m31 : 40|8@1+ (1,0) [0|255] "Hex"  Project
 SG_ AFE_AFEREG_20 m32 : 40|8@1+ (1,0) [0|255] "Hex"  Project
 SG_ AFE_AFEREG_21 m33 : 40|8@1+ (1,0) [0|255] "Hex"  Project
 SG_ AFE_AFEREG_22 m34 : 40|8@1+ (1,0) [0|255] "Hex"  Project
 SG_ AFE_AFEREG_23 m35 : 40|8@1+ (1,0) [0|255] "Hex"  Project
 SG_ AFE_AFEREG_24 m36 : 40|8@1+ (1,0) [0|255] "Hex"  Project
 SG_ AFE_AFEREG_25 m37 : 40|8@1+ (1,0) [0|255] "Hex"  Project
 SG_ AFE_AFEREG_26 m38 : 40|8@1+ (1,0) [0|255] "Hex"  Project
 SG_ AFE_AFEREG_27 m39 : 40|8@1+ (1,0) [0|255] "Hex"  Project
 SG_ AFE_AFEREG_28 m40 : 40|8@1+ (1,0) [0|255] "Hex"  Project
 SG_ AFE_AFEREG_29 m41 : 40|8@1+ (1,0) [0|255] "Hex"  Project
 SG_ AFE_AFEREG_2A m42 : 40|8@1+ (1,0) [0|255] "Hex"  Project
 SG_ AFE_AFEREG_2B m43 : 40|8@1+ (1,0) [0|255] "Hex"  Project
 SG_ AFE_AFEREG_2C m44 : 40|8@1+ (1,0) [0|255] "Hex"  Project
 SG_ AFE_AFEREG_2D m45 : 40|8@1+ (1,0) [0|255] "Hex"  Project
 SG_ AFE_AFEREG_2E m46 : 40|8@1+ (1,0) [0|255] "Hex"  Project
 SG_ AFE_AFEREG_2F m47 : 40|8@1+ (1,0) [0|255] "Hex"  Project
 SG_ AFE_AFEREG_30 m48 : 40|8@1+ (1,0) [0|255] "Hex"  Project
 SG_ AFE_AFEREG_31 m49 : 40|8@1+ (1,0) [0|255] "Hex"  Project
 SG_ AFE_AFEREG_32 m50 : 40|8@1+ (1,0) [0|255] "Hex"  Project
 SG_ AFE_AFEREG_33 m51 : 40|8@1+ (1,0) [0|255] "Hex"  Project
 SG_ AFE_AFEREG_34 m52 : 40|8@1+ (1,0) [0|255] "Hex"  Project
 SG_ AFE_AFEREG_35 m53 : 40|8@1+ (1,0) [0|255] "Hex"  Project
 SG_ AFE_AFEREG_36 m54 : 40|8@1+ (1,0) [0|255] "Hex"  Project
 SG_ AFE_AFEREG_37 m55 : 40|8@1+ (1,0) [0|255] "Hex"  Project
 SG_ AFE_AFEREG_3A m58 : 40|8@1+ (1,0) [0|255] "Hex"  Project
 SG_ AFE_AFEREG_3B m59 : 40|8@1+ (1,0) [0|255] "Hex"  Project
 SG_ AFE_AFEREG_3C m60 : 40|8@1+ (1,0) [0|255] "Hex"  Project
 SG_ AFE_AFEREG_3D m61 : 40|8@1+ (1,0) [0|255] "Hex"  Project
 SG_ AFE_AFEREG_3E m62 : 40|8@1+ (1,0) [0|255] "Hex"  Project
 SG_ AFE_AFEREG_3F m63 : 40|8@1+ (1,0) [0|255] "Hex"  Project
 SG_ AFE_AFEREG_40 m64 : 40|8@1+ (1,0) [0|255] "Hex"  Project
 SG_ AFE_AFEREG_41 m65 : 40|8@1+ (1,0) [0|255] "Hex"  Project
 SG_ AFE_AFEREG_42 m66 : 40|8@1+ (1,0) [0|255] "Hex"  Project
 SG_ AFE_AFEREG_43 m67 : 40|8@1+ (1,0) [0|255] "Hex"  Project
 SG_ AFE_AFEREG_44 m68 : 40|8@1+ (1,0) [0|255] "Hex"  Project
 SG_ AFE_AFEREG_45 m69 : 40|8@1+ (1,0) [0|255] "Hex"  Project
 SG_ AFE_AFEREG_46 m70 : 40|8@1+ (1,0) [0|255] "Hex"  Project
 SG_ AFE_AFEREG_47 m71 : 40|8@1+ (1,0) [0|255] "Hex"  Project
 SG_ AFE_AFEREG_4C m76 : 40|8@1+ (1,0) [0|255] "Hex"  Project
 SG_ AFE_AFEREG_4D m77 : 40|8@1+ (1,0) [0|255] "Hex"  Project
 SG_ AFE_AFEREG_4E m78 : 40|8@1+ (1,0) [0|255] "Hex"  Project
 SG_ AFE_AFEREG_50 m80 : 40|8@1+ (1,0) [0|255] "Hex"  Project
 SG_ AFE_AFEREG_51 m81 : 40|8@1+ (1,0) [0|255] "Hex"  Project
 SG_ AFE_AFEREG_52 m82 : 40|8@1+ (1,0) [0|255] "Hex"  Project
 SG_ AFE_AFEREG_53 m83 : 40|8@1+ (1,0) [0|255] "Hex"  Project
 SG_ AFE_AFEREG_54 m84 : 40|8@1+ (1,0) [0|255] "Hex"  Project
 SG_ AFE_AFEREG_58 m88 : 40|8@1+ (1,0) [0|255] "Hex"  Project
 SG_ AFE_AFEREG_59 m89 : 40|8@1+ (1,0) [0|255] "Hex"  Project
 SG_ AFE_AFEREG_5A m90 : 40|8@1+ (1,0) [0|255] "Hex"  Project
 SG_ AFE_AFEREG_5B m91 : 40|8@1+ (1,0) [0|255] "Hex"  Project
 SG_ AFE_AFEREG_5C m92 : 40|8@1+ (1,0) [0|255] "Hex"  Project
 SG_ AFE_AFEREG_5D m93 : 40|8@1+ (1,0) [0|255] "Hex"  Project
 SG_ AFE_AFEREG_5E m94 : 40|8@1+ (1,0) [0|255] "Hex"  Project
 SG_ AFE_AFEREG_60 m96 : 40|8@1+ (1,0) [0|255] "Hex"  Project
 SG_ AFE_AFEREG_61 m97 : 40|8@1+ (1,0) [0|255] "Hex"  Project
 SG_ AFE_AFEREG_62 m98 : 40|8@1+ (1,0) [0|255] "Hex"  Project
 SG_ AFE_AFEREG_63 m99 : 40|8@1+ (1,0) [0|255] "Hex"  Project
 SG_ AFE_AFEREG_64 m100 : 40|8@1+ (1,0) [0|255] "Hex"  Project
 SG_ AFE_AFEREG_65 m101 : 40|8@1+ (1,0) [0|255] "Hex"  Project
 SG_ AFE_AFEREG_66 m102 : 40|8@1+ (1,0) [0|255] "Hex"  Project
 SG_ AFE_AFEREG_67 m103 : 40|8@1+ (1,0) [0|255] "Hex"  Project
 SG_ AFE_AFEREG_68 m104 : 40|8@1+ (1,0) [0|255] "Hex"  Project
 SG_ AFE_AFEREG_69 m105 : 40|8@1+ (1,0) [0|255] "Hex"  Project
 SG_ AFE_AFEREG_6A m106 : 40|8@1+ (1,0) [0|255] "Hex"  Project
 SG_ AFE_AFEREG_6B m107 : 40|8@1+ (1,0) [0|255] "Hex"  Project
 SG_ AFE_AFEREG_6C m108 : 40|8@1+ (1,0) [0|255] "Hex"  Project
 SG_ AFE_AFEREG_6E m110 : 40|8@1+ (1,0) [0|255] "Hex"  Project
 SG_ AFE_AFEREG_6F m111 : 40|8@1+ (1,0) [0|255] "Hex"  Project
 SG_ AFE_AFEREG_70 m112 : 40|8@1+ (1,0) [0|255] "Hex"  Project
 SG_ AFE_AFEREG_71 m113 : 40|8@1+ (1,0) [0|255] "Hex"  Project
 SG_ AFE_AFEREG_72 m114 : 40|8@1+ (1,0) [0|255] "Hex"  Project
 SG_ AFE_AFEREG_73 m115 : 40|8@1+ (1,0) [0|255] "Hex"  Project
 SG_ AFE_AFEREG_74 m116 : 40|8@1+ (1,0) [0|255] "Hex"  Project
 SG_ AFE_AFEREG_75 m117 : 40|8@1+ (1,0) [0|255] "Hex"  Project
 SG_ AFE_AFEREG_76 m118 : 40|8@1+ (1,0) [0|255] "Hex"  Project
 SG_ AFE_AFEREG_78 m120 : 40|8@1+ (1,0) [0|255] "Hex"  Project
 SG_ AFE_AFEREG_79 m121 : 40|8@1+ (1,0) [0|255] "Hex"  Project
 SG_ AFE_AFEREG_7C m124 : 40|8@1+ (1,0) [0|255] "Hex"  Project
 SG_ AFE_AFEREG_7D m125 : 40|8@1+ (1,0) [0|255] "Hex"  Project
 SG_ AFE_AFEREG_7E m126 : 40|8@1+ (1,0) [0|255] "Hex"  Project
 SG_ AFE_AFEREG_7F m127 : 40|8@1+ (1,0) [0|255] "Hex"  Project
BO_ 1875 BMS: 8 test
 SG_ BMS_command M : 24|16@1+ (1,0) [0|65535] ""  Project
 SG_ BMS_Vpack m1 : 40|16@1+ (1,0) [0|65535] "mV"  Project
 SG_ BMS_PackVoltage m2 : 40|16@1+ (1,0) [0|65535] "mV"  Project
 SG_ BMS_PackCurrent m3 : 40|32@1- (1,0) [-2147483648|2147483647] "mA"  Project
 SG_ BMS_AvgCurrent m4 : 40|32@1- (1,0) [-2147483648|2147483647] "mA"  Project
 SG_ BMS_RSOC m5 : 40|32@1- (1,0) [-3.4E+38|3.4E+38] "%"  Project
 SG_ BMS_ASOC m6 : 40|32@1- (1,0) [-3.4E+38|3.4E+38] "%"  Project
 SG_ BMS_RC m7 : 40|32@1- (1,0) [-3.4E+38|3.4E+38] "mAh"  Project
 SG_ BMS_FCC m8 : 40|16@1+ (1,0) [0|65535] "mAh"  Project
 SG_ BMS_DCR m9 : 40|32@1- (1,0) [-3.4E+38|3.4E+38] "mAh"  Project
 SG_ BMS_FDCR m10 : 40|32@1- (1,0) [-3.4E+38|3.4E+38] "mAh"  Project
 SG_ BMS_CycleCount m11 : 40|16@1+ (1,0) [0|65535] "Times"  Project
 SG_ BMS_LearnCycle m12 : 40|16@1+ (1,0) [0|65535] "Times"  Project
 SG_ BMS_UserRC m13 : 40|32@1- (1,0) [-3.4E+38|3.4E+38] "mAh"  Project
 SG_ BMS_UserRSOC m14 : 40|32@1- (1,0) [-3.4E+38|3.4E+38] "%"  Project
 SG_ BMS_FCCmin m15 : 40|16@1+ (1,0) [0|65535] "mAh"  Project
 SG_ BMS_DeltaRC m16 : 40|32@1- (1,0) [-3.4E+38|3.4E+38] "mAh"  Project
 SG_ BMS_StartRSOC m17 : 40|32@1- (1,0) [-3.4E+38|3.4E+38] "%"  Project
 SG_ BMS_StartFDCR m18 : 40|32@1- (1,0) [-3.4E+38|3.4E+38] "mAh"  Project
 SG_ BMS_RCminCutoff m19 : 40|32@1- (1,0) [-3.4E+38|3.4E+38] "mAh"  Project
 SG_ BMS_StartRSOCmin m20 : 40|32@1- (1,0) [-3.4E+38|3.4E+38] "%"  Project
 SG_ BMS_UsageCapacity m21 : 40|16@1+ (1,0) [0|65535] "mAh"  Project
 SG_ BMS_SuccChaCap m22 : 40|32@1- (1,0) [-3.4E+38|3.4E+38] "mAh"  Project
 SG_ BMS_ChargeVoltage m24 : 40|16@1+ (1,0) [0|65535] "mV"  Project
 SG_ BMS_BatteryStatus m32 : 40|16@1+ (1,0) [0|65535] "Hex"  Project
 SG_ BMS_PackStatus m33 : 40|16@1+ (1,0) [0|65535] "Hex"  Project
 SG_ BMS_SafetyStatus m34 : 40|16@1+ (1,0) [0|65535] "Hex"  Project
 SG_ BMS_SafetyStatus2 m34 : 56|8@1+ (1,0) [0|255] "Hex"  Project
 SG_ BMS_WarnStatus m35 : 40|16@1+ (1,0) [0|65535] "Hex"  Project
 SG_ BMS_PFStatus m36 : 40|16@1+ (1,0) [0|65535] "Hex"  Project
 SG_ BMS_CBStatus m37 : 40|16@1+ (1,0) [0|65535] "Hex"  Project
 SG_ BMS_PackSetting m38 : 40|16@1+ (1,0) [0|65535] "Hex"  Project
 SG_ BMS_Temp1 m48 : 40|16@1- (0.1,0) [-3276.8|3276.7] "DegC"  Project
 SG_ BMS_Temp2 m48 : 56|16@1- (0.1,0) [-3276.8|3276.7] "DegC"  Project
 SG_ BMS_Temp3 m49 : 40|16@1- (0.1,0) [-3276.8|3276.7] "DegC"  Project
 SG_ BMS_CellVolt1 m64 : 40|16@1+ (1,0) [0|65535] "mV"  Project
 SG_ BMS_CellVolt2 m65 : 40|16@1+ (1,0) [0|65535] "mV"  Project
 SG_ BMS_CellVolt3 m66 : 40|16@1+ (1,0) [0|65535] "mV"  Project
 SG_ BMS_CellVolt4 m67 : 40|16@1+ (1,0) [0|65535] "mV"  Project
 SG_ BMS_CellVolt5 m68 : 40|16@1+ (1,0) [0|65535] "mV"  Project
 SG_ BMS_CellVolt6 m69 : 40|16@1+ (1,0) [0|65535] "mV"  Project
 SG_ BMS_CellVolt7 m70 : 40|16@1+ (1,0) [0|65535] "mV"  Project
 SG_ BMS_CellVolt8 m71 : 40|16@1+ (1,0) [0|65535] "mV"  Project
 SG_ BMS_CellVolt9 m72 : 40|16@1+ (1,0) [0|65535] "mV"  Project
 SG_ BMS_CellVolt10 m73 : 40|16@1+ (1,0) [0|65535] "mV"  Project
 SG_ BMS_CellVolt11 m74 : 40|16@1+ (1,0) [0|65535] "mV"  Project
 SG_ BMS_CellVolt12 m75 : 40|16@1+ (1,0) [0|65535] "mV"  Project
 SG_ BMS_CellVolt13 m76 : 40|16@1+ (1,0) [0|65535] "mV"  Project
 SG_ BMS_CellVolt14 m77 : 40|16@1+ (1,0) [0|65535] "mV"  Project
 SG_ BMS_CellVolt15 m78 : 40|16@1+ (1,0) [0|65535] "mV"  Project
 SG_ BMS_CellVolt16 m79 : 40|16@1+ (1,0) [0|65535] "mV"  Project
 SG_ BMS_EngMode m80 : 40|8@1+ (1,0) [0|255] "Hex"  Project
 SG_ BMS_SIM_PackCurrent m81 : 40|32@1- (1,0) [-2147483648|2147483647] "mA"  Project
 SG_ BMS_SIM_CellVolt1 m82 : 40|16@1+ (1,0) [0|65535] "mV"  Project
 SG_ BMS_SIM_CellVolt2 m82 : 56|16@1+ (1,0) [0|65535] "mV"  Project
 SG_ BMS_SIM_CellVolt3 m82 : 72|16@1+ (1,0) [0|65535] "mV"  Project
 SG_ BMS_SIM_CellVolt4 m83 : 40|16@1+ (1,0) [0|65535] "mV"  Project
 SG_ BMS_SIM_CellVolt5 m83 : 56|16@1+ (1,0) [0|65535] "mV"  Project
 SG_ BMS_SIM_CellVolt6 m83 : 72|16@1+ (1,0) [0|65535] "mV"  Project
 SG_ BMS_SIM_CellVolt7 m84 : 40|16@1+ (1,0) [0|65535] "mV"  Project
 SG_ BMS_SIM_CellVolt8 m84 : 56|16@1+ (1,0) [0|65535] "mV"  Project
 SG_ BMS_SIM_CellVolt9 m84 : 72|16@1+ (1,0) [0|65535] "mV"  Project
 SG_ BMS_SIM_CellVolt10 m85 : 40|16@1+ (1,0) [0|65535] "mV"  Project
 SG_ BMS_SIM_CellVolt11 m85 : 56|16@1+ (1,0) [0|65535] "mV"  Project
 SG_ BMS_SIM_CellVolt12 m85 : 72|16@1+ (1,0) [0|65535] "mV"  Project
 SG_ BMS_SIM_CellVolt13 m86 : 40|16@1+ (1,0) [0|65535] "mV"  Project
 SG_ BMS_SIM_CellVolt14 m86 : 56|16@1+ (1,0) [0|65535] "mV"  Project
 SG_ BMS_SIM_CellVolt15 m86 : 72|16@1+ (1,0) [0|65535] "mV"  Project
 SG_ BMS_SIM_CellVolt16 m87 : 40|16@1+ (1,0) [0|65535] "mV"  Project
 SG_ BMS_SIM_Vpack m87 : 56|16@1+ (1,0) [0|65535] "mV"  Project
 SG_ BMS_SIM_Vbat m87 : 72|16@1+ (1,0) [0|65535] "mV"  Project
 SG_ BMS_SIM_Temp1 m88 : 40|16@1- (0.1,0) [-3276.8|3276.7] "DegC"  Project
 SG_ BMS_SIM_Temp2 m88 : 56|16@1- (0.1,0) [-3276.8|3276.7] "DegC"  Project
 SG_ BMS_SIM_Temp3 m88 : 72|16@1- (0.1,0) [-3276.8|3276.7] "DegC"  Project
 SG_ BMS_SystemTime m89 : 40|32@1+ (1,0) [0|4294967295] "DateTime"  Project
 SG_ BMS_OCVUpdateCount m128 : 40|32@1+ (0.05,0) [0|214748364.75] "Sec"  Project
 SG_ BMS_MCU_ADC_Vol1 m136 : 40|16@1+ (1,0) [0|65535] "mV"  Project
 SG_ BMS_MCU_ADC_Vol2 m137 : 40|16@1+ (1,0) [0|65535] "mV"  Project
 SG_ BMS_MCU_ADC_Vol3 m138 : 40|16@1+ (1,0) [0|65535] "mV"  Project
 SG_ BMS_MCU_ADC_Vol4 m139 : 40|16@1+ (1,0) [0|65535] "mV"  Project
 SG_ BMS_PublicVer m240 : 40|24@1+ (1,0) [0|16777215] "Ver"  Project
 SG_ BMS_ChkSum m39 : 40|32@1+ (1,0) [0|4294967295] "Hex"  Project
 SG_ BMS_CanloaderChkSum m40 : 40|32@1+ (1,0) [0|4294967295] "Hex"  Project
BO_ 1877 DFA: 8 test
 SG_ DFA_command M : 24|16@1+ (1,0) [0|65535] ""  Project
 SG_ DFA_HW_Ver m0 : 40|24@1+ (1,0) [0|16777215] "Ver"  Project
 SG_ DFA_FW_Ver m1 : 40|24@1+ (1,0) [0|16777215] "Ver"  Project
 SG_ DFA_OperationCfgA m2 : 40|16@1+ (1,0) [0|65535] "Hex"  Project
 SG_ DFA_Cell_ID m4 : 40|16@1+ (1,0) [0|65535] "Hex"  Project
 SG_ DFA_ModName m5 : 40|48@1+ (1,0) [0|281474976710655] "ASCII"  Project
 SG_ DFA_ModType m6 : 40|48@1+ (1,0) [0|281474976710655] "ASCII"  Project
 SG_ DFA_CellSerieslSize m7 : 40|8@1+ (1,0) [0|255] "Number"  Project
 SG_ DFA_CellParallelSize m7 : 48|8@1+ (1,0) [0|255] "Number"  Project
 SG_ DFA_TimeOfLastCharge m10 : 40|32@1+ (1,0) [0|4294967295] "DateTime"  Project
 SG_ DFA_TimeOfCurrentCharge m11 : 40|32@1+ (1,0) [0|4294967295] "DateTime"  Project
 SG_ DFA_TimeOfLastChargeMax m12 : 40|32@1+ (1,0) [0|4294967295] "DateTime"  Project
 SG_ DFA_TimeOfCurrentChargeMax m13 : 40|32@1+ (1,0) [0|4294967295] "DateTime"  Project
 SG_ DFA_TimeOfFirstCharge m14 : 40|32@1+ (1,0) [0|4294967295] "DateTime"  Project
 SG_ DFA_MaxUnchgDuration m15 : 40|32@1+ (1.44,0) [0|6184752904.8] "Min"  Project
 SG_ DFA_TimeOfFirstWakeup m16 : 40|32@1+ (1,0) [0|4294967295] "DateTime"  Project
 SG_ DFA_FirstWakeupType m17 : 40|8@1+ (1,0) [0|255] "Hex"  Project
 SG_ DFA_TimeOfFirstShipping m18 : 40|32@1+ (1,0) [0|4294967295] "DateTime"  Project
 SG_ DFA_TimeOfFirstShutDown m19 : 40|32@1+ (1,0) [0|4294967295] "DateTime"  Project
 SG_ DFA_OperationTime m20 : 40|32@1+ (1,0) [0|4294967295] "Sec"  Project
 SG_ DFA_ProductionDate m26 : 40|24@1+ (1,0) [0|16777215] "YMD"  Project
 SG_ DFA_ShippingDate m27 : 40|24@1+ (1,0) [0|16777215] "YMD"  Project
 SG_ DFA_RefCellValue1 m32 : 40|16@1+ (1,0) [0|65535] "mV"  Project
 SG_ DFA_CaliADValue1 m32 : 56|16@1+ (1,0) [0|65535] "Hex"  Project
 SG_ DFA_NickelResistance1 m32 : 72|16@1- (1,0) [-32768|32767] "0.1mOhm"  Project
 SG_ DFA_RefCellValue2 m33 : 40|16@1+ (1,0) [0|65535] "mV"  Project
 SG_ DFA_CaliADValue2 m33 : 56|16@1+ (1,0) [0|65535] "Hex"  Project
 SG_ DFA_NickelResistance2 m33 : 72|16@1- (1,0) [-32768|32767] "0.1mOhm"  Project
 SG_ DFA_RefCellValue3 m34 : 40|16@1+ (1,0) [0|65535] "mV"  Project
 SG_ DFA_CaliADValue3 m34 : 56|16@1+ (1,0) [0|65535] "Hex"  Project
 SG_ DFA_NickelResistance3 m34 : 72|16@1- (1,0) [-32768|32767] "0.1mOhm"  Project
 SG_ DFA_RefCellValue4 m35 : 40|16@1+ (1,0) [0|65535] "mV"  Project
 SG_ DFA_CaliADValue4 m35 : 56|16@1+ (1,0) [0|65535] "Hex"  Project
 SG_ DFA_NickelResistance4 m35 : 72|16@1- (1,0) [-32768|32767] "0.1mOhm"  Project
 SG_ DFA_RefCellValue5 m36 : 40|16@1+ (1,0) [0|65535] "mV"  Project
 SG_ DFA_CaliADValue5 m36 : 56|16@1+ (1,0) [0|65535] "Hex"  Project
 SG_ DFA_NickelResistance5 m36 : 72|16@1- (1,0) [-32768|32767] "0.1mOhm"  Project
 SG_ DFA_RefCellValue6 m37 : 40|16@1+ (1,0) [0|65535] "mV"  Project
 SG_ DFA_CaliADValue6 m37 : 56|16@1+ (1,0) [0|65535] "Hex"  Project
 SG_ DFA_NickelResistance6 m37 : 72|16@1- (1,0) [-32768|32767] "0.1mOhm"  Project
 SG_ DFA_RefCellValue7 m38 : 40|16@1+ (1,0) [0|65535] "mV"  Project
 SG_ DFA_CaliADValue7 m38 : 56|16@1+ (1,0) [0|65535] "Hex"  Project
 SG_ DFA_NickelResistance7 m38 : 72|16@1- (1,0) [-32768|32767] "0.1mOhm"  Project
 SG_ DFA_RefCellValue8 m39 : 40|16@1+ (1,0) [0|65535] "mV"  Project
 SG_ DFA_CaliADValue8 m39 : 56|16@1+ (1,0) [0|65535] "Hex"  Project
 SG_ DFA_NickelResistance8 m39 : 72|16@1- (1,0) [-32768|32767] "0.1mOhm"  Project
 SG_ DFA_RefCellValue9 m40 : 40|16@1+ (1,0) [0|65535] "mV"  Project
 SG_ DFA_CaliADValue9 m40 : 56|16@1+ (1,0) [0|65535] "Hex"  Project
 SG_ DFA_NickelResistance9 m40 : 72|16@1- (1,0) [-32768|32767] "0.1mOhm"  Project
 SG_ DFA_RefCellValue10 m41 : 40|16@1+ (1,0) [0|65535] "mV"  Project
 SG_ DFA_CaliADValue10 m41 : 56|16@1+ (1,0) [0|65535] "Hex"  Project
 SG_ DFA_NickelResistance10 m41 : 72|16@1- (1,0) [-32768|32767] "0.1mOhm"  Project
 SG_ DFA_RefCellValue11 m42 : 40|16@1+ (1,0) [0|65535] "mV"  Project
 SG_ DFA_CaliADValue11 m42 : 56|16@1+ (1,0) [0|65535] "Hex"  Project
 SG_ DFA_NickelResistance11 m42 : 72|16@1- (1,0) [-32768|32767] "0.1mOhm"  Project
 SG_ DFA_RefCellValue12 m43 : 40|16@1+ (1,0) [0|65535] "mV"  Project
 SG_ DFA_CaliADValue12 m43 : 56|16@1+ (1,0) [0|65535] "Hex"  Project
 SG_ DFA_NickelResistance12 m43 : 72|16@1- (1,0) [-32768|32767] "0.1mOhm"  Project
 SG_ DFA_RefCellValue13 m44 : 40|16@1+ (1,0) [0|65535] "mV"  Project
 SG_ DFA_CaliADValue13 m44 : 56|16@1+ (1,0) [0|65535] "Hex"  Project
 SG_ DFA_NickelResistance13 m44 : 72|16@1- (1,0) [-32768|32767] "0.1mOhm"  Project
 SG_ DFA_RefCellValue14 m45 : 40|16@1+ (1,0) [0|65535] "mV"  Project
 SG_ DFA_CaliADValue14 m45 : 56|16@1+ (1,0) [0|65535] "Hex"  Project
 SG_ DFA_NickelResistance14 m45 : 72|16@1- (1,0) [-32768|32767] "0.1mOhm"  Project
 SG_ DFA_RefCellValue15 m46 : 40|16@1+ (1,0) [0|65535] "mV"  Project
 SG_ DFA_CaliADValue15 m46 : 56|16@1+ (1,0) [0|65535] "Hex"  Project
 SG_ DFA_NickelResistance15 m46 : 72|16@1- (1,0) [-32768|32767] "0.1mOhm"  Project
 SG_ DFA_RefCellValue16 m47 : 40|16@1+ (1,0) [0|65535] "mV"  Project
 SG_ DFA_CaliADValue16 m47 : 56|16@1+ (1,0) [0|65535] "Hex"  Project
 SG_ DFA_NickelResistance16 m47 : 72|16@1- (1,0) [-32768|32767] "0.1mOhm"  Project
 SG_ DFA_CHGRefCurrentValue1 m48 : 40|16@1- (1,0) [-32768|32767] "mA"  Project
 SG_ DFA_CHGCaliCurrentAD1 m49 : 40|32@1+ (1,0) [0|4294967295] "Hex"  Project
 SG_ DFA_CHGRefCurrentValue2 m50 : 40|16@1- (1,0) [-32768|32767] "mA"  Project
 SG_ DFA_CHGCaliCurrentAD2 m51 : 40|32@1+ (1,0) [0|4294967295] "Hex"  Project
 SG_ DFA_DSGRefCurrentValue1 m52 : 40|16@1- (1,0) [-32768|32767] "mA"  Project
 SG_ DFA_DSGCaliCurrentAD1 m53 : 40|32@1+ (1,0) [0|4294967295] "Hex"  Project
 SG_ DFA_DSGRefCurrentValue2 m54 : 40|16@1- (1,0) [-32768|32767] "mA"  Project
 SG_ DFA_DSGCaliCurrentAD2 m55 : 40|32@1+ (1,0) [0|4294967295] "Hex"  Project
 SG_ DFA_TempRefResis1 m56 : 40|16@1+ (1,0) [0|65535] "Ohm"  Project
 SG_ DFA_TempCaliOffset1 m56 : 56|16@1- (1,0) [-32768|32767] "Hex"  Project
 SG_ DFA_TempRefResis2 m57 : 40|16@1+ (1,0) [0|65535] "Ohm"  Project
 SG_ DFA_TempCaliOffset2 m57 : 56|16@1- (1,0) [-32768|32767] "Hex"  Project
 SG_ DFA_TempRefResis3 m58 : 40|16@1+ (1,0) [0|65535] "Ohm"  Project
 SG_ DFA_TempCaliOffset3 m58 : 56|16@1- (1,0) [-32768|32767] "Hex"  Project
 SG_ DFA_CycleCount m64 : 40|16@1+ (1,0) [0|65535] "Times"  Project
 SG_ DFA_LearnCycle m65 : 40|16@1+ (1,0) [0|65535] "Times"  Project
 SG_ DFA_FCC m66 : 40|16@1+ (1,0) [0|65535] "mAh"  Project
 SG_ DFA_RC m67 : 40|32@1- (1,0) [-3.4E+38|3.4E+38] "mAh"  Project
 SG_ DFA_DCR m68 : 40|32@1- (1,0) [-3.4E+38|3.4E+38] "mAh"  Project
 SG_ DFA_TimeOfFCCUpdate m69 : 40|32@1+ (1,0) [0|4294967295] "DateTime"  Project
 SG_ DFA_UserRC m70 : 40|32@1- (1,0) [-3.4E+38|3.4E+38] "mAh"  Project
 SG_ DFA_UserRSOC m71 : 40|32@1- (1,0) [-3.4E+38|3.4E+38] "%"  Project
 SG_ DFA_ShippingCnt m72 : 40|16@1+ (1,0) [0|65535] "Times"  Project
 SG_ DFA_ShippingFailedCnt1 m72 : 56|16@1+ (1,0) [0|65535] "Times"  Project
 SG_ DFA_ShippingFailedCnt2 m72 : 72|16@1+ (1,0) [0|65535] "Times"  Project
 SG_ DFA_ShutDownCnt m73 : 40|16@1+ (1,0) [0|65535] "Times"  Project
 SG_ DFA_ShutDownFailedCnt1 m73 : 56|16@1+ (1,0) [0|65535] "Times"  Project
 SG_ DFA_ShutDownFailedCnt2 m73 : 72|16@1+ (1,0) [0|65535] "Times"  Project
 SG_ DFA_RunAwayCnt1 m74 : 40|16@1+ (1,0) [0|65535] "Times"  Project
 SG_ DFA_RunAwayCnt2 m74 : 56|16@1+ (1,0) [0|65535] "Times"  Project
 SG_ DFA_AFERegCheckFailedCnt m74 : 72|16@1+ (1,0) [0|65535] "Times"  Project
 SG_ DFA_ChargingCapacity m75 : 40|32@1- (1,0) [-3.4E+38|3.4E+38] "mAh"  Project
 SG_ DFA_FCCmin m76 : 40|16@1+ (1,0) [0|65535] "mAh"  Project
 SG_ DFA_RCminCutoff m77 : 40|32@1- (1,0) [-3.4E+38|3.4E+38] "mAh"  Project
 SG_ DFA_FCC_learning m78 : 40|16@1+ (1,0) [0|65535] "mAh"  Project
 SG_ DFA_UsTStamp m80 : 40|32@1+ (1,0) [0|4294967295] "DateTime"  Project
 SG_ DFA_ProductID m81 : 40|16@1+ (1,0) [0|65535] "Hex"  Project
 SG_ DFA_DiagVer m81 : 56|16@1+ (1,0) [0|65535] "Hex"  Project
 SG_ DFA_UIVer m81 : 72|16@1+ (1,0) [0|65535] "Hex"  Project
 SG_ DFA_ReprogramHtyCounter m82 : 40|8@1+ (1,0) [0|255] "Times"  Project
 SG_ DFA_CommInterface m82 : 48|8@1+ (1,0) [0|255] "Hex"  Project
 SG_ DFA_BtLoaderVer m83 : 40|16@1+ (1,0) [0|65535] "Hex"  Project
 SG_ DFA_ProductionSN1 m112 : 40|48@1+ (1,0) [0|281474976710655] "ASCII"  Project
 SG_ DFA_ProductionSN2 m113 : 40|48@1+ (1,0) [0|281474976710655] "ASCII"  Project
 SG_ DFA_ProductionSN3 m114 : 40|48@1+ (1,0) [0|281474976710655] "ASCII"  Project
 SG_ DFA_ProductionSN4 m115 : 40|48@1+ (1,0) [0|281474976710655] "ASCII"  Project
 SG_ DFA_ProductionSN5 m116 : 40|48@1+ (1,0) [0|281474976710655] "ASCII"  Project
 SG_ DFA_CustomerSN1 m117 : 40|48@1+ (1,0) [0|281474976710655] "ASCII"  Project
 SG_ DFA_CustomerSN2 m118 : 40|48@1+ (1,0) [0|281474976710655] "ASCII"  Project
 SG_ DFA_CustomerSN3 m119 : 40|48@1+ (1,0) [0|281474976710655] "ASCII"  Project
 SG_ DFA_CustomerSN4 m120 : 40|48@1+ (1,0) [0|281474976710655] "ASCII"  Project
 SG_ DFA_CustomerSN5 m121 : 40|48@1+ (1,0) [0|281474976710655] "ASCII"  Project
 SG_ DFA_DFALockMark m128 : 40|16@1+ (1,0) [0|65535] "Hex"  Project
 SG_ DFA_DFAEraseCnt m129 : 40|16@1+ (1,0) [0|65535] "Time"  Project
 SG_ DFA_DFAChkSum m130 : 40|32@1+ (1,0) [0|4294967295] "Hex"  Project
 SG_ DFA_WDFA1 m4095 : 40|8@1+ (1,0) [0|255] "ASCII"  Project
 SG_ DFA_WDFA2 m4095 : 48|8@1+ (1,0) [0|255] "ASCII"  Project
 SG_ DFA_WDFA3 m4095 : 56|8@1+ (1,0) [0|255] "ASCII"  Project
 SG_ EEPROM_FW_Ver m32768 : 40|24@1+ (1,0) [0|16777215] "Ver"  Project
 SG_ EEPROM_HW_Ver m32769 : 40|24@1+ (1,0) [0|16777215] "Ver"  Project
 SG_ EEPROM_Cell_ID m32770 : 40|16@1+ (1,0) [0|65535] "Hex"  Project
 SG_ EEPROM_ModName m32771 : 40|48@1+ (1,0) [0|281474976710655] "ASCII"  Project
 SG_ EEPROM_ModType m32772 : 40|48@1+ (1,0) [0|281474976710655] "ASCII"  Project
 SG_ EEPROM_CellSerieslSize m32773 : 40|8@1+ (1,0) [0|255] "Number"  Project
 SG_ EEPROM_CellParallelSize m32773 : 48|8@1+ (1,0) [0|255] "Number"  Project
 SG_ EEPROM_ProductionDate m32774 : 40|24@1+ (1,0) [0|16777215] "YMD"  Project
 SG_ EEPROM_ShippingDate m32775 : 40|24@1+ (1,0) [0|16777215] "YMD"  Project
 SG_ EEPROM_TimeOfLastCharge m32776 : 40|32@1+ (1,0) [0|4294967295] "DateTime"  Project
 SG_ EEPROM_TimeOfCurrentCharge m32777 : 40|32@1+ (1,0) [0|4294967295] "DateTime"  Project
 SG_ EEPROM_TimeOfLastChargeMax m32778 : 40|32@1+ (1,0) [0|4294967295] "DateTime"  Project
 SG_ EEPROM_TimeOfCurrentChargeMax m32779 : 40|32@1+ (1,0) [0|4294967295] "DateTime"  Project
 SG_ EEPROM_TimeOfFirstCharge m32780 : 40|32@1+ (1,0) [0|4294967295] "DateTime"  Project
 SG_ EEPROM_MaxUnchgDuration m32781 : 40|32@1+ (0.001,0) [0|4294967.295] "Day"  Project
 SG_ EEPROM_ProductionSN1 m32782 : 40|48@1+ (1,0) [0|281474976710655] "ASCII"  Project
 SG_ EEPROM_ProductionSN2 m32783 : 40|48@1+ (1,0) [0|281474976710655] "ASCII"  Project
 SG_ EEPROM_ProductionSN3 m32784 : 40|48@1+ (1,0) [0|281474976710655] "ASCII"  Project
 SG_ EEPROM_ProductionSN4 m32785 : 40|48@1+ (1,0) [0|281474976710655] "ASCII"  Project
 SG_ EEPROM_ProductionSN5 m32786 : 40|48@1+ (1,0) [0|281474976710655] "ASCII"  Project
 SG_ EEPROM_TimeOfFirstWakeup m32787 : 40|32@1+ (1,0) [0|4294967295] "DateTime"  Project
 SG_ EEPROM_FirstWakeupType m32788 : 40|8@1+ (1,0) [0|255] "Hex"  Project
 SG_ EEPROM_TimeOfFirstShipping m32789 : 40|32@1+ (1,0) [0|4294967295] "DateTime"  Project
 SG_ EEPROM_TimeOfFirstShutDown m32790 : 40|32@1+ (1,0) [0|4294967295] "DateTime"  Project
 SG_ EEPROM_OperationTime m32791 : 40|32@1+ (1,0) [0|4294967295] "Sec"  Project
 SG_ EEPROM_RefCellValue1 m32800 : 40|16@1+ (1,0) [0|65535] "mV"  Project
 SG_ EEPROM_CaliADValue1 m32800 : 56|16@1+ (1,0) [0|65535] "Hex"  Project
 SG_ EEPROM_RefCellValue2 m32801 : 40|16@1+ (1,0) [0|65535] "mV"  Project
 SG_ EEPROM_CaliADValue2 m32801 : 56|16@1+ (1,0) [0|65535] "Hex"  Project
 SG_ EEPROM_RefCellValue3 m32802 : 40|16@1+ (1,0) [0|65535] "mV"  Project
 SG_ EEPROM_CaliADValue3 m32802 : 56|16@1+ (1,0) [0|65535] "Hex"  Project
 SG_ EEPROM_RefCellValue4 m32803 : 40|16@1+ (1,0) [0|65535] "mV"  Project
 SG_ EEPROM_CaliADValue4 m32803 : 56|16@1+ (1,0) [0|65535] "Hex"  Project
 SG_ EEPROM_RefCellValue5 m32804 : 40|16@1+ (1,0) [0|65535] "mV"  Project
 SG_ EEPROM_CaliADValue5 m32804 : 56|16@1+ (1,0) [0|65535] "Hex"  Project
 SG_ EEPROM_RefCellValue6 m32805 : 40|16@1+ (1,0) [0|65535] "mV"  Project
 SG_ EEPROM_CaliADValue6 m32805 : 56|16@1+ (1,0) [0|65535] "Hex"  Project
 SG_ EEPROM_RefCellValue7 m32806 : 40|16@1+ (1,0) [0|65535] "mV"  Project
 SG_ EEPROM_CaliADValue7 m32806 : 56|16@1+ (1,0) [0|65535] "Hex"  Project
 SG_ EEPROM_RefCellValue8 m32807 : 40|16@1+ (1,0) [0|65535] "mV"  Project
 SG_ EEPROM_CaliADValue8 m32807 : 56|16@1+ (1,0) [0|65535] "Hex"  Project
 SG_ EEPROM_RefCellValue9 m32808 : 40|16@1+ (1,0) [0|65535] "mV"  Project
 SG_ EEPROM_CaliADValue9 m32808 : 56|16@1+ (1,0) [0|65535] "Hex"  Project
 SG_ EEPROM_RefCellValue10 m32809 : 40|16@1+ (1,0) [0|65535] "mV"  Project
 SG_ EEPROM_CaliADValue10 m32809 : 56|16@1+ (1,0) [0|65535] "Hex"  Project
 SG_ EEPROM_RefCellValue11 m32810 : 40|16@1+ (1,0) [0|65535] "mV"  Project
 SG_ EEPROM_CaliADValue11 m32810 : 56|16@1+ (1,0) [0|65535] "Hex"  Project
 SG_ EEPROM_RefCellValue12 m32811 : 40|16@1+ (1,0) [0|65535] "mV"  Project
 SG_ EEPROM_CaliADValue12 m32811 : 56|16@1+ (1,0) [0|65535] "Hex"  Project
 SG_ EEPROM_RefCellValue13 m32812 : 40|16@1+ (1,0) [0|65535] "mV"  Project
 SG_ EEPROM_CaliADValue13 m32812 : 56|16@1+ (1,0) [0|65535] "Hex"  Project
 SG_ EEPROM_RefCellValue14 m32813 : 40|16@1+ (1,0) [0|65535] "mV"  Project
 SG_ EEPROM_CaliADValue14 m32813 : 56|16@1+ (1,0) [0|65535] "Hex"  Project
 SG_ EEPROM_RefCellValue15 m32814 : 40|16@1+ (1,0) [0|65535] "mV"  Project
 SG_ EEPROM_CaliADValue15 m32814 : 56|16@1+ (1,0) [0|65535] "Hex"  Project
 SG_ EEPROM_RefCellValue16 m32815 : 40|16@1+ (1,0) [0|65535] "mV"  Project
 SG_ EEPROM_CaliADValue16 m32815 : 56|16@1+ (1,0) [0|65535] "Hex"  Project
 SG_ EEPROM_CHGRefCurrentValue1 m32816 : 40|16@1- (1,0) [-32768|32767] "mA"  Project
 SG_ EEPROM_CHGRefCurrentValue2 m32817 : 40|16@1- (1,0) [-32768|32767] "mA"  Project
 SG_ EEPROM_CHGCaliCurrentAD1 m32818 : 40|32@1+ (1,0) [0|4294967295] "Hex"  Project
 SG_ EEPROM_CHGCaliCurrentAD2 m32819 : 40|32@1+ (1,0) [0|4294967295] "Hex"  Project
 SG_ EEPROM_DSGRefCurrentValue1 m32820 : 40|16@1- (1,0) [-32768|32767] "mA"  Project
 SG_ EEPROM_DSGRefCurrentValue2 m32821 : 40|16@1- (1,0) [-32768|32767] "mA"  Project
 SG_ EEPROM_DSGCaliCurrentAD1 m32822 : 40|32@1+ (1,0) [0|4294967295] "Hex"  Project
 SG_ EEPROM_DSGCaliCurrentAD2 m32823 : 40|32@1+ (1,0) [0|4294967295] "Hex"  Project
 SG_ EEPROM_TempRefResis1 m32824 : 40|16@1+ (1,0) [0|65535] "Ohm"  Project
 SG_ EEPROM_TempCaliOffset1 m32824 : 56|16@1- (1,0) [-32768|32767] "Hex"  Project
 SG_ EEPROM_TempRefResis2 m32825 : 40|16@1+ (1,0) [0|65535] "Ohm"  Project
 SG_ EEPROM_TempCaliOffset2 m32825 : 56|16@1- (1,0) [-32768|32767] "Hex"  Project
 SG_ EEPROM_TempRefResis3 m32826 : 40|16@1+ (1,0) [0|65535] "Ohm"  Project
 SG_ EEPROM_TempCaliOffset3 m32826 : 56|16@1- (1,0) [-32768|32767] "Hex"  Project
 SG_ EEPROM_CycleCount m32832 : 40|16@1+ (1,0) [0|65535] "Times"  Project
 SG_ EEPROM_LearnCycle m32833 : 40|16@1+ (1,0) [0|65535] "Times"  Project
 SG_ EEPROM_FCC m32834 : 40|16@1+ (1,0) [0|65535] "mAh"  Project
 SG_ EEPROM_RC m32835 : 40|32@1- (1,0) [-3.4E+38|3.4E+38] "mAh"  Project
 SG_ EEPROM_DCR m32836 : 40|32@1- (1,0) [-3.4E+38|3.4E+38] "mAh"  Project
 SG_ EEPROM_TimeOfFCCUpdate m32837 : 40|32@1+ (1,0) [0|4294967295] "DateTime"  Project
 SG_ EEPROM_Event_Counter m32848 : 40|32@1+ (1,0) [0|4294967295] "Time"  Project
 SG_ EEPROM_DFALockMark m32864 : 40|16@1+ (1,0) [0|65535] "Hex"  Project
 SG_ EEPROM_DFAEraseCnt m32865 : 40|16@1+ (1,0) [0|65535] "Time"  Project
 SG_ EEPROM_DFBLockMark m32866 : 40|16@1+ (1,0) [0|65535] "Hex"  Project
 SG_ EEPROM_DFBEraseCnt m32867 : 40|16@1+ (1,0) [0|65535] "Times"  Project
 SG_ EEPROM_ReprogramHtyCounter m32872 : 40|8@1+ (1,0) [0|255] "Times"  Project
 SG_ EEPROM_CommInterface m32872 : 48|8@1+ (1,0) [0|255] "Hex"  Project
 SG_ EEPROM_BtLoaderVer m32872 : 56|16@1+ (1,0) [0|65535] "Hex"  Project
 SG_ EEPROM_FCCmin m32873 : 40|16@1+ (1,0) [0|65535] "mAh"  Project
 SG_ EEPROM_RCminCutoff m32874 : 40|32@1- (1,0) [-3.4E+38|3.4E+38] "mAh"  Project
 SG_ EEPROM_FCClearning m32875 : 40|16@1+ (1,0) [0|65535] "mAh"  Project
 SG_ EEPROM_CustomerSN1 m32885 : 40|48@1+ (1,0) [0|281474976710655] "ASCII"  Project
 SG_ EEPROM_CustomerSN2 m32886 : 40|48@1+ (1,0) [0|281474976710655] "ASCII"  Project
 SG_ EEPROM_CustomerSN3 m32887 : 40|48@1+ (1,0) [0|281474976710655] "ASCII"  Project
 SG_ EEPROM_CustomerSN4 m32888 : 40|48@1+ (1,0) [0|281474976710655] "ASCII"  Project
 SG_ EEPROM_CustomerSN5 m32889 : 40|48@1+ (1,0) [0|281474976710655] "ASCII"  Project
BO_ 1879 DFB: 8 test
 SG_ DFB_command M : 24|16@1+ (1,0) [0|65535] ""  Project
 SG_ DFB_OperationCfgB m0 : 40|16@1+ (1,0) [0|65535] "Hex"  Project
 SG_ DFB_Rsense m1 : 40|32@1+ (0.01,0) [0|42949672.95] "mOhm"  Project
 SG_ DFB_COC m4 : 40|32@1- (1,0) [-2147483648|2147483647] "mA"  Project
 SG_ DFB_COCWT m4 : 72|16@1+ (0.05,0) [0|3276.75] "Sec"  Project
 SG_ DFB_COC2 m5 : 40|32@1- (1,0) [-2147483648|2147483647] "mA"  Project
 SG_ DFB_COCWT2 m5 : 72|16@1+ (0.05,0) [0|3276.75] "Sec"  Project
 SG_ DFB_COCRWT m6 : 40|16@1+ (0.05,0) [0|3276.75] "Sec"  Project
 SG_ DFB_LTCOC m7 : 40|32@1- (1,0) [-2147483648|2147483647] "mA"  Project
 SG_ DFB_LTCOCWT m7 : 72|16@1+ (0.05,0) [0|3276.75] "Sec"  Project
 SG_ DFB_OVP m8 : 40|16@1+ (1,0) [0|65535] "mV"  Project
 SG_ DFB_OVPR m8 : 56|16@1+ (1,0) [0|65535] "mV"  Project
 SG_ DFB_OVPWT m9 : 40|16@1+ (0.05,0) [0|3276.75] "Sec"  Project
 SG_ DFB_OVPRWT m9 : 56|16@1+ (0.05,0) [0|3276.75] "Sec"  Project
 SG_ DFB_COT m10 : 40|8@1- (1,0) [-128|127] "DegC"  Project
 SG_ DFB_COTR m10 : 48|8@1- (1,0) [-128|127] "DegC"  Project
 SG_ DFB_CUT m10 : 56|8@1- (1,0) [-128|127] "DegC"  Project
 SG_ DFB_CUTR m10 : 64|8@1- (1,0) [-128|127] "DegC"  Project
 SG_ DFB_TempFlagWT m10 : 72|16@1+ (0.05,0) [0|3276.75] "Sec"  Project
 SG_ DFB_LTChg m11 : 40|8@1- (1,0) [-128|127] "DegC"  Project
 SG_ DFB_LTChgR m11 : 48|8@1- (1,0) [-128|127] "DegC"  Project
 SG_ DFB_ZeroCurrentTH m12 : 40|16@1- (1,0) [-32768|32767] "mA"  Project
 SG_ DFB_DOC m16 : 40|32@1- (1,0) [-2147483648|2147483647] "mA"  Project
 SG_ DFB_DOCWT m16 : 72|16@1+ (0.05,0) [0|3276.75] "Sec"  Project
 SG_ DFB_DOC2 m17 : 40|32@1- (1,0) [-2147483648|2147483647] "mA"  Project
 SG_ DFB_DOCWT2 m17 : 72|16@1+ (0.05,0) [0|3276.75] "Sec"  Project
 SG_ DFB_DOC3 m18 : 40|32@1- (1,0) [-2147483648|2147483647] "mA"  Project
 SG_ DFB_DOCWT3 m18 : 72|16@1+ (0.05,0) [0|3276.75] "Sec"  Project
 SG_ DFB_DOCRWT m19 : 40|16@1+ (0.05,0) [0|3276.75] "Sec"  Project
 SG_ DFB_DOCD m19 : 56|32@1- (1,0) [-2147483648|2147483647] "mA"  Project
 SG_ DFB_UVP m20 : 40|16@1+ (1,0) [0|65535] "mV"  Project
 SG_ DFB_UVPR m20 : 56|16@1+ (1,0) [0|65535] "mV"  Project
 SG_ DFB_UVPWT m21 : 40|16@1+ (0.05,0) [0|3276.75] "Sec"  Project
 SG_ DFB_UVPRWT m21 : 56|16@1+ (0.05,0) [0|3276.75] "Sec"  Project
 SG_ DFB_DOT m22 : 40|8@1- (1,0) [-128|127] "DegC"  Project
 SG_ DFB_DOTR m22 : 48|8@1- (1,0) [-128|127] "DegC"  Project
 SG_ DFB_DUT m22 : 56|8@1- (1,0) [-128|127] "DegC"  Project
 SG_ DFB_DUTR m22 : 64|8@1- (1,0) [-128|127] "DegC"  Project
 SG_ DFB_MOSOT m23 : 40|8@1- (1,0) [-128|127] "DegC"  Project
 SG_ DFB_MOSOTR m23 : 48|8@1- (1,0) [-128|127] "DegC"  Project
 SG_ DFB_SCPRelease m24 : 40|16@1+ (1,0) [0|65535] "mV"  Project
 SG_ DFB_WarnCOCWT m32 : 40|16@1+ (0.05,0) [0|3276.75] "Sec"  Project
 SG_ DFB_WarnCOCWT2 m32 : 56|16@1+ (0.05,0) [0|3276.75] "Sec"  Project
 SG_ DFB_WarnOVP m33 : 40|16@1+ (1,0) [0|65535] "mV"  Project
 SG_ DFB_WarnOVPR m33 : 56|16@1+ (1,0) [0|65535] "mV"  Project
 SG_ DFB_WarnOVPWT m34 : 40|16@1+ (0.05,0) [0|3276.75] "Sec"  Project
 SG_ DFB_WarnOVPRWT m34 : 56|16@1+ (0.05,0) [0|3276.75] "Sec"  Project
 SG_ DFB_WarnCOT m35 : 40|8@1- (1,0) [-128|127] "DegC"  Project
 SG_ DFB_WarnCUT m35 : 48|8@1- (1,0) [-128|127] "DegC"  Project
 SG_ DFB_WarnDOCWT m40 : 40|16@1+ (0.05,0) [0|3276.75] "Sec"  Project
 SG_ DFB_WarnDOCWT2 m40 : 56|16@1+ (0.05,0) [0|3276.75] "Sec"  Project
 SG_ DFB_WarnDOCWT3 m40 : 72|16@1+ (0.05,0) [0|3276.75] "Sec"  Project
 SG_ DFB_WarnUVP m41 : 40|16@1+ (1,0) [0|65535] "mV"  Project
 SG_ DFB_WarnUVPR m41 : 56|16@1+ (1,0) [0|65535] "mV"  Project
 SG_ DFB_WarnUVPWT m42 : 40|16@1+ (0.05,0) [0|3276.75] "Sec"  Project
 SG_ DFB_WarnUVPRWT m42 : 56|16@1+ (0.05,0) [0|3276.75] "Sec"  Project
 SG_ DFB_WarnDOT m43 : 40|8@1- (1,0) [-128|127] "DegC"  Project
 SG_ DFB_WarnDUT m43 : 48|8@1- (1,0) [-128|127] "DegC"  Project
 SG_ DFB_WarnMOSOT m44 : 40|8@1- (1,0) [-128|127] "DegC"  Project
 SG_ DFB_ShippingVolt m48 : 40|16@1+ (1,0) [0|65535] "mV"  Project
 SG_ DFB_ShippingWT m49 : 40|16@1+ (0.05,0) [0|3276.75] "Sec"  Project
 SG_ DFB_ShutDownVolt m50 : 40|16@1+ (1,0) [0|65535] "mV"  Project
 SG_ DFB_ShutDownWT m51 : 40|16@1+ (0.05,0) [0|3276.75] "Sec"  Project
 SG_ DFB_PFOVP m56 : 40|16@1+ (1,0) [0|65535] "mV"  Project
 SG_ DFB_PFOVPWT m56 : 56|16@1+ (0.05,0) [0|3276.75] "Sec"  Project
 SG_ DFB_PFUVP m57 : 40|16@1+ (1,0) [0|65535] "mV"  Project
 SG_ DFB_PFUVPWT m57 : 56|16@1+ (0.05,0) [0|3276.75] "Sec"  Project
 SG_ DFB_PFCBStartRSOC m58 : 40|8@1+ (1,0) [0|255] "%"  Project
 SG_ DFB_PFCBOnNORMAL m58 : 48|16@1+ (1,0) [0|65535] "mV"  Project
 SG_ DFB_PFCBWT m58 : 64|16@1+ (0.05,0) [0|3276.75] "Sec"  Project
 SG_ DFB_CellTerminalVolt m64 : 40|16@1+ (1,0) [0|65535] "mV"  Project
 SG_ DFB_TaperCurrentTH m64 : 56|16@1- (1,0) [-32768|32767] "mA"  Project
 SG_ DFB_ChargingVoltage m65 : 40|16@1+ (1,0) [0|65535] "mV"  Project
 SG_ DFB_ChargingCurrent m65 : 56|16@1- (1,0) [-32768|32767] "mA"  Project
 SG_ DFB_LTChargingCurrent m66 : 40|16@1- (1,0) [-32768|32767] "mA"  Project
 SG_ DFB_CCTimeOut m67 : 40|32@1+ (0.05,0) [0|214748364.75] "Sec"  Project
 SG_ DFB_CVTimeOut m68 : 40|32@1+ (0.05,0) [0|214748364.75] "Sec"  Project
 SG_ DFB_CBOnTH m72 : 40|16@1+ (1,0) [0|65535] "mV"  Project
 SG_ DFB_CBOffTH m72 : 56|16@1+ (1,0) [0|65535] "mV"  Project
 SG_ DFB_CBStartVolt m73 : 40|16@1+ (1,0) [0|65535] "mV"  Project
 SG_ DFB_CBOnWT m73 : 56|16@1+ (0.05,0) [0|3276.75] "Sec"  Project
 SG_ DFB_PDWT m80 : 40|16@1+ (0.05,0) [0|3276.75] "Sec"  Project
 SG_ DFB_PDEV m80 : 56|16@1+ (1,0) [0|65535] "mV"  Project
 SG_ DFB_PDTO m80 : 72|16@1+ (0.05,0) [0|3276.75] "Sec"  Project
 SG_ DFB_FetOffWT m88 : 40|16@1+ (0.05,0) [0|3276.75] "Sec"  Project
 SG_ DFB_EntryStopWT m88 : 56|16@1+ (0.05,0) [0|3276.75] "Sec"  Project
 SG_ DFB_PowerDownWT m89 : 40|32@1+ (0.05,0) [0|214748364.75] "Sec"  Project
 SG_ DFB_DesignCapacity m96 : 40|16@1+ (1,0) [0|65535] "mAh"  Project
 SG_ DFB_SelfDsgCurrent m96 : 56|16@1+ (1,0) [0|65535] "mA"  Project
 SG_ DFB_CycleCountTH m96 : 72|16@1+ (1,0) [0|65535] "mAh"  Project
 SG_ DFB_NearFull m97 : 40|16@1+ (1,0) [0|65535] "mAh"  Project
 SG_ DFB_FCCTempLow m97 : 56|8@1- (1,0) [-128|127] "DegC"  Project
 SG_ DFB_FCCTempHigh m97 : 64|8@1- (1,0) [-128|127] "DegC"  Project
 SG_ DFB_OCVUpdateTime m98 : 40|32@1+ (0.05,0) [0|214748364.75] "Sec"  Project
 SG_ DFB_ChgTerminateCurrent m99 : 40|16@1- (1,0) [-32768|32767] "mA"  Project
 SG_ DFB_ChgTerminateVoltage m99 : 56|16@1+ (1,0) [0|65535] "mV"  Project
 SG_ DFB_FCCUpdateUpperBound m99 : 72|8@1+ (1,0) [0|255] "%"  Project
 SG_ DFB_OCVTable[0] m104 : 40|16@1+ (1,0) [0|65535] "mV"  Project
 SG_ DFB_OCVTable[1] m104 : 56|16@1+ (1,0) [0|65535] "mV"  Project
 SG_ DFB_OCVTable[2] m104 : 72|16@1+ (1,0) [0|65535] "mV"  Project
 SG_ DFB_OCVTable[3] m105 : 40|16@1+ (1,0) [0|65535] "mV"  Project
 SG_ DFB_OCVTable[4] m105 : 56|16@1+ (1,0) [0|65535] "mV"  Project
 SG_ DFB_OCVTable[5] m105 : 72|16@1+ (1,0) [0|65535] "mV"  Project
 SG_ DFB_OCVTable[6] m106 : 40|16@1+ (1,0) [0|65535] "mV"  Project
 SG_ DFB_OCVTable[7] m106 : 56|16@1+ (1,0) [0|65535] "mV"  Project
 SG_ DFB_OCVTable[8] m106 : 72|16@1+ (1,0) [0|65535] "mV"  Project
 SG_ DFB_OCVTable[9] m107 : 40|16@1+ (1,0) [0|65535] "mV"  Project
 SG_ DFB_OCVTable[10] m107 : 56|16@1+ (1,0) [0|65535] "mV"  Project
 SG_ DFB_OCVTable[11] m107 : 72|16@1+ (1,0) [0|65535] "mV"  Project
 SG_ DFB_OCVTable[12] m108 : 40|16@1+ (1,0) [0|65535] "mV"  Project
 SG_ DFB_OCVTable[13] m108 : 56|16@1+ (1,0) [0|65535] "mV"  Project
 SG_ DFB_OCVTable[14] m108 : 72|16@1+ (1,0) [0|65535] "mV"  Project
 SG_ DFB_OCVTable[15] m109 : 40|16@1+ (1,0) [0|65535] "mV"  Project
 SG_ DFB_OCVTable[16] m109 : 56|16@1+ (1,0) [0|65535] "mV"  Project
 SG_ DFB_RSOCTable[0] m112 : 40|16@1+ (0.01,0) [0|655.35] "%"  Project
 SG_ DFB_RSOCTable[1] m112 : 56|16@1+ (0.01,0) [0|655.35] "%"  Project
 SG_ DFB_RSOCTable[2] m112 : 72|16@1+ (0.01,0) [0|655.35] "%"  Project
 SG_ DFB_RSOCTable[3] m113 : 40|16@1+ (0.01,0) [0|655.35] "%"  Project
 SG_ DFB_RSOCTable[4] m113 : 56|16@1+ (0.01,0) [0|655.35] "%"  Project
 SG_ DFB_RSOCTable[5] m113 : 72|16@1+ (0.01,0) [0|655.35] "%"  Project
 SG_ DFB_RSOCTable[6] m114 : 40|16@1+ (0.01,0) [0|655.35] "%"  Project
 SG_ DFB_RSOCTable[7] m114 : 56|16@1+ (0.01,0) [0|655.35] "%"  Project
 SG_ DFB_RSOCTable[8] m114 : 72|16@1+ (0.01,0) [0|655.35] "%"  Project
 SG_ DFB_RSOCTable[9] m115 : 40|16@1+ (0.01,0) [0|655.35] "%"  Project
 SG_ DFB_RSOCTable[10] m115 : 56|16@1+ (0.01,0) [0|655.35] "%"  Project
 SG_ DFB_RSOCTable[11] m115 : 72|16@1+ (0.01,0) [0|655.35] "%"  Project
 SG_ DFB_RSOCTable[12] m116 : 40|16@1+ (0.01,0) [0|655.35] "%"  Project
 SG_ DFB_RSOCTable[13] m116 : 56|16@1+ (0.01,0) [0|655.35] "%"  Project
 SG_ DFB_RSOCTable[14] m116 : 72|16@1+ (0.01,0) [0|655.35] "%"  Project
 SG_ DFB_RSOCTable[15] m117 : 40|16@1+ (0.01,0) [0|655.35] "%"  Project
 SG_ DFB_RSOCTable[16] m117 : 56|16@1+ (0.01,0) [0|655.35] "%"  Project
 SG_ DFB_DFBLockMark m120 : 40|16@1+ (1,0) [0|65535] "Hex"  Project
 SG_ DFB_DFBEraseCnt m121 : 40|16@1+ (1,0) [0|65535] "Times"  Project
 SG_ DFB_DFBChkSum m122 : 40|32@1+ (1,0) [0|4294967295] "Hex"  Project
 SG_ DFB_WDFB1 m4095 : 40|8@1+ (1,0) [0|255] "ASCII"  Project
 SG_ DFB_WDFB2 m4095 : 48|8@1+ (1,0) [0|255] "ASCII"  Project
 SG_ DFB_WDFB3 m4095 : 56|8@1+ (1,0) [0|255] "ASCII"  Project
BO_ 1881 DFC: 8 test
 SG_ DFC_command M : 24|16@1+ (1,0) [0|65535] ""  Project
 SG_ DFC_BurningFuseTrigCnt m0 : 40|8@1+ (1,0) [0|255] "Times"  Project
 SG_ DFC_BurningFuse1stTrigVolt m1 : 40|16@1+ (1,0) [0|65535] "mV"  Project
 SG_ DFC_AFE_RegisterErrorCnt m2 : 40|8@1+ (1,0) [0|255] "Times"  Project
 SG_ DFC_OperationCfgC m3 : 40|16@1+ (1,0) [0|65535] "Hex"  Project
 SG_ DFC_OCV_DeltaRSOC m4 : 40|32@1- (1,0) [-3.4E+38|3.4E+38] "%"  Project
 SG_ DFC_UnbalanceCnt m5 : 40|8@1+ (1,0) [0|255] "Times"  Project
 SG_ DFC_WarnOVPCnt m6 : 40|8@1+ (1,0) [0|255] "Time"  Project
 SG_ DFC_WarnOVP_Vcell1 m7 : 40|16@1+ (1,0) [0|65535] "mV"  Project
 SG_ DFC_WarnOVP_Vcell2 m7 : 56|16@1+ (1,0) [0|65535] "mV"  Project
 SG_ DFC_WarnOVP_Vcell3 m7 : 72|16@1+ (1,0) [0|65535] "mV"  Project
 SG_ DFC_WarnOVP_Vcell4 m8 : 40|16@1+ (1,0) [0|65535] "mV"  Project
 SG_ DFC_WarnOVP_Vcell5 m8 : 56|16@1+ (1,0) [0|65535] "mV"  Project
 SG_ DFC_WarnOVP_Vcell6 m8 : 72|16@1+ (1,0) [0|65535] "mV"  Project
 SG_ DFC_WarnOVP_Vcell7 m9 : 40|16@1+ (1,0) [0|65535] "mV"  Project
 SG_ DFC_WarnOVP_Vcell8 m9 : 56|16@1+ (1,0) [0|65535] "mV"  Project
 SG_ DFC_WarnOVP_Vcell9 m9 : 72|16@1+ (1,0) [0|65535] "mV"  Project
 SG_ DFC_WarnOVP_Vcell10 m10 : 40|16@1+ (1,0) [0|65535] "mV"  Project
 SG_ DFC_WarnOVP_Vcell11 m10 : 56|16@1+ (1,0) [0|65535] "mV"  Project
 SG_ DFC_WarnOVP_Vcell12 m10 : 72|16@1+ (1,0) [0|65535] "mV"  Project
 SG_ DFC_WarnOVP_Vcell13 m11 : 40|16@1+ (1,0) [0|65535] "mV"  Project
 SG_ DFC_WarnOVP_Vcell14 m11 : 56|16@1+ (1,0) [0|65535] "mV"  Project
 SG_ DFC_WarnOVP_Vcell15 m11 : 72|16@1+ (1,0) [0|65535] "mV"  Project
 SG_ DFC_WarnOVP_Vcell16 m12 : 40|16@1+ (1,0) [0|65535] "mV"  Project
 SG_ DFC_LearningStatus m13 : 40|8@1+ (1,0) [0|255] "Hex"  Project
 SG_ DFC_FCCUpdateTemp m13 : 48|16@1- (0.1,0) [-3276.8|3276.7] "DegC"  Project
 SG_ DFC_Det2nd_TriggerCnt m16 : 40|16@1+ (1,0) [0|65535] "Times"  Project
 SG_ DFC_Det2nd_MaxTriggerTime m16 : 56|16@1+ (0.005,0) [0|327.675] "Sec"  Project
 SG_ DFC_Det2nd_1stRTC_Time m17 : 40|32@1+ (1,0) [0|4294967295] "DateTime"  Project
 SG_ DFC_Det2nd_2ndRTC_Time m18 : 40|32@1+ (1,0) [0|4294967295] "DateTime"  Project
 SG_ DFC_Det2nd_3rdRTC_Time m19 : 40|32@1+ (1,0) [0|4294967295] "DateTime"  Project
 SG_ DFC_Det2nd_1stCurrent m20 : 40|32@1- (1,0) [-2147483648|2147483647] "mA"  Project
 SG_ DFC_Det2nd_2ndCurrent m21 : 40|32@1- (1,0) [-2147483648|2147483647] "mA"  Project
 SG_ DFC_Det2nd_3rdCurrent m22 : 40|32@1- (1,0) [-2147483648|2147483647] "mA"  Project
 SG_ DFC_Det2nd_1stMosTemp m23 : 40|16@1- (0.1,0) [-3276.8|3276.7] "DegC"  Project
 SG_ DFC_Det2nd_2ndMosTemp m23 : 56|16@1- (0.1,0) [-3276.8|3276.7] "DegC"  Project
 SG_ DFC_Det2nd_3rdMosTemp m23 : 72|16@1- (0.1,0) [-3276.8|3276.7] "DegC"  Project
 SG_ DFC_Det2nd_1stTriggerTime m24 : 40|16@1+ (0.005,0) [0|327.675] "Sec"  Project
 SG_ DFC_Det2nd_2ndTriggerTime m24 : 56|16@1+ (0.005,0) [0|327.675] "Sec"  Project
 SG_ DFC_Det2nd_3rdTriggerTime m24 : 72|16@1+ (0.005,0) [0|327.675] "Sec"  Project
 SG_ DFC_MaxCurrent m33 : 40|32@1- (1,0) [-2147483648|2147483647] "mA"  Project
 SG_ DFC_MinCurrent m34 : 40|32@1- (1,0) [-2147483648|2147483647] "mA"  Project
 SG_ DFC_MaxTemp1 m35 : 40|16@1- (0.1,0) [-3276.8|3276.7] "DegC"  Project
 SG_ DFC_MaxTemp2 m35 : 56|16@1- (0.1,0) [-3276.8|3276.7] "DegC"  Project
 SG_ DFC_MaxTemp3 m35 : 72|16@1- (0.1,0) [-3276.8|3276.7] "DegC"  Project
 SG_ DFC_MaxTemp4 m36 : 40|16@1- (0.1,0) [-3276.8|3276.7] "DegC"  Project
 SG_ DFC_MaxTemp5 m36 : 56|16@1- (0.1,0) [-3276.8|3276.7] "DegC"  Project
 SG_ DFC_MaxTemp6 m36 : 72|16@1- (0.1,0) [-3276.8|3276.7] "DegC"  Project
 SG_ DFC_MinTemp1 m37 : 40|16@1- (0.1,0) [-3276.8|3276.7] "DegC"  Project
 SG_ DFC_MinTemp2 m37 : 56|16@1- (0.1,0) [-3276.8|3276.7] "DegC"  Project
 SG_ DFC_MinTemp3 m37 : 72|16@1- (0.1,0) [-3276.8|3276.7] "DegC"  Project
 SG_ DFC_MinTemp4 m38 : 40|16@1- (0.1,0) [-3276.8|3276.7] "DegC"  Project
 SG_ DFC_MinTemp5 m38 : 56|16@1- (0.1,0) [-3276.8|3276.7] "DegC"  Project
 SG_ DFC_MinTemp6 m38 : 72|16@1- (0.1,0) [-3276.8|3276.7] "DegC"  Project
 SG_ DFC_InitTemp1 m39 : 40|16@1- (0.1,0) [-3276.8|3276.7] "DegC"  Project
 SG_ DFC_InitTemp2 m39 : 56|16@1- (0.1,0) [-3276.8|3276.7] "DegC"  Project
 SG_ DFC_InitTemp3 m39 : 72|16@1- (0.1,0) [-3276.8|3276.7] "DegC"  Project
 SG_ DFC_InitTemp4 m40 : 40|16@1- (0.1,0) [-3276.8|3276.7] "DegC"  Project
 SG_ DFC_InitTemp5 m40 : 56|16@1- (0.1,0) [-3276.8|3276.7] "DegC"  Project
 SG_ DFC_InitTemp6 m40 : 72|16@1- (0.1,0) [-3276.8|3276.7] "DegC"  Project
 SG_ DFC_CUTChgTime m41 : 40|32@1+ (0.05,0) [0|214748364.75] "Sec"  Project
 SG_ DFC_LowTempChgTIme m42 : 40|32@1+ (0.05,0) [0|214748364.75] "Sec"  Project
 SG_ DFC_DelayCnt m48 : 40|8@1+ (1,0) [0|255] "Value"  Project
 SG_ DFC_S1_TriggerCnt m49 : 40|16@1+ (1,0) [0|65535] "Times"  Project
 SG_ DFC_S1_MaxTriggerTime m49 : 56|16@1+ (0.05,0) [0|3276.75] "Sec"  Project
 SG_ DFC_S1_1stCurrent m50 : 40|32@1- (1,0) [-2147483648|2147483647] "mA"  Project
 SG_ DFC_S1_2ndCurrent m51 : 40|32@1- (1,0) [-2147483648|2147483647] "mA"  Project
 SG_ DFC_S1_3rdCurrent m52 : 40|32@1- (1,0) [-2147483648|2147483647] "mA"  Project
 SG_ DFC_S1_1stMosTemp m53 : 40|16@1- (0.1,0) [-3276.8|3276.7] "DegC"  Project
 SG_ DFC_S1_2ndMosTemp m53 : 56|16@1- (0.1,0) [-3276.8|3276.7] "DegC"  Project
 SG_ DFC_S1_3rdMosTemp m53 : 72|16@1- (0.1,0) [-3276.8|3276.7] "DegC"  Project
 SG_ DFC_S2_TriggerCnt m54 : 40|16@1+ (1,0) [0|65535] "Times"  Project
 SG_ DFC_S2_MaxTriggerTime m54 : 56|16@1+ (0.05,0) [0|3276.75] "Sec"  Project
 SG_ DFC_S2_1stCurrent m55 : 40|32@1- (1,0) [-2147483648|2147483647] "mA"  Project
 SG_ DFC_S2_2ndCurrent m56 : 40|32@1- (1,0) [-2147483648|2147483647] "mA"  Project
 SG_ DFC_S2_3rdCurrent m57 : 40|32@1- (1,0) [-2147483648|2147483647] "mA"  Project
 SG_ DFC_S2_1stMosTemp m58 : 40|16@1- (0.1,0) [-3276.8|3276.7] "DegC"  Project
 SG_ DFC_S2_2ndMosTemp m58 : 56|16@1- (0.1,0) [-3276.8|3276.7] "DegC"  Project
 SG_ DFC_S2_3rdMosTemp m58 : 72|16@1- (0.1,0) [-3276.8|3276.7] "DegC"  Project
 SG_ DFC_S3_TriggerCnt m59 : 40|16@1+ (1,0) [0|65535] "Times"  Project
 SG_ DFC_S3_MaxTriggerTime m59 : 56|16@1+ (0.05,0) [0|3276.75] "Sec"  Project
 SG_ DFC_S3_1stCurrent m60 : 40|32@1- (1,0) [-2147483648|2147483647] "mA"  Project
 SG_ DFC_S3_2ndCurrent m61 : 40|32@1- (1,0) [-2147483648|2147483647] "mA"  Project
 SG_ DFC_S3_3rdCurrent m62 : 40|32@1- (1,0) [-2147483648|2147483647] "mA"  Project
 SG_ DFC_S3_1stMosTemp m63 : 40|16@1- (0.1,0) [-3276.8|3276.7] "DegC"  Project
 SG_ DFC_S3_2ndMosTemp m63 : 56|16@1- (0.1,0) [-3276.8|3276.7] "DegC"  Project
 SG_ DFC_S3_3rdMosTemp m63 : 72|16@1- (0.1,0) [-3276.8|3276.7] "DegC"  Project
 SG_ DFC_S4_TriggerCnt m64 : 40|16@1+ (1,0) [0|65535] "Times"  Project
 SG_ DFC_S4_MaxTriggerTime m64 : 56|16@1+ (0.05,0) [0|3276.75] "Sec"  Project
 SG_ DFC_S4_1stCurrent m65 : 40|32@1- (1,0) [-2147483648|2147483647] "mA"  Project
 SG_ DFC_S4_2ndCurrent m66 : 40|32@1- (1,0) [-2147483648|2147483647] "mA"  Project
 SG_ DFC_S4_3rdCurrent m67 : 40|32@1- (1,0) [-2147483648|2147483647] "mA"  Project
 SG_ DFC_S4_1stMosTemp m68 : 40|16@1- (0.1,0) [-3276.8|3276.7] "DegC"  Project
 SG_ DFC_S4_2ndMosTemp m68 : 56|16@1- (0.1,0) [-3276.8|3276.7] "DegC"  Project
 SG_ DFC_S4_3rdMosTemp m68 : 72|16@1- (0.1,0) [-3276.8|3276.7] "DegC"  Project
 SG_ DFC_S5_TriggerCnt m69 : 40|16@1+ (1,0) [0|65535] "Times"  Project
 SG_ DFC_S5_MaxTriggerTime m69 : 56|16@1+ (0.05,0) [0|3276.75] "Sec"  Project
 SG_ DFC_S5_1stCurrent m70 : 40|32@1- (1,0) [-2147483648|2147483647] "mA"  Project
 SG_ DFC_S5_2ndCurrent m71 : 40|32@1- (1,0) [-2147483648|2147483647] "mA"  Project
 SG_ DFC_S5_3rdCurrent m72 : 40|32@1- (1,0) [-2147483648|2147483647] "mA"  Project
 SG_ DFC_S5_1stMosTemp m73 : 40|16@1- (0.1,0) [-3276.8|3276.7] "DegC"  Project
 SG_ DFC_S5_2ndMosTemp m73 : 56|16@1- (0.1,0) [-3276.8|3276.7] "DegC"  Project
 SG_ DFC_S5_3rdMosTemp m73 : 72|16@1- (0.1,0) [-3276.8|3276.7] "DegC"  Project
 SG_ DFC_Wakeup_Volt1 m74 : 40|16@1+ (1,0) [0|65535] "mV"  Project
 SG_ DFC_Wakeup_Volt2 m74 : 56|16@1+ (1,0) [0|65535] "mV"  Project
 SG_ DFC_Wakeup_Volt3 m74 : 72|16@1+ (1,0) [0|65535] "mV"  Project
 SG_ DFC_Wakeup_Volt4 m75 : 40|16@1+ (1,0) [0|65535] "mV"  Project
 SG_ DFC_Wakeup_Volt5 m75 : 56|16@1+ (1,0) [0|65535] "mV"  Project
 SG_ DFC_Wakeup_Volt6 m75 : 72|16@1+ (1,0) [0|65535] "mV"  Project
 SG_ DFC_Wakeup_Volt7 m76 : 40|16@1+ (1,0) [0|65535] "mV"  Project
 SG_ DFC_Wakeup_Volt8 m76 : 56|16@1+ (1,0) [0|65535] "mV"  Project
 SG_ DFC_Wakeup_Volt9 m76 : 72|16@1+ (1,0) [0|65535] "mV"  Project
 SG_ DFC_Wakeup_Volt10 m77 : 40|16@1+ (1,0) [0|65535] "mV"  Project
 SG_ DFC_Wakeup_Volt11 m77 : 56|16@1+ (1,0) [0|65535] "mV"  Project
 SG_ DFC_Wakeup_Volt12 m77 : 72|16@1+ (1,0) [0|65535] "mV"  Project
 SG_ DFC_Wakeup_Volt13 m78 : 40|16@1+ (1,0) [0|65535] "mV"  Project
 SG_ DFC_Wakeup_Volt14 m78 : 56|16@1+ (1,0) [0|65535] "mV"  Project
 SG_ DFC_Wakeup_Volt15 m78 : 72|16@1+ (1,0) [0|65535] "mV"  Project
 SG_ DFC_Wakeup_Volt16 m79 : 40|16@1+ (1,0) [0|65535] "mV"  Project
 SG_ DFC_Wakeup_Temp1 m80 : 40|16@1- (0.1,0) [-3276.8|3276.7] "DegC"  Project
 SG_ DFC_Wakeup_Temp2 m80 : 56|16@1- (0.1,0) [-3276.8|3276.7] "DegC"  Project
 SG_ DFC_Wakeup_Temp3 m80 : 72|16@1- (0.1,0) [-3276.8|3276.7] "DegC"  Project
 SG_ DFC_Wakeup_Temp4 m81 : 40|16@1- (0.1,0) [-3276.8|3276.7] "DegC"  Project
 SG_ DFC_Wakeup_Temp5 m81 : 56|16@1- (0.1,0) [-3276.8|3276.7] "DegC"  Project
 SG_ DFC_Wakeup_Temp6 m81 : 72|16@1- (0.1,0) [-3276.8|3276.7] "DegC"  Project
 SG_ DFC_ChargerInCnt m82 : 40|16@1+ (1,0) [0|65535] "Times"  Project
 SG_ DFC_PowerOffTotalCnt m83 : 40|32@1+ (1,0) [0|4294967295] "Times"  Project
 SG_ DFC_PowerOffChargerInCnt m83 : 72|16@1+ (1,0) [0|65535] "Times"  Project
 SG_ DFC_PowerOffCustomer1 m84 : 40|16@1+ (1,0) [0|65535] "Times"  Project
 SG_ DFC_PowerOffCustomer2 m84 : 56|16@1+ (1,0) [0|65535] "Times"  Project
 SG_ DFC_CellBalDur1 m85 : 40|32@1+ (1,0) [0|4294967295] "Sec"  Project
 SG_ DFC_CellBalDur2 m86 : 40|32@1+ (1,0) [0|4294967295] "Sec"  Project
 SG_ DFC_CellBalDur3 m87 : 40|32@1+ (1,0) [0|4294967295] "Sec"  Project
 SG_ DFC_CellBalDur4 m88 : 40|32@1+ (1,0) [0|4294967295] "Sec"  Project
 SG_ DFC_CellBalDur5 m89 : 40|32@1+ (1,0) [0|4294967295] "Sec"  Project
 SG_ DFC_CellBalDur6 m90 : 40|32@1+ (1,0) [0|4294967295] "Sec"  Project
 SG_ DFC_CellBalDur7 m91 : 40|32@1+ (1,0) [0|4294967295] "Sec"  Project
 SG_ DFC_CellBalDur8 m92 : 40|32@1+ (1,0) [0|4294967295] "Sec"  Project
 SG_ DFC_CellBalDur9 m93 : 40|32@1+ (1,0) [0|4294967295] "Sec"  Project
 SG_ DFC_CellBalDur10 m94 : 40|32@1+ (1,0) [0|4294967295] "Sec"  Project
 SG_ DFC_CellBalDur11 m95 : 40|32@1+ (1,0) [0|4294967295] "Sec"  Project
 SG_ DFC_CellBalDur12 m96 : 40|32@1+ (1,0) [0|4294967295] "Sec"  Project
 SG_ DFC_CellBalDur13 m97 : 40|32@1+ (1,0) [0|4294967295] "Sec"  Project
 SG_ DFC_CellBalDur14 m98 : 40|32@1+ (1,0) [0|4294967295] "Sec"  Project
 SG_ DFC_CellBalDur15 m99 : 40|32@1+ (1,0) [0|4294967295] "Sec"  Project
 SG_ DFC_CellBalDur16 m100 : 40|32@1+ (1,0) [0|4294967295] "Sec"  Project
 SG_ DFC_DSG-Temp_M20_0_Dur m101 : 40|32@1+ (1,0) [0|4294967295] "Sec"  Project
 SG_ DFC_DSG-Temp_0_50_Dur m102 : 40|32@1+ (1,0) [0|4294967295] "Sec"  Project
 SG_ DFC_DSG-Temp_50_DOT_Dur m103 : 40|32@1+ (1,0) [0|4294967295] "Sec"  Project
 SG_ DFC_CHG_Temp_0_10_HiVoltDur m104 : 40|32@1+ (1,0) [0|4294967295] "Sec"  Project
 SG_ DFC_CHG_Temp_0_10_NoHiVoltDur m105 : 40|32@1+ (1,0) [0|4294967295] "Sec"  Project
 SG_ DFC_CHG_Temp_10_40_HiVoltDur m106 : 40|32@1+ (1,0) [0|4294967295] "Sec"  Project
 SG_ DFC_CHG_Temp_10_40_NoHiVoltDur m107 : 40|32@1+ (1,0) [0|4294967295] "Sec"  Project
 SG_ DFC_CHG_Temp_40_COT_HiVoltDur m108 : 40|32@1+ (1,0) [0|4294967295] "Sec"  Project
 SG_ DFC_CHG_Temp_40_COT_NoHiVoltDur m109 : 40|32@1+ (1,0) [0|4294967295] "Sec"  Project
 SG_ DFC_REG_Temp_0_10_HiVoltDur m110 : 40|32@1+ (1,0) [0|4294967295] "Sec"  Project
 SG_ DFC_REG_Temp_0_10_NoHiVoltDur m111 : 40|32@1+ (1,0) [0|4294967295] "Sec"  Project
 SG_ DFC_REG_Temp_10_40_HiVoltDur m112 : 40|32@1+ (1,0) [0|4294967295] "Sec"  Project
 SG_ DFC_REG_Temp_10_40_NoHiVoltDur m113 : 40|32@1+ (1,0) [0|4294967295] "Sec"  Project
 SG_ DFC_REG_Temp_40_COT_HiVoltDur m114 : 40|32@1+ (1,0) [0|4294967295] "Sec"  Project
 SG_ DFC_REG_Temp_40_COT_NoHiVoltDur m115 : 40|32@1+ (1,0) [0|4294967295] "Sec"  Project
 SG_ DFC_CellAT0_Under_10_Dur m116 : 40|32@1+ (1,0) [0|4294967295] "Sec"  Project
 SG_ DFC_CellAT0_10_30_Dur m117 : 40|32@1+ (1,0) [0|4294967295] "Sec"  Project
 SG_ DFC_CellAT0_30_40_Dur m118 : 40|32@1+ (1,0) [0|4294967295] "Sec"  Project
 SG_ DFC_CellAT0_40_50_Dur m119 : 40|32@1+ (1,0) [0|4294967295] "Sec"  Project
 SG_ DFC_CellAT0_50_60_Dur m120 : 40|32@1+ (1,0) [0|4294967295] "Sec"  Project
 SG_ DFC_CellAT0_60_70_Dur m121 : 40|32@1+ (1,0) [0|4294967295] "Sec"  Project
 SG_ DFC_CellAT0_Over_70_Dur m122 : 40|32@1+ (1,0) [0|4294967295] "Sec"  Project
 SG_ DFC_CellAT1_Under_10_Dur m123 : 40|32@1+ (1,0) [0|4294967295] "Sec"  Project
 SG_ DFC_CellAT1_10_30_Dur m124 : 40|32@1+ (1,0) [0|4294967295] "Sec"  Project
 SG_ DFC_CellAT1_30_40_Dur m125 : 40|32@1+ (1,0) [0|4294967295] "Sec"  Project
 SG_ DFC_CellAT1_40_50_Dur m126 : 40|32@1+ (1,0) [0|4294967295] "Sec"  Project
 SG_ DFC_CellAT1_50_60_Dur m127 : 40|32@1+ (1,0) [0|4294967295] "Sec"  Project
 SG_ DFC_CellAT1_60_70_Dur m128 : 40|32@1+ (1,0) [0|4294967295] "Sec"  Project
 SG_ DFC_CellAT1_Over_70_Dur m129 : 40|32@1+ (1,0) [0|4294967295] "Sec"  Project
 SG_ DFC_CellAT2_Under_10_Dur m130 : 40|32@1+ (1,0) [0|4294967295] "Sec"  Project
 SG_ DFC_CellAT2_10_30_Dur m131 : 40|32@1+ (1,0) [0|4294967295] "Sec"  Project
 SG_ DFC_CellAT2_30_40_Dur m132 : 40|32@1+ (1,0) [0|4294967295] "Sec"  Project
 SG_ DFC_CellAT2_40_50_Dur m133 : 40|32@1+ (1,0) [0|4294967295] "Sec"  Project
 SG_ DFC_CellAT2_50_60_Dur m134 : 40|32@1+ (1,0) [0|4294967295] "Sec"  Project
 SG_ DFC_CellAT2_60_70_Dur m135 : 40|32@1+ (1,0) [0|4294967295] "Sec"  Project
 SG_ DFC_CellAT2_Over_70_Dur m136 : 40|32@1+ (1,0) [0|4294967295] "Sec"  Project
 SG_ DFC_HiVoltDur m137 : 40|32@1+ (1,0) [0|4294967295] "Sec"  Project
 SG_ DFC_HiTempHiVoltDur0 m138 : 40|32@1+ (1,0) [0|4294967295] "Sec"  Project
 SG_ DFC_HiTempHiVoltDur1 m139 : 40|32@1+ (1,0) [0|4294967295] "Sec"  Project
 SG_ DFC_HiTempHiVoltDur2 m140 : 40|32@1+ (1,0) [0|4294967295] "Sec"  Project
 SG_ DFC_CellMaxVolt1 m141 : 40|16@1+ (1,0) [0|65535] "mV"  Project
 SG_ DFC_CellMaxVolt2 m141 : 56|16@1+ (1,0) [0|65535] "mV"  Project
 SG_ DFC_CellMaxVolt3 m141 : 72|16@1+ (1,0) [0|65535] "mV"  Project
 SG_ DFC_CellMaxVolt4 m142 : 40|16@1+ (1,0) [0|65535] "mV"  Project
 SG_ DFC_CellMaxVolt5 m142 : 56|16@1+ (1,0) [0|65535] "mV"  Project
 SG_ DFC_CellMaxVolt6 m142 : 72|16@1+ (1,0) [0|65535] "mV"  Project
 SG_ DFC_CellMaxVolt7 m143 : 40|16@1+ (1,0) [0|65535] "mV"  Project
 SG_ DFC_CellMaxVolt8 m143 : 56|16@1+ (1,0) [0|65535] "mV"  Project
 SG_ DFC_CellMaxVolt9 m143 : 72|16@1+ (1,0) [0|65535] "mV"  Project
 SG_ DFC_CellMaxVolt10 m144 : 40|16@1+ (1,0) [0|65535] "mV"  Project
 SG_ DFC_CellMaxVolt11 m144 : 56|16@1+ (1,0) [0|65535] "mV"  Project
 SG_ DFC_CellMaxVolt12 m144 : 72|16@1+ (1,0) [0|65535] "mV"  Project
 SG_ DFC_CellMaxVolt13 m145 : 40|16@1+ (1,0) [0|65535] "mV"  Project
 SG_ DFC_CellMaxVolt14 m145 : 56|16@1+ (1,0) [0|65535] "mV"  Project
 SG_ DFC_CellMaxVolt15 m145 : 72|16@1+ (1,0) [0|65535] "mV"  Project
 SG_ DFC_CellMaxVolt16 m146 : 40|16@1+ (1,0) [0|65535] "mV"  Project
 SG_ DFC_CellMinVolt1 m147 : 40|16@1+ (1,0) [0|65535] "mV"  Project
 SG_ DFC_CellMinVolt2 m147 : 56|16@1+ (1,0) [0|65535] "mV"  Project
 SG_ DFC_CellMinVolt3 m147 : 72|16@1+ (1,0) [0|65535] "mV"  Project
 SG_ DFC_CellMinVolt4 m148 : 40|16@1+ (1,0) [0|65535] "mV"  Project
 SG_ DFC_CellMinVolt5 m148 : 56|16@1+ (1,0) [0|65535] "mV"  Project
 SG_ DFC_CellMinVolt6 m148 : 72|16@1+ (1,0) [0|65535] "mV"  Project
 SG_ DFC_CellMinVolt7 m149 : 40|16@1+ (1,0) [0|65535] "mV"  Project
 SG_ DFC_CellMinVolt8 m149 : 56|16@1+ (1,0) [0|65535] "mV"  Project
 SG_ DFC_CellMinVolt9 m149 : 72|16@1+ (1,0) [0|65535] "mV"  Project
 SG_ DFC_CellMinVolt10 m150 : 40|16@1+ (1,0) [0|65535] "mV"  Project
 SG_ DFC_CellMinVolt11 m150 : 56|16@1+ (1,0) [0|65535] "mV"  Project
 SG_ DFC_CellMinVolt12 m150 : 72|16@1+ (1,0) [0|65535] "mV"  Project
 SG_ DFC_CellMinVolt13 m151 : 40|16@1+ (1,0) [0|65535] "mV"  Project
 SG_ DFC_CellMinVolt14 m151 : 56|16@1+ (1,0) [0|65535] "mV"  Project
 SG_ DFC_CellMinVolt15 m151 : 72|16@1+ (1,0) [0|65535] "mV"  Project
 SG_ DFC_CellMinVolt16 m152 : 40|16@1+ (1,0) [0|65535] "mV"  Project
 SG_ DFC_ProdDateVolt1 m153 : 40|16@1+ (1,0) [0|65535] "mV"  Project
 SG_ DFC_ProdDateVolt2 m153 : 56|16@1+ (1,0) [0|65535] "mV"  Project
 SG_ DFC_ProdDateVolt3 m153 : 72|16@1+ (1,0) [0|65535] "mV"  Project
 SG_ DFC_ProdDateVolt4 m154 : 40|16@1+ (1,0) [0|65535] "mV"  Project
 SG_ DFC_ProdDateVolt5 m154 : 56|16@1+ (1,0) [0|65535] "mV"  Project
 SG_ DFC_ProdDateVolt6 m154 : 72|16@1+ (1,0) [0|65535] "mV"  Project
 SG_ DFC_ProdDateVolt7 m155 : 40|16@1+ (1,0) [0|65535] "mV"  Project
 SG_ DFC_ProdDateVolt8 m155 : 56|16@1+ (1,0) [0|65535] "mV"  Project
 SG_ DFC_ProdDateVolt9 m155 : 72|16@1+ (1,0) [0|65535] "mV"  Project
 SG_ DFC_ProdDateVolt10 m156 : 40|16@1+ (1,0) [0|65535] "mV"  Project
 SG_ DFC_ProdDateVolt11 m156 : 56|16@1+ (1,0) [0|65535] "mV"  Project
 SG_ DFC_ProdDateVolt12 m156 : 72|16@1+ (1,0) [0|65535] "mV"  Project
 SG_ DFC_ProdDateVolt13 m157 : 40|16@1+ (1,0) [0|65535] "mV"  Project
 SG_ DFC_ProdDateVolt14 m157 : 56|16@1+ (1,0) [0|65535] "mV"  Project
 SG_ DFC_ProdDateVolt15 m157 : 72|16@1+ (1,0) [0|65535] "mV"  Project
 SG_ DFC_ProdDateVolt16 m158 : 40|16@1+ (1,0) [0|65535] "mV"  Project
 SG_ DFC_MaxRegenCurrent m159 : 40|32@1- (1,0) [-2147483648|2147483647] "mA"  Project
 SG_ DFC_MaxRegenCurrentDur m159 : 72|16@1+ (0.05,0) [0|3276.75] "Sec"  Project
 SG_ DFC_LowVoltDetCnt m160 : 40|16@1+ (1,0) [0|65535] "Times"  Project
 SG_ DFC_LowVoltShutDownCnt m161 : 40|16@1+ (1,0) [0|65535] "Times"  Project
 SG_ DFC_CmdShutDownCnt m161 : 56|16@1+ (1,0) [0|65535] "Times"  Project
 SG_ DFC_AutoShutDownCnt m161 : 72|16@1+ (1,0) [0|65535] "Times"  Project
 SG_ DFC_FirstFCC_StartRSOC_MaxVolt m162 : 40|16@1+ (1,0) [0|65535] "mV"  Project
 SG_ DFC_FirstFCC_StartRSOC_MaxNum m162 : 56|8@1+ (1,1) [1|256] "Num"  Project
 SG_ DFC_FirstFCC_StartRSOC_MinVolt m162 : 64|16@1+ (1,0) [0|65535] "mV"  Project
 SG_ DFC_FirstFCC_StartRSOC_MinNum m162 : 80|8@1+ (1,1) [1|256] "Num"  Project
 SG_ DFC_FirstFCC_StartRSOC_AvgVolt m163 : 40|16@1+ (1,0) [0|65535] "mV"  Project
 SG_ DFC_FirstFCC_StopRSOC_MaxVolt m164 : 40|16@1+ (1,0) [0|65535] "mV"  Project
 SG_ DFC_FirstFCC_StopRSOC_MaxNum m164 : 56|8@1+ (1,1) [1|256] "Num"  Project
 SG_ DFC_FirstFCC_StopRSOC_MinVolt m164 : 64|16@1+ (1,0) [0|65535] "mV"  Project
 SG_ DFC_FirstFCC_StopRSOC_MinNum m164 : 80|8@1+ (1,1) [1|256] "Num"  Project
 SG_ DFC_FirstFCC_StopRSOC_AvgVolt m165 : 40|16@1+ (1,0) [0|65535] "mV"  Project
 SG_ DFC_FirstFCC_Time m166 : 40|32@1+ (1,0) [0|4294967295] "DateTime"  Project
 SG_ DFC_FirstFCC_Result m166 : 72|16@1+ (1,0) [0|65535] "mAh"  Project
 SG_ DFC_LastFCC_StartRSOC_MaxVolt m167 : 40|16@1+ (1,0) [0|65535] "mV"  Project
 SG_ DFC_LastFCC_StartRSOC_MaxNum m167 : 56|8@1+ (1,1) [1|256] "Num"  Project
 SG_ DFC_LastFCC_StartRSOC_MinVolt m167 : 64|16@1+ (1,0) [0|65535] "mV"  Project
 SG_ DFC_LastFCC_StartRSOC_MinNum m167 : 80|8@1+ (1,1) [1|256] "Num"  Project
 SG_ DFC_LastFCC_StartRSOC_AvgVolt m168 : 40|16@1+ (1,0) [0|65535] "mV"  Project
 SG_ DFC_LastFCC_StopRSOC_MaxVolt m169 : 40|16@1+ (1,0) [0|65535] "mV"  Project
 SG_ DFC_LastFCC_StopRSOC_MaxNum m169 : 56|8@1+ (1,1) [1|256] "Num"  Project
 SG_ DFC_LastFCC_StopRSOC_MinVolt m169 : 64|16@1+ (1,0) [0|65535] "mV"  Project
 SG_ DFC_LastFCC_StopRSOC_MinNum m169 : 80|8@1+ (1,1) [1|256] "Num"  Project
 SG_ DFC_LastFCC_StopRSOC_AvgVolt m170 : 40|16@1+ (1,0) [0|65535] "mV"  Project
 SG_ DFC_DFCEraseCnt m1024 : 40|16@1+ (1,0) [0|65535] "Times"  Project
 SG_ DFC_DFCChkSum m1025 : 40|32@1+ (1,0) [0|4294967295] "Hex"  Project
BO_ 1883 FaultTrace: 8 test
 SG_ FaultTrace_command M : 24|16@1+ (1,0) [0|65535] ""  Project
 SG_ FaultTrace_Event_Counter_1 m8192 : 40|32@1+ (1,0) [0|4294967295] "Time"  Project
 SG_ FaultTrace_AvgVol_1_1 m8193 : 40|16@1+ (1,0) [0|65535] "mV"  Project
 SG_ FaultTrace_MaxVol_1_1 m8193 : 56|16@1+ (1,0) [0|65535] "mV"  Project
 SG_ FaultTrace_MinVol_1_1 m8193 : 72|16@1+ (1,0) [0|65535] "mV"  Project
 SG_ FaultTrace_CellNumMax_1_1 m8194 : 40|8@1+ (1,0) [0|255] "Number"  Project
 SG_ FaultTrace_CellNumMin_1_1 m8194 : 48|8@1+ (1,0) [0|255] "Number"  Project
 SG_ FaultTrace_AvgCurrent_1_1 m8195 : 40|32@1- (1,0) [-2147483648|2147483647] "mA"  Project
 SG_ FaultTrace_BatteryStatus_1_1 m8196 : 40|32@1+ (1,0) [0|4294967295] "Hex"  Project
 SG_ FaultTrace_PackStatus_1_1 m8197 : 40|16@1+ (1,0) [0|65535] "Hex"  Project
 SG_ FaultTrace_AvgVol_1_2 m8209 : 40|16@1+ (1,0) [0|65535] "mV"  Project
 SG_ FaultTrace_MaxVol_1_2 m8209 : 56|16@1+ (1,0) [0|65535] "mV"  Project
 SG_ FaultTrace_MinVol_1_2 m8209 : 72|16@1+ (1,0) [0|65535] "mV"  Project
 SG_ FaultTrace_CellNumMax_1_2 m8210 : 40|8@1+ (1,0) [0|255] "Number"  Project
 SG_ FaultTrace_CellNumMin_1_2 m8210 : 48|8@1+ (1,0) [0|255] "Number"  Project
 SG_ FaultTrace_AvgCurrent_1_2 m8211 : 40|32@1- (1,0) [-2147483648|2147483647] "mA"  Project
 SG_ FaultTrace_BatteryStatus_1_2 m8212 : 40|32@1+ (1,0) [0|4294967295] "Hex"  Project
 SG_ FaultTrace_PackStatus_1_2 m8213 : 40|16@1+ (1,0) [0|65535] "Hex"  Project
 SG_ FaultTrace_AvgVol_1_3 m8225 : 40|16@1+ (1,0) [0|65535] "mV"  Project
 SG_ FaultTrace_MaxVol_1_3 m8225 : 56|16@1+ (1,0) [0|65535] "mV"  Project
 SG_ FaultTrace_MinVol_1_3 m8225 : 72|16@1+ (1,0) [0|65535] "mV"  Project
 SG_ FaultTrace_CellNumMax_1_3 m8226 : 40|8@1+ (1,0) [0|255] "Number"  Project
 SG_ FaultTrace_CellNumMin_1_3 m8226 : 48|8@1+ (1,0) [0|255] "Number"  Project
 SG_ FaultTrace_AvgCurrent_1_3 m8227 : 40|32@1- (1,0) [-2147483648|2147483647] "mA"  Project
 SG_ FaultTrace_BatteryStatus_1_3 m8228 : 40|32@1+ (1,0) [0|4294967295] "Hex"  Project
 SG_ FaultTrace_PackStatus_1_3 m8229 : 40|16@1+ (1,0) [0|65535] "Hex"  Project
 SG_ FaultTrace_AvgVol_1_4 m8241 : 40|16@1+ (1,0) [0|65535] "mV"  Project
 SG_ FaultTrace_MaxVol_1_4 m8241 : 56|16@1+ (1,0) [0|65535] "mV"  Project
 SG_ FaultTrace_MinVol_1_4 m8241 : 72|16@1+ (1,0) [0|65535] "mV"  Project
 SG_ FaultTrace_CellNumMax_1_4 m8242 : 40|8@1+ (1,0) [0|255] "Number"  Project
 SG_ FaultTrace_CellNumMin_1_4 m8242 : 48|8@1+ (1,0) [0|255] "Number"  Project
 SG_ FaultTrace_AvgCurrent_1_4 m8243 : 40|32@1- (1,0) [-2147483648|2147483647] "mA"  Project
 SG_ FaultTrace_BatteryStatus_1_4 m8244 : 40|32@1+ (1,0) [0|4294967295] "Hex"  Project
 SG_ FaultTrace_PackStatus_1_4 m8245 : 40|16@1+ (1,0) [0|65535] "Hex"  Project
 SG_ FaultTrace_Event_Counter_2 m8448 : 40|32@1+ (1,0) [0|4294967295] "Time"  Project
 SG_ FaultTrace_AvgVol_2_1 m8449 : 40|16@1+ (1,0) [0|65535] "mV"  Project
 SG_ FaultTrace_MaxVol_2_1 m8449 : 56|16@1+ (1,0) [0|65535] "mV"  Project
 SG_ FaultTrace_MinVol_2_1 m8449 : 72|16@1+ (1,0) [0|65535] "mV"  Project
 SG_ FaultTrace_CellNumMax_2_1 m8450 : 40|8@1+ (1,0) [0|255] "Number"  Project
 SG_ FaultTrace_CellNumMin_2_1 m8450 : 48|8@1+ (1,0) [0|255] "Number"  Project
 SG_ FaultTrace_AvgCurrent_2_1 m8451 : 40|32@1- (1,0) [-2147483648|2147483647] "mA"  Project
 SG_ FaultTrace_BatteryStatus_2_1 m8452 : 40|32@1+ (1,0) [0|4294967295] "Hex"  Project
 SG_ FaultTrace_PackStatus_2_1 m8453 : 40|16@1+ (1,0) [0|65535] "Hex"  Project
 SG_ FaultTrace_AvgVol_2_2 m8465 : 40|16@1+ (1,0) [0|65535] "mV"  Project
 SG_ FaultTrace_MaxVol_2_2 m8465 : 56|16@1+ (1,0) [0|65535] "mV"  Project
 SG_ FaultTrace_MinVol_2_2 m8465 : 72|16@1+ (1,0) [0|65535] "mV"  Project
 SG_ FaultTrace_CellNumMax_2_2 m8466 : 40|8@1+ (1,0) [0|255] "Number"  Project
 SG_ FaultTrace_CellNumMin_2_2 m8466 : 48|8@1+ (1,0) [0|255] "Number"  Project
 SG_ FaultTrace_AvgCurrent_2_2 m8467 : 40|32@1- (1,0) [-2147483648|2147483647] "mA"  Project
 SG_ FaultTrace_BatteryStatus_2_2 m8468 : 40|32@1+ (1,0) [0|4294967295] "Hex"  Project
 SG_ FaultTrace_PackStatus_2_2 m8469 : 40|16@1+ (1,0) [0|65535] "Hex"  Project
 SG_ FaultTrace_AvgVol_2_3 m8481 : 40|16@1+ (1,0) [0|65535] "mV"  Project
 SG_ FaultTrace_MaxVol_2_3 m8481 : 56|16@1+ (1,0) [0|65535] "mV"  Project
 SG_ FaultTrace_MinVol_2_3 m8481 : 72|16@1+ (1,0) [0|65535] "mV"  Project
 SG_ FaultTrace_CellNumMax_2_3 m8482 : 40|8@1+ (1,0) [0|255] "Number"  Project
 SG_ FaultTrace_CellNumMin_2_3 m8482 : 48|8@1+ (1,0) [0|255] "Number"  Project
 SG_ FaultTrace_AvgCurrent_2_3 m8483 : 40|32@1- (1,0) [-2147483648|2147483647] "mA"  Project
 SG_ FaultTrace_BatteryStatus_2_3 m8484 : 40|32@1+ (1,0) [0|4294967295] "Hex"  Project
 SG_ FaultTrace_PackStatus_2_3 m8485 : 40|16@1+ (1,0) [0|65535] "Hex"  Project
 SG_ FaultTrace_AvgVol_2_4 m8497 : 40|16@1+ (1,0) [0|65535] "mV"  Project
 SG_ FaultTrace_MaxVol_2_4 m8497 : 56|16@1+ (1,0) [0|65535] "mV"  Project
 SG_ FaultTrace_MinVol_2_4 m8497 : 72|16@1+ (1,0) [0|65535] "mV"  Project
 SG_ FaultTrace_CellNumMax_2_4 m8498 : 40|8@1+ (1,0) [0|255] "Number"  Project
 SG_ FaultTrace_CellNumMin_2_4 m8498 : 48|8@1+ (1,0) [0|255] "Number"  Project
 SG_ FaultTrace_AvgCurrent_2_4 m8499 : 40|32@1- (1,0) [-2147483648|2147483647] "mA"  Project
 SG_ FaultTrace_BatteryStatus_2_4 m8500 : 40|32@1+ (1,0) [0|4294967295] "Hex"  Project
 SG_ FaultTrace_PackStatus_2_4 m8501 : 40|16@1+ (1,0) [0|65535] "Hex"  Project
 SG_ FaultTrace_Event_Counter_3 m8704 : 40|32@1+ (1,0) [0|4294967295] "Time"  Project
 SG_ FaultTrace_AvgVol_3_1 m8705 : 40|16@1+ (1,0) [0|65535] "mV"  Project
 SG_ FaultTrace_MaxVol_3_1 m8705 : 56|16@1+ (1,0) [0|65535] "mV"  Project
 SG_ FaultTrace_MinVol_3_1 m8705 : 72|16@1+ (1,0) [0|65535] "mV"  Project
 SG_ FaultTrace_CellNumMax_3_1 m8706 : 40|8@1+ (1,0) [0|255] "Number"  Project
 SG_ FaultTrace_CellNumMin_3_1 m8706 : 48|8@1+ (1,0) [0|255] "Number"  Project
 SG_ FaultTrace_AvgCurrent_3_1 m8707 : 40|32@1- (1,0) [-2147483648|2147483647] "mA"  Project
 SG_ FaultTrace_BatteryStatus_3_1 m8708 : 40|32@1+ (1,0) [0|4294967295] "Hex"  Project
 SG_ FaultTrace_PackStatus_3_1 m8709 : 40|16@1+ (1,0) [0|65535] "Hex"  Project
 SG_ FaultTrace_AvgVol_3_2 m8721 : 40|16@1+ (1,0) [0|65535] "mV"  Project
 SG_ FaultTrace_MaxVol_3_2 m8721 : 56|16@1+ (1,0) [0|65535] "mV"  Project
 SG_ FaultTrace_MinVol_3_2 m8721 : 72|16@1+ (1,0) [0|65535] "mV"  Project
 SG_ FaultTrace_CellNumMax_3_2 m8722 : 40|8@1+ (1,0) [0|255] "Number"  Project
 SG_ FaultTrace_CellNumMin_3_2 m8722 : 48|8@1+ (1,0) [0|255] "Number"  Project
 SG_ FaultTrace_AvgCurrent_3_2 m8723 : 40|32@1- (1,0) [-2147483648|2147483647] "mA"  Project
 SG_ FaultTrace_BatteryStatus_3_2 m8724 : 40|32@1+ (1,0) [0|4294967295] "Hex"  Project
 SG_ FaultTrace_PackStatus_3_2 m8725 : 40|16@1+ (1,0) [0|65535] "Hex"  Project
 SG_ FaultTrace_AvgVol_3_3 m8737 : 40|16@1+ (1,0) [0|65535] "mV"  Project
 SG_ FaultTrace_MaxVol_3_3 m8737 : 56|16@1+ (1,0) [0|65535] "mV"  Project
 SG_ FaultTrace_MinVol_3_3 m8737 : 72|16@1+ (1,0) [0|65535] "mV"  Project
 SG_ FaultTrace_CellNumMax_3_3 m8738 : 40|8@1+ (1,0) [0|255] "Number"  Project
 SG_ FaultTrace_CellNumMin_3_3 m8738 : 48|8@1+ (1,0) [0|255] "Number"  Project
 SG_ FaultTrace_AvgCurrent_3_3 m8739 : 40|32@1- (1,0) [-2147483648|2147483647] "mA"  Project
 SG_ FaultTrace_BatteryStatus_3_3 m8740 : 40|32@1+ (1,0) [0|4294967295] "Hex"  Project
 SG_ FaultTrace_PackStatus_3_3 m8741 : 40|16@1+ (1,0) [0|65535] "Hex"  Project
 SG_ FaultTrace_AvgVol_3_4 m8753 : 40|16@1+ (1,0) [0|65535] "mV"  Project
 SG_ FaultTrace_MaxVol_3_4 m8753 : 56|16@1+ (1,0) [0|65535] "mV"  Project
 SG_ FaultTrace_MinVol_3_4 m8753 : 72|16@1+ (1,0) [0|65535] "mV"  Project
 SG_ FaultTrace_CellNumMax_3_4 m8754 : 40|8@1+ (1,0) [0|255] "Number"  Project
 SG_ FaultTrace_CellNumMin_3_4 m8754 : 48|8@1+ (1,0) [0|255] "Number"  Project
 SG_ FaultTrace_AvgCurrent_3_4 m8755 : 40|32@1- (1,0) [-2147483648|2147483647] "mA"  Project
 SG_ FaultTrace_BatteryStatus_3_4 m8756 : 40|32@1+ (1,0) [0|4294967295] "Hex"  Project
 SG_ FaultTrace_PackStatus_3_4 m8757 : 40|16@1+ (1,0) [0|65535] "Hex"  Project
 SG_ FaultTrace_Event_Counter_4 m8960 : 40|32@1+ (1,0) [0|4294967295] "Time"  Project
 SG_ FaultTrace_AvgVol_4_1 m8961 : 40|16@1+ (1,0) [0|65535] "mV"  Project
 SG_ FaultTrace_MaxVol_4_1 m8961 : 56|16@1+ (1,0) [0|65535] "mV"  Project
 SG_ FaultTrace_MinVol_4_1 m8961 : 72|16@1+ (1,0) [0|65535] "mV"  Project
 SG_ FaultTrace_CellNumMax_4_1 m8962 : 40|8@1+ (1,0) [0|255] "Number"  Project
 SG_ FaultTrace_CellNumMin_4_1 m8962 : 48|8@1+ (1,0) [0|255] "Number"  Project
 SG_ FaultTrace_AvgCurrent_4_1 m8963 : 40|32@1- (1,0) [-2147483648|2147483647] "mA"  Project
 SG_ FaultTrace_BatteryStatus_4_1 m8964 : 40|32@1+ (1,0) [0|4294967295] "Hex"  Project
 SG_ FaultTrace_PackStatus_4_1 m8965 : 40|16@1+ (1,0) [0|65535] "Hex"  Project
 SG_ FaultTrace_AvgVol_4_2 m8977 : 40|16@1+ (1,0) [0|65535] "mV"  Project
 SG_ FaultTrace_MaxVol_4_2 m8977 : 56|16@1+ (1,0) [0|65535] "mV"  Project
 SG_ FaultTrace_MinVol_4_2 m8977 : 72|16@1+ (1,0) [0|65535] "mV"  Project
 SG_ FaultTrace_CellNumMax_4_2 m8978 : 40|8@1+ (1,0) [0|255] "Number"  Project
 SG_ FaultTrace_CellNumMin_4_2 m8978 : 48|8@1+ (1,0) [0|255] "Number"  Project
 SG_ FaultTrace_AvgCurrent_4_2 m8979 : 40|32@1- (1,0) [-2147483648|2147483647] "mA"  Project
 SG_ FaultTrace_BatteryStatus_4_2 m8980 : 40|32@1+ (1,0) [0|4294967295] "Hex"  Project
 SG_ FaultTrace_PackStatus_4_2 m8981 : 40|16@1+ (1,0) [0|65535] "Hex"  Project
 SG_ FaultTrace_AvgVol_4_3 m8993 : 40|16@1+ (1,0) [0|65535] "mV"  Project
 SG_ FaultTrace_MaxVol_4_3 m8993 : 56|16@1+ (1,0) [0|65535] "mV"  Project
 SG_ FaultTrace_MinVol_4_3 m8993 : 72|16@1+ (1,0) [0|65535] "mV"  Project
 SG_ FaultTrace_CellNumMax_4_3 m8994 : 40|8@1+ (1,0) [0|255] "Number"  Project
 SG_ FaultTrace_CellNumMin_4_3 m8994 : 48|8@1+ (1,0) [0|255] "Number"  Project
 SG_ FaultTrace_AvgCurrent_4_3 m8995 : 40|32@1- (1,0) [-2147483648|2147483647] "mA"  Project
 SG_ FaultTrace_BatteryStatus_4_3 m8996 : 40|32@1+ (1,0) [0|4294967295] "Hex"  Project
 SG_ FaultTrace_PackStatus_4_3 m8997 : 40|16@1+ (1,0) [0|65535] "Hex"  Project
 SG_ FaultTrace_AvgVol_4_4 m9009 : 40|16@1+ (1,0) [0|65535] "mV"  Project
 SG_ FaultTrace_MaxVol_4_4 m9009 : 56|16@1+ (1,0) [0|65535] "mV"  Project
 SG_ FaultTrace_MinVol_4_4 m9009 : 72|16@1+ (1,0) [0|65535] "mV"  Project
 SG_ FaultTrace_CellNumMax_4_4 m9010 : 40|8@1+ (1,0) [0|255] "Number"  Project
 SG_ FaultTrace_CellNumMin_4_4 m9010 : 48|8@1+ (1,0) [0|255] "Number"  Project
 SG_ FaultTrace_AvgCurrent_4_4 m9011 : 40|32@1- (1,0) [-2147483648|2147483647] "mA"  Project
 SG_ FaultTrace_BatteryStatus_4_4 m9012 : 40|32@1+ (1,0) [0|4294967295] "Hex"  Project
 SG_ FaultTrace_PackStatus_4_4 m9013 : 40|16@1+ (1,0) [0|65535] "Hex"  Project
BO_ 1885 Reprogramhty: 8 test
 SG_ Reprogramhty_command M : 24|16@1+ (1,0) [0|65535] ""  Project
 SG_ Reprogramhty_BefFWVer1 m0 : 40|24@1+ (1,0) [0|16777215] "Hex"  Project
 SG_ Reprogramhty_AftFWVer1 m0 : 64|24@1+ (1,0) [0|16777215] "Hex"  Project
 SG_ Reprogramhty_UsTStamp1 m1 : 40|32@1+ (1,0) [0|4294967295] "DateTime"  Project
 SG_ Reprogramhty_ProductID1 m2 : 40|16@1+ (1,0) [0|65535] "Hex"  Project
 SG_ Reprogramhty_DiagVer1 m2 : 56|16@1+ (1,0) [0|65535] "Hex"  Project
 SG_ Reprogramhty_UIVer1 m2 : 72|16@1+ (1,0) [0|65535] "Hex"  Project
 SG_ Reprogramhty_BoTStamp1 m3 : 40|32@1+ (1,0) [0|4294967295] "DateTime"  Project
 SG_ Reprogramhty_BoRetTime1 m3 : 72|8@1+ (1,0) [0|255] "Times"  Project
 SG_ Reprogramhty_BefFWVer2 m16 : 40|24@1+ (1,0) [0|16777215] "Hex"  Project
 SG_ Reprogramhty_AftFWVer2 m16 : 64|24@1+ (1,0) [0|16777215] "Hex"  Project
 SG_ Reprogramhty_UsTStamp2 m17 : 40|32@1+ (1,0) [0|4294967295] "DateTime"  Project
 SG_ Reprogramhty_ProductID2 m18 : 40|16@1+ (1,0) [0|65535] "Hex"  Project
 SG_ Reprogramhty_DiagVer2 m18 : 56|16@1+ (1,0) [0|65535] "Hex"  Project
 SG_ Reprogramhty_UIVer2 m18 : 72|16@1+ (1,0) [0|65535] "Hex"  Project
 SG_ Reprogramhty_BoTStamp2 m19 : 40|32@1+ (1,0) [0|4294967295] "DateTime"  Project
 SG_ Reprogramhty_BoRetTime2 m19 : 72|8@1+ (1,0) [0|255] "Times"  Project
 SG_ Reprogramhty_BefFWVer3 m32 : 40|24@1+ (1,0) [0|16777215] "Hex"  Project
 SG_ Reprogramhty_AftFWVer3 m32 : 64|24@1+ (1,0) [0|16777215] "Hex"  Project
 SG_ Reprogramhty_UsTStamp3 m33 : 40|32@1+ (1,0) [0|4294967295] "DateTime"  Project
 SG_ Reprogramhty_ProductID3 m34 : 40|16@1+ (1,0) [0|65535] "Hex"  Project
 SG_ Reprogramhty_DiagVer3 m34 : 56|16@1+ (1,0) [0|65535] "Hex"  Project
 SG_ Reprogramhty_UIVer3 m34 : 72|16@1+ (1,0) [0|65535] "Hex"  Project
 SG_ Reprogramhty_BoTStamp3 m35 : 40|32@1+ (1,0) [0|4294967295] "DateTime"  Project
 SG_ Reprogramhty_BoRetTime3 m35 : 72|8@1+ (1,0) [0|255] "Times"  Project
 SG_ Reprogramhty_BefFWVer4 m48 : 40|24@1+ (1,0) [0|16777215] "Hex"  Project
 SG_ Reprogramhty_AftFWVer4 m48 : 64|24@1+ (1,0) [0|16777215] "Hex"  Project
 SG_ Reprogramhty_UsTStamp4 m49 : 40|32@1+ (1,0) [0|4294967295] "DateTime"  Project
 SG_ Reprogramhty_ProductID4 m50 : 40|16@1+ (1,0) [0|65535] "Hex"  Project
 SG_ Reprogramhty_DiagVer4 m50 : 56|16@1+ (1,0) [0|65535] "Hex"  Project
 SG_ Reprogramhty_UIVer4 m50 : 72|16@1+ (1,0) [0|65535] "Hex"  Project
 SG_ Reprogramhty_BoTStamp4 m51 : 40|32@1+ (1,0) [0|4294967295] "DateTime"  Project
 SG_ Reprogramhty_BoRetTime4 m51 : 72|8@1+ (1,0) [0|255] "Times"  Project
 SG_ Reprogramhty_BefFWVer5 m64 : 40|24@1+ (1,0) [0|16777215] "Hex"  Project
 SG_ Reprogramhty_AftFWVer5 m64 : 64|24@1+ (1,0) [0|16777215] "Hex"  Project
 SG_ Reprogramhty_UsTStamp5 m65 : 40|32@1+ (1,0) [0|4294967295] "DateTime"  Project
 SG_ Reprogramhty_ProductID5 m66 : 40|16@1+ (1,0) [0|65535] "Hex"  Project
 SG_ Reprogramhty_DiagVer5 m66 : 56|16@1+ (1,0) [0|65535] "Hex"  Project
 SG_ Reprogramhty_UIVer5 m66 : 72|16@1+ (1,0) [0|65535] "Hex"  Project
 SG_ Reprogramhty_BoTStamp5 m67 : 40|32@1+ (1,0) [0|4294967295] "DateTime"  Project
 SG_ Reprogramhty_BoRetTime5 m67 : 72|8@1+ (1,0) [0|255] "Times"  Project
BO_ 1883 FaultLog: 8 test
 SG_ FaultLog_command M : 24|16@1+ (1,0) [0|65535] ""  Project
 SG_ FaultLog_OVPCnt m0 : 40|8@1+ (1,0) [0|255] "Time"  Project
 SG_ FaultLog_UVPCnt m1 : 40|8@1+ (1,0) [0|255] "Time"  Project
 SG_ FaultLog_COTCnt m2 : 40|8@1+ (1,0) [0|255] "Time"  Project
 SG_ FaultLog_CUTCnt m3 : 40|8@1+ (1,0) [0|255] "Time"  Project
 SG_ FaultLog_DOTCnt m4 : 40|8@1+ (1,0) [0|255] "Time"  Project
 SG_ FaultLog_DUTCnt m5 : 40|8@1+ (1,0) [0|255] "Time"  Project
 SG_ FaultLog_AFE_DOCCnt m6 : 40|8@1+ (1,0) [0|255] "Time"  Project
 SG_ FaultLog_AFE_COCCnt m7 : 40|8@1+ (1,0) [0|255] "Time"  Project
 SG_ FaultLog_DOCCnt m8 : 40|8@1+ (1,0) [0|255] "Time"  Project
 SG_ FaultLog_COCCnt m9 : 40|8@1+ (1,0) [0|255] "Time"  Project
 SG_ FaultLog_ChargerAuthFCnt m10 : 40|8@1+ (1,0) [0|255] "Time"  Project
 SG_ FaultLog_ChargerOTPCnt m11 : 40|8@1+ (1,0) [0|255] "Time"  Project
 SG_ FaultLog_ChargerOVPCnt m12 : 40|8@1+ (1,0) [0|255] "Time"  Project
 SG_ FaultLog_MOSOTUTP_Cnt m13 : 40|8@1+ (1,0) [0|255] "Time"  Project
 SG_ FaultLog_AFECFCnt m14 : 40|8@1+ (1,0) [0|255] "Time"  Project
 SG_ FaultLog_SD_FailCnt m15 : 40|8@1+ (1,0) [0|255] "Time"  Project
 SG_ FaultLog_SS2_HWSCP_Cnt m16 : 40|8@1+ (1,0) [0|255] "Time"  Project
 SG_ FaultLog_SS2_UVPCMOS_Cnt m17 : 40|8@1+ (1,0) [0|255] "Time"  Project
 SG_ FaultLog_SS2_PDSGF_Cnt m18 : 40|8@1+ (1,0) [0|255] "Time"  Project
 SG_ FaultLog_MaxCellVolt m32 : 40|16@1+ (1,0) [0|65535] "mV"  Project
 SG_ FaultLog_MinCellVolt m33 : 40|16@1+ (1,0) [0|65535] "mV"  Project
 SG_ FaultLog_MaxChgTemp m34 : 40|16@1- (0.1,0) [-3276.8|3276.7] "DegC"  Project
 SG_ FaultLog_MinChgTemp m35 : 40|16@1- (0.1,0) [-3276.8|3276.7] "DegC"  Project
 SG_ FaultLog_MaxDsgTemp m36 : 40|16@1- (0.1,0) [-3276.8|3276.7] "DegC"  Project
 SG_ FaultLog_MinDsgTemp m37 : 40|16@1- (0.1,0) [-3276.8|3276.7] "DegC"  Project
 SG_ FaultLog_MaxChgCurrent m38 : 40|32@1- (1,0) [-2147483648|2147483647] "mA"  Project
 SG_ FaultLog_MaxDsgCurrent m39 : 40|32@1- (1,0) [-2147483648|2147483647] "mA"  Project
 SG_ FaultLog_MAXCellVoltTime m48 : 40|32@1+ (1,0) [0|4294967295] "DateTime"  Project
 SG_ FaultLog_MINCellVoltTime m49 : 40|32@1+ (1,0) [0|4294967295] "DateTime"  Project
 SG_ FaultLog_MaxChgTempTime m50 : 40|32@1+ (1,0) [0|4294967295] "DateTime"  Project
 SG_ FaultLog_MinChgTempTime m51 : 40|32@1+ (1,0) [0|4294967295] "DateTime"  Project
 SG_ FaultLog_MaxDsgTempTime m52 : 40|32@1+ (1,0) [0|4294967295] "DateTime"  Project
 SG_ FaultLog_MinDsgTempTime m53 : 40|32@1+ (1,0) [0|4294967295] "DateTime"  Project
 SG_ FaultLog_MaxChgCurrentTime m54 : 40|32@1+ (1,0) [0|4294967295] "DateTime"  Project
 SG_ FaultLog_MaxDsgCurrentTime m55 : 40|32@1+ (1,0) [0|4294967295] "DateTime"  Project
 SG_ FaultLog_PFStatus m64 : 40|16@1+ (1,0) [0|65535] "Hex"  Project
 SG_ FaultLog_SafetyStatus2 m65 : 40|8@1+ (1,0) [0|255] "Hex"  Project
 SG_ FaultLog_Event_Counter m66 : 40|32@1+ (1,0) [0|4294967295] "Time"  Project
 SG_ FaultLog_FW_Version m67 : 40|16@1+ (1,0) [0|65535] "Hex"  Project
 SG_ FaultLog_WarnOVPCnt m80 : 40|8@1+ (1,0) [0|255] "Time"  Project
 SG_ FaultLog_WarnOVP_Vcell1 m81 : 40|16@1+ (1,0) [0|65535] "mV"  Project
 SG_ FaultLog_WarnOVP_Vcell2 m81 : 56|16@1+ (1,0) [0|65535] "mV"  Project
 SG_ FaultLog_WarnOVP_Vcell3 m81 : 72|16@1+ (1,0) [0|65535] "mV"  Project
 SG_ FaultLog_WarnOVP_Vcell4 m82 : 40|16@1+ (1,0) [0|65535] "mV"  Project
 SG_ FaultLog_WarnOVP_Vcell5 m82 : 56|16@1+ (1,0) [0|65535] "mV"  Project
 SG_ FaultLog_WarnOVP_Vcell6 m82 : 72|16@1+ (1,0) [0|65535] "mV"  Project
 SG_ FaultLog_WarnOVP_Vcell7 m83 : 40|16@1+ (1,0) [0|65535] "mV"  Project
 SG_ FaultLog_WarnOVP_Vcell8 m83 : 56|16@1+ (1,0) [0|65535] "mV"  Project
 SG_ FaultLog_WarnOVP_Vcell9 m83 : 72|16@1+ (1,0) [0|65535] "mV"  Project
 SG_ FaultLog_WarnOVP_Vcell10 m84 : 40|16@1+ (1,0) [0|65535] "mV"  Project
 SG_ FaultLog_WarnOVP_Vcell11 m84 : 56|16@1+ (1,0) [0|65535] "mV"  Project
 SG_ FaultLog_WarnOVP_Vcell12 m84 : 72|16@1+ (1,0) [0|65535] "mV"  Project
 SG_ FaultLog_WarnOVP_Vcell13 m85 : 40|16@1+ (1,0) [0|65535] "mV"  Project
 SG_ FaultLog_WarnOVP_Vcell14 m85 : 56|16@1+ (1,0) [0|65535] "mV"  Project
 SG_ FaultLog_WarnOVP_Vcell15 m85 : 72|16@1+ (1,0) [0|65535] "mV"  Project
 SG_ FaultLog_WarnOVP_Vcell16 m86 : 40|16@1+ (1,0) [0|65535] "mV"  Project
 SG_ FaultLogTime_ROM_1 m512 : 40|32@1+ (1,0) [0|4294967295] "DateTime"  Project
 SG_ Event_Counter_ROM_1 m513 : 40|32@1+ (1,0) [0|4294967295] "Time"  Project
 SG_ FW_Ver_ROM_1 m514 : 40|16@1+ (1,0) [0|65535] "Ver"  Project
 SG_ BatteryStatus_ROM_1 m515 : 40|16@1+ (1,0) [0|65535] "Hex"  Project
 SG_ SafetyStatus_ROM_1 m516 : 40|16@1+ (1,0) [0|65535] "Hex"  Project
 SG_ PackStatus_ROM_1 m517 : 40|16@1+ (1,0) [0|65535] "Hex"  Project
 SG_ PFStatus_ROM_1 m518 : 40|16@1+ (1,0) [0|65535] "Hex"  Project
 SG_ SafetyStatus2_ROM_1 m519 : 40|8@1+ (1,0) [0|255] "Hex"  Project
 SG_ Current_ROM_1 m520 : 40|32@1- (1,0) [-2147483648|2147483647] "mA"  Project
 SG_ CellVolt1_ROM_1 m521 : 40|16@1+ (1,0) [0|65535] "mV"  Project
 SG_ CellVolt2_ROM_1 m521 : 56|16@1+ (1,0) [0|65535] "mV"  Project
 SG_ CellVolt3_ROM_1 m521 : 72|16@1+ (1,0) [0|65535] "mV"  Project
 SG_ CellVolt4_ROM_1 m522 : 40|16@1+ (1,0) [0|65535] "mV"  Project
 SG_ CellVolt5_ROM_1 m522 : 56|16@1+ (1,0) [0|65535] "mV"  Project
 SG_ CellVolt6_ROM_1 m522 : 72|16@1+ (1,0) [0|65535] "mV"  Project
 SG_ CellVolt7_ROM_1 m523 : 40|16@1+ (1,0) [0|65535] "mV"  Project
 SG_ CellVolt8_ROM_1 m523 : 56|16@1+ (1,0) [0|65535] "mV"  Project
 SG_ CellVolt9_ROM_1 m523 : 72|16@1+ (1,0) [0|65535] "mV"  Project
 SG_ CellVolt10_ROM_1 m524 : 40|16@1+ (1,0) [0|65535] "mV"  Project
 SG_ CellVolt11_ROM_1 m524 : 56|16@1+ (1,0) [0|65535] "mV"  Project
 SG_ CellVolt12_ROM_1 m524 : 72|16@1+ (1,0) [0|65535] "mV"  Project
 SG_ CellVolt13_ROM_1 m525 : 40|16@1+ (1,0) [0|65535] "mV"  Project
 SG_ CellVolt14_ROM_1 m525 : 56|16@1+ (1,0) [0|65535] "mV"  Project
 SG_ CellVolt15_ROM_1 m525 : 72|16@1+ (1,0) [0|65535] "mV"  Project
 SG_ CellVolt16_ROM_1 m526 : 40|16@1+ (1,0) [0|65535] "mV"  Project
 SG_ Temp1_ROM_1 m527 : 40|16@1- (0.1,0) [-3276.8|3276.7] "DegC"  Project
 SG_ Temp2_ROM_1 m527 : 56|16@1- (0.1,0) [-3276.8|3276.7] "DegC"  Project
 SG_ Temp3_ROM_1 m527 : 72|16@1- (0.1,0) [-3276.8|3276.7] "DegC"  Project
 SG_ TimeOfCurrentCharge_ROM_1 m528 : 40|32@1+ (1,0) [0|4294967295] "DateTime"  Project
 SG_ RSOC_ROM_1 m528 : 72|8@1+ (1,0) [0|255] "%"  Project
 SG_ SafetyTemp_ROM_1 m529 : 40|16@1- (0.1,0) [-3276.8|3276.7] "DegC"  Project
 SG_ FaultLogTime_ROM_2 m640 : 40|32@1+ (1,0) [0|4294967295] "DateTime"  Project
 SG_ Event_Counter_ROM_2 m641 : 40|32@1+ (1,0) [0|4294967295] "Time"  Project
 SG_ FW_Ver_ROM_2 m642 : 40|16@1+ (1,0) [0|65535] "Ver"  Project
 SG_ BatteryStatus_ROM_2 m643 : 40|16@1+ (1,0) [0|65535] "Hex"  Project
 SG_ SafetyStatus_ROM_2 m644 : 40|16@1+ (1,0) [0|65535] "Hex"  Project
 SG_ PackStatus_ROM_2 m645 : 40|16@1+ (1,0) [0|65535] "Hex"  Project
 SG_ PFStatus_ROM_2 m646 : 40|16@1+ (1,0) [0|65535] "Hex"  Project
 SG_ SafetyStatus2_ROM_2 m647 : 40|8@1+ (1,0) [0|255] "Hex"  Project
 SG_ Current_ROM_2 m648 : 40|32@1- (1,0) [-2147483648|2147483647] "mA"  Project
 SG_ CellVolt1_ROM_2 m649 : 40|16@1+ (1,0) [0|65535] "mV"  Project
 SG_ CellVolt2_ROM_2 m649 : 56|16@1+ (1,0) [0|65535] "mV"  Project
 SG_ CellVolt3_ROM_2 m649 : 72|16@1+ (1,0) [0|65535] "mV"  Project
 SG_ CellVolt4_ROM_2 m650 : 40|16@1+ (1,0) [0|65535] "mV"  Project
 SG_ CellVolt5_ROM_2 m650 : 56|16@1+ (1,0) [0|65535] "mV"  Project
 SG_ CellVolt6_ROM_2 m650 : 72|16@1+ (1,0) [0|65535] "mV"  Project
 SG_ CellVolt7_ROM_2 m651 : 40|16@1+ (1,0) [0|65535] "mV"  Project
 SG_ CellVolt8_ROM_2 m651 : 56|16@1+ (1,0) [0|65535] "mV"  Project
 SG_ CellVolt9_ROM_2 m651 : 72|16@1+ (1,0) [0|65535] "mV"  Project
 SG_ CellVolt10_ROM_2 m652 : 40|16@1+ (1,0) [0|65535] "mV"  Project
 SG_ CellVolt11_ROM_2 m652 : 56|16@1+ (1,0) [0|65535] "mV"  Project
 SG_ CellVolt12_ROM_2 m652 : 72|16@1+ (1,0) [0|65535] "mV"  Project
 SG_ CellVolt13_ROM_2 m653 : 40|16@1+ (1,0) [0|65535] "mV"  Project
 SG_ CellVolt14_ROM_2 m653 : 56|16@1+ (1,0) [0|65535] "mV"  Project
 SG_ CellVolt15_ROM_2 m653 : 72|16@1+ (1,0) [0|65535] "mV"  Project
 SG_ CellVolt16_ROM_2 m654 : 40|16@1+ (1,0) [0|65535] "mV"  Project
 SG_ Temp1_ROM_2 m655 : 40|16@1- (0.1,0) [-3276.8|3276.7] "DegC"  Project
 SG_ Temp2_ROM_2 m655 : 56|16@1- (0.1,0) [-3276.8|3276.7] "DegC"  Project
 SG_ Temp3_ROM_2 m655 : 72|16@1- (0.1,0) [-3276.8|3276.7] "DegC"  Project
 SG_ TimeOfCurrentCharge_ROM_2 m656 : 40|32@1+ (1,0) [0|4294967295] "DateTime"  Project
 SG_ RSOC_ROM_2 m656 : 72|8@1+ (1,0) [0|255] "%"  Project
 SG_ SafetyTemp_ROM_2 m657 : 40|16@1- (0.1,0) [-3276.8|3276.7] "DegC"  Project
 SG_ FaultLogTime_ROM_3 m768 : 40|32@1+ (1,0) [0|4294967295] "DateTime"  Project
 SG_ Event_Counter_ROM_3 m769 : 40|32@1+ (1,0) [0|4294967295] "Time"  Project
 SG_ FW_Ver_ROM_3 m770 : 40|16@1+ (1,0) [0|65535] "Ver"  Project
 SG_ BatteryStatus_ROM_3 m771 : 40|16@1+ (1,0) [0|65535] "Hex"  Project
 SG_ SafetyStatus_ROM_3 m772 : 40|16@1+ (1,0) [0|65535] "Hex"  Project
 SG_ PackStatus_ROM_3 m773 : 40|16@1+ (1,0) [0|65535] "Hex"  Project
 SG_ PFStatus_ROM_3 m774 : 40|16@1+ (1,0) [0|65535] "Hex"  Project
 SG_ SafetyStatus2_ROM_3 m775 : 40|8@1+ (1,0) [0|255] "Hex"  Project
 SG_ Current_ROM_3 m776 : 40|32@1- (1,0) [-2147483648|2147483647] "mA"  Project
 SG_ CellVolt1_ROM_3 m777 : 40|16@1+ (1,0) [0|65535] "mV"  Project
 SG_ CellVolt2_ROM_3 m777 : 56|16@1+ (1,0) [0|65535] "mV"  Project
 SG_ CellVolt3_ROM_3 m777 : 72|16@1+ (1,0) [0|65535] "mV"  Project
 SG_ CellVolt4_ROM_3 m778 : 40|16@1+ (1,0) [0|65535] "mV"  Project
 SG_ CellVolt5_ROM_3 m778 : 56|16@1+ (1,0) [0|65535] "mV"  Project
 SG_ CellVolt6_ROM_3 m778 : 72|16@1+ (1,0) [0|65535] "mV"  Project
 SG_ CellVolt7_ROM_3 m779 : 40|16@1+ (1,0) [0|65535] "mV"  Project
 SG_ CellVolt8_ROM_3 m779 : 56|16@1+ (1,0) [0|65535] "mV"  Project
 SG_ CellVolt9_ROM_3 m779 : 72|16@1+ (1,0) [0|65535] "mV"  Project
 SG_ CellVolt10_ROM_3 m780 : 40|16@1+ (1,0) [0|65535] "mV"  Project
 SG_ CellVolt11_ROM_3 m780 : 56|16@1+ (1,0) [0|65535] "mV"  Project
 SG_ CellVolt12_ROM_3 m780 : 72|16@1+ (1,0) [0|65535] "mV"  Project
 SG_ CellVolt13_ROM_3 m781 : 40|16@1+ (1,0) [0|65535] "mV"  Project
 SG_ CellVolt14_ROM_3 m781 : 56|16@1+ (1,0) [0|65535] "mV"  Project
 SG_ CellVolt15_ROM_3 m781 : 72|16@1+ (1,0) [0|65535] "mV"  Project
 SG_ CellVolt16_ROM_3 m782 : 40|16@1+ (1,0) [0|65535] "mV"  Project
 SG_ Temp1_ROM_3 m783 : 40|16@1- (0.1,0) [-3276.8|3276.7] "DegC"  Project
 SG_ Temp2_ROM_3 m783 : 56|16@1- (0.1,0) [-3276.8|3276.7] "DegC"  Project
 SG_ Temp3_ROM_3 m783 : 72|16@1- (0.1,0) [-3276.8|3276.7] "DegC"  Project
 SG_ TimeOfCurrentCharge_ROM_3 m784 : 40|32@1+ (1,0) [0|4294967295] "DateTime"  Project
 SG_ RSOC_ROM_3 m784 : 72|8@1+ (1,0) [0|255] "%"  Project
 SG_ SafetyTemp_ROM_3 m785 : 40|16@1- (0.1,0) [-3276.8|3276.7] "DegC"  Project
 SG_ FaultLogTime_ROM_4 m896 : 40|32@1+ (1,0) [0|4294967295] "DateTime"  Project
 SG_ Event_Counter_ROM_4 m897 : 40|32@1+ (1,0) [0|4294967295] "Time"  Project
 SG_ FW_Ver_ROM_4 m898 : 40|16@1+ (1,0) [0|65535] "Ver"  Project
 SG_ BatteryStatus_ROM_4 m899 : 40|16@1+ (1,0) [0|65535] "Hex"  Project
 SG_ SafetyStatus_ROM_4 m900 : 40|16@1+ (1,0) [0|65535] "Hex"  Project
 SG_ PackStatus_ROM_4 m901 : 40|16@1+ (1,0) [0|65535] "Hex"  Project
 SG_ PFStatus_ROM_4 m902 : 40|16@1+ (1,0) [0|65535] "Hex"  Project
 SG_ SafetyStatus2_ROM_4 m903 : 40|8@1+ (1,0) [0|255] "Hex"  Project
 SG_ Current_ROM_4 m904 : 40|32@1- (1,0) [-2147483648|2147483647] "mA"  Project
 SG_ CellVolt1_ROM_4 m905 : 40|16@1+ (1,0) [0|65535] "mV"  Project
 SG_ CellVolt2_ROM_4 m905 : 56|16@1+ (1,0) [0|65535] "mV"  Project
 SG_ CellVolt3_ROM_4 m905 : 72|16@1+ (1,0) [0|65535] "mV"  Project
 SG_ CellVolt4_ROM_4 m906 : 40|16@1+ (1,0) [0|65535] "mV"  Project
 SG_ CellVolt5_ROM_4 m906 : 56|16@1+ (1,0) [0|65535] "mV"  Project
 SG_ CellVolt6_ROM_4 m906 : 72|16@1+ (1,0) [0|65535] "mV"  Project
 SG_ CellVolt7_ROM_4 m907 : 40|16@1+ (1,0) [0|65535] "mV"  Project
 SG_ CellVolt8_ROM_4 m907 : 56|16@1+ (1,0) [0|65535] "mV"  Project
 SG_ CellVolt9_ROM_4 m907 : 72|16@1+ (1,0) [0|65535] "mV"  Project
 SG_ CellVolt10_ROM_4 m908 : 40|16@1+ (1,0) [0|65535] "mV"  Project
 SG_ CellVolt11_ROM_4 m908 : 56|16@1+ (1,0) [0|65535] "mV"  Project
 SG_ CellVolt12_ROM_4 m908 : 72|16@1+ (1,0) [0|65535] "mV"  Project
 SG_ CellVolt13_ROM_4 m909 : 40|16@1+ (1,0) [0|65535] "mV"  Project
 SG_ CellVolt14_ROM_4 m909 : 56|16@1+ (1,0) [0|65535] "mV"  Project
 SG_ CellVolt15_ROM_4 m909 : 72|16@1+ (1,0) [0|65535] "mV"  Project
 SG_ CellVolt16_ROM_4 m910 : 40|16@1+ (1,0) [0|65535] "mV"  Project
 SG_ Temp1_ROM_4 m911 : 40|16@1- (0.1,0) [-3276.8|3276.7] "DegC"  Project
 SG_ Temp2_ROM_4 m911 : 56|16@1- (0.1,0) [-3276.8|3276.7] "DegC"  Project
 SG_ Temp3_ROM_4 m911 : 72|16@1- (0.1,0) [-3276.8|3276.7] "DegC"  Project
 SG_ TimeOfCurrentCharge_ROM_4 m912 : 40|32@1+ (1,0) [0|4294967295] "DateTime"  Project
 SG_ RSOC_ROM_4 m912 : 72|8@1+ (1,0) [0|255] "%"  Project
 SG_ SafetyTemp_ROM_4 m913 : 40|16@1- (0.1,0) [-3276.8|3276.7] "DegC"  Project
 SG_ FaultLogTime_ROM_5 m1024 : 40|32@1+ (1,0) [0|4294967295] "DateTime"  Project
 SG_ Event_Counter_ROM_5 m1025 : 40|32@1+ (1,0) [0|4294967295] "Time"  Project
 SG_ FW_Ver_ROM_5 m1026 : 40|16@1+ (1,0) [0|65535] "Ver"  Project
 SG_ BatteryStatus_ROM_5 m1027 : 40|16@1+ (1,0) [0|65535] "Hex"  Project
 SG_ SafetyStatus_ROM_5 m1028 : 40|16@1+ (1,0) [0|65535] "Hex"  Project
 SG_ PackStatus_ROM_5 m1029 : 40|16@1+ (1,0) [0|65535] "Hex"  Project
 SG_ PFStatus_ROM_5 m1030 : 40|16@1+ (1,0) [0|65535] "Hex"  Project
 SG_ SafetyStatus2_ROM_5 m1031 : 40|8@1+ (1,0) [0|255] "Hex"  Project
 SG_ Current_ROM_5 m1032 : 40|32@1- (1,0) [-2147483648|2147483647] "mA"  Project
 SG_ CellVolt1_ROM_5 m1033 : 40|16@1+ (1,0) [0|65535] "mV"  Project
 SG_ CellVolt2_ROM_5 m1033 : 56|16@1+ (1,0) [0|65535] "mV"  Project
 SG_ CellVolt3_ROM_5 m1033 : 72|16@1+ (1,0) [0|65535] "mV"  Project
 SG_ CellVolt4_ROM_5 m1034 : 40|16@1+ (1,0) [0|65535] "mV"  Project
 SG_ CellVolt5_ROM_5 m1034 : 56|16@1+ (1,0) [0|65535] "mV"  Project
 SG_ CellVolt6_ROM_5 m1034 : 72|16@1+ (1,0) [0|65535] "mV"  Project
 SG_ CellVolt7_ROM_5 m1035 : 40|16@1+ (1,0) [0|65535] "mV"  Project
 SG_ CellVolt8_ROM_5 m1035 : 56|16@1+ (1,0) [0|65535] "mV"  Project
 SG_ CellVolt9_ROM_5 m1035 : 72|16@1+ (1,0) [0|65535] "mV"  Project
 SG_ CellVolt10_ROM_5 m1036 : 40|16@1+ (1,0) [0|65535] "mV"  Project
 SG_ CellVolt11_ROM_5 m1036 : 56|16@1+ (1,0) [0|65535] "mV"  Project
 SG_ CellVolt12_ROM_5 m1036 : 72|16@1+ (1,0) [0|65535] "mV"  Project
 SG_ CellVolt13_ROM_5 m1037 : 40|16@1+ (1,0) [0|65535] "mV"  Project
 SG_ CellVolt14_ROM_5 m1037 : 56|16@1+ (1,0) [0|65535] "mV"  Project
 SG_ CellVolt15_ROM_5 m1037 : 72|16@1+ (1,0) [0|65535] "mV"  Project
 SG_ CellVolt16_ROM_5 m1038 : 40|16@1+ (1,0) [0|65535] "mV"  Project
 SG_ Temp1_ROM_5 m1039 : 40|16@1- (0.1,0) [-3276.8|3276.7] "DegC"  Project
 SG_ Temp2_ROM_5 m1039 : 56|16@1- (0.1,0) [-3276.8|3276.7] "DegC"  Project
 SG_ Temp3_ROM_5 m1039 : 72|16@1- (0.1,0) [-3276.8|3276.7] "DegC"  Project
 SG_ TimeOfCurrentCharge_ROM_5 m1040 : 40|32@1+ (1,0) [0|4294967295] "DateTime"  Project
 SG_ RSOC_ROM_5 m1040 : 72|8@1+ (1,0) [0|255] "%"  Project
 SG_ SafetyTemp_ROM_5 m1041 : 40|16@1- (0.1,0) [-3276.8|3276.7] "DegC"  Project
 SG_ FaultLogTime_ROM_6 m1152 : 40|32@1+ (1,0) [0|4294967295] "DateTime"  Project
 SG_ Event_Counter_ROM_6 m1153 : 40|32@1+ (1,0) [0|4294967295] "Time"  Project
 SG_ FW_Ver_ROM_6 m1154 : 40|16@1+ (1,0) [0|65535] "Ver"  Project
 SG_ BatteryStatus_ROM_6 m1155 : 40|16@1+ (1,0) [0|65535] "Hex"  Project
 SG_ SafetyStatus_ROM_6 m1156 : 40|16@1+ (1,0) [0|65535] "Hex"  Project
 SG_ PackStatus_ROM_6 m1157 : 40|16@1+ (1,0) [0|65535] "Hex"  Project
 SG_ PFStatus_ROM_6 m1158 : 40|16@1+ (1,0) [0|65535] "Hex"  Project
 SG_ SafetyStatus2_ROM_6 m1159 : 40|8@1+ (1,0) [0|255] "Hex"  Project
 SG_ Current_ROM_6 m1160 : 40|32@1- (1,0) [-2147483648|2147483647] "mA"  Project
 SG_ CellVolt1_ROM_6 m1161 : 40|16@1+ (1,0) [0|65535] "mV"  Project
 SG_ CellVolt2_ROM_6 m1161 : 56|16@1+ (1,0) [0|65535] "mV"  Project
 SG_ CellVolt3_ROM_6 m1161 : 72|16@1+ (1,0) [0|65535] "mV"  Project
 SG_ CellVolt4_ROM_6 m1162 : 40|16@1+ (1,0) [0|65535] "mV"  Project
 SG_ CellVolt5_ROM_6 m1162 : 56|16@1+ (1,0) [0|65535] "mV"  Project
 SG_ CellVolt6_ROM_6 m1162 : 72|16@1+ (1,0) [0|65535] "mV"  Project
 SG_ CellVolt7_ROM_6 m1163 : 40|16@1+ (1,0) [0|65535] "mV"  Project
 SG_ CellVolt8_ROM_6 m1163 : 56|16@1+ (1,0) [0|65535] "mV"  Project
 SG_ CellVolt9_ROM_6 m1163 : 72|16@1+ (1,0) [0|65535] "mV"  Project
 SG_ CellVolt10_ROM_6 m1164 : 40|16@1+ (1,0) [0|65535] "mV"  Project
 SG_ CellVolt11_ROM_6 m1164 : 56|16@1+ (1,0) [0|65535] "mV"  Project
 SG_ CellVolt12_ROM_6 m1164 : 72|16@1+ (1,0) [0|65535] "mV"  Project
 SG_ CellVolt13_ROM_6 m1165 : 40|16@1+ (1,0) [0|65535] "mV"  Project
 SG_ CellVolt14_ROM_6 m1165 : 56|16@1+ (1,0) [0|65535] "mV"  Project
 SG_ CellVolt15_ROM_6 m1165 : 72|16@1+ (1,0) [0|65535] "mV"  Project
 SG_ CellVolt16_ROM_6 m1166 : 40|16@1+ (1,0) [0|65535] "mV"  Project
 SG_ Temp1_ROM_6 m1167 : 40|16@1- (0.1,0) [-3276.8|3276.7] "DegC"  Project
 SG_ Temp2_ROM_6 m1167 : 56|16@1- (0.1,0) [-3276.8|3276.7] "DegC"  Project
 SG_ Temp3_ROM_6 m1167 : 72|16@1- (0.1,0) [-3276.8|3276.7] "DegC"  Project
 SG_ TimeOfCurrentCharge_ROM_6 m1168 : 40|32@1+ (1,0) [0|4294967295] "DateTime"  Project
 SG_ RSOC_ROM_6 m1168 : 72|8@1+ (1,0) [0|255] "%"  Project
 SG_ SafetyTemp_ROM_6 m1169 : 40|16@1- (0.1,0) [-3276.8|3276.7] "DegC"  Project
 SG_ FaultLogTime_ROM_7 m1280 : 40|32@1+ (1,0) [0|4294967295] "DateTime"  Project
 SG_ Event_Counter_ROM_7 m1281 : 40|32@1+ (1,0) [0|4294967295] "Time"  Project
 SG_ FW_Ver_ROM_7 m1282 : 40|16@1+ (1,0) [0|65535] "Ver"  Project
 SG_ BatteryStatus_ROM_7 m1283 : 40|16@1+ (1,0) [0|65535] "Hex"  Project
 SG_ SafetyStatus_ROM_7 m1284 : 40|16@1+ (1,0) [0|65535] "Hex"  Project
 SG_ PackStatus_ROM_7 m1285 : 40|16@1+ (1,0) [0|65535] "Hex"  Project
 SG_ PFStatus_ROM_7 m1286 : 40|16@1+ (1,0) [0|65535] "Hex"  Project
 SG_ SafetyStatus2_ROM_7 m1287 : 40|8@1+ (1,0) [0|255] "Hex"  Project
 SG_ Current_ROM_7 m1288 : 40|32@1- (1,0) [-2147483648|2147483647] "mA"  Project
 SG_ CellVolt1_ROM_7 m1289 : 40|16@1+ (1,0) [0|65535] "mV"  Project
 SG_ CellVolt2_ROM_7 m1289 : 56|16@1+ (1,0) [0|65535] "mV"  Project
 SG_ CellVolt3_ROM_7 m1289 : 72|16@1+ (1,0) [0|65535] "mV"  Project
 SG_ CellVolt4_ROM_7 m1290 : 40|16@1+ (1,0) [0|65535] "mV"  Project
 SG_ CellVolt5_ROM_7 m1290 : 56|16@1+ (1,0) [0|65535] "mV"  Project
 SG_ CellVolt6_ROM_7 m1290 : 72|16@1+ (1,0) [0|65535] "mV"  Project
 SG_ CellVolt7_ROM_7 m1291 : 40|16@1+ (1,0) [0|65535] "mV"  Project
 SG_ CellVolt8_ROM_7 m1291 : 56|16@1+ (1,0) [0|65535] "mV"  Project
 SG_ CellVolt9_ROM_7 m1291 : 72|16@1+ (1,0) [0|65535] "mV"  Project
 SG_ CellVolt10_ROM_7 m1292 : 40|16@1+ (1,0) [0|65535] "mV"  Project
 SG_ CellVolt11_ROM_7 m1292 : 56|16@1+ (1,0) [0|65535] "mV"  Project
 SG_ CellVolt12_ROM_7 m1292 : 72|16@1+ (1,0) [0|65535] "mV"  Project
 SG_ CellVolt13_ROM_7 m1293 : 40|16@1+ (1,0) [0|65535] "mV"  Project
 SG_ CellVolt14_ROM_7 m1293 : 56|16@1+ (1,0) [0|65535] "mV"  Project
 SG_ CellVolt15_ROM_7 m1293 : 72|16@1+ (1,0) [0|65535] "mV"  Project
 SG_ CellVolt16_ROM_7 m1294 : 40|16@1+ (1,0) [0|65535] "mV"  Project
 SG_ Temp1_ROM_7 m1295 : 40|16@1- (0.1,0) [-3276.8|3276.7] "DegC"  Project
 SG_ Temp2_ROM_7 m1295 : 56|16@1- (0.1,0) [-3276.8|3276.7] "DegC"  Project
 SG_ Temp3_ROM_7 m1295 : 72|16@1- (0.1,0) [-3276.8|3276.7] "DegC"  Project
 SG_ TimeOfCurrentCharge_ROM_7 m1296 : 40|32@1+ (1,0) [0|4294967295] "DateTime"  Project
 SG_ RSOC_ROM_7 m1296 : 72|8@1+ (1,0) [0|255] "%"  Project
 SG_ SafetyTemp_ROM_7 m1297 : 40|16@1- (0.1,0) [-3276.8|3276.7] "DegC"  Project
 SG_ FaultLogTime_ROM_8 m1408 : 40|32@1+ (1,0) [0|4294967295] "DateTime"  Project
 SG_ Event_Counter_ROM_8 m1409 : 40|32@1+ (1,0) [0|4294967295] "Time"  Project
 SG_ FW_Ver_ROM_8 m1410 : 40|16@1+ (1,0) [0|65535] "Ver"  Project
 SG_ BatteryStatus_ROM_8 m1411 : 40|16@1+ (1,0) [0|65535] "Hex"  Project
 SG_ SafetyStatus_ROM_8 m1412 : 40|16@1+ (1,0) [0|65535] "Hex"  Project
 SG_ PackStatus_ROM_8 m1413 : 40|16@1+ (1,0) [0|65535] "Hex"  Project
 SG_ PFStatus_ROM_8 m1414 : 40|16@1+ (1,0) [0|65535] "Hex"  Project
 SG_ SafetyStatus2_ROM_8 m1415 : 40|8@1+ (1,0) [0|255] "Hex"  Project
 SG_ Current_ROM_8 m1416 : 40|32@1- (1,0) [-2147483648|2147483647] "mA"  Project
 SG_ CellVolt1_ROM_8 m1417 : 40|16@1+ (1,0) [0|65535] "mV"  Project
 SG_ CellVolt2_ROM_8 m1417 : 56|16@1+ (1,0) [0|65535] "mV"  Project
 SG_ CellVolt3_ROM_8 m1417 : 72|16@1+ (1,0) [0|65535] "mV"  Project
 SG_ CellVolt4_ROM_8 m1418 : 40|16@1+ (1,0) [0|65535] "mV"  Project
 SG_ CellVolt5_ROM_8 m1418 : 56|16@1+ (1,0) [0|65535] "mV"  Project
 SG_ CellVolt6_ROM_8 m1418 : 72|16@1+ (1,0) [0|65535] "mV"  Project
 SG_ CellVolt7_ROM_8 m1419 : 40|16@1+ (1,0) [0|65535] "mV"  Project
 SG_ CellVolt8_ROM_8 m1419 : 56|16@1+ (1,0) [0|65535] "mV"  Project
 SG_ CellVolt9_ROM_8 m1419 : 72|16@1+ (1,0) [0|65535] "mV"  Project
 SG_ CellVolt10_ROM_8 m1420 : 40|16@1+ (1,0) [0|65535] "mV"  Project
 SG_ CellVolt11_ROM_8 m1420 : 56|16@1+ (1,0) [0|65535] "mV"  Project
 SG_ CellVolt12_ROM_8 m1420 : 72|16@1+ (1,0) [0|65535] "mV"  Project
 SG_ CellVolt13_ROM_8 m1421 : 40|16@1+ (1,0) [0|65535] "mV"  Project
 SG_ CellVolt14_ROM_8 m1421 : 56|16@1+ (1,0) [0|65535] "mV"  Project
 SG_ CellVolt15_ROM_8 m1421 : 72|16@1+ (1,0) [0|65535] "mV"  Project
 SG_ CellVolt16_ROM_8 m1422 : 40|16@1+ (1,0) [0|65535] "mV"  Project
 SG_ Temp1_ROM_8 m1423 : 40|16@1- (0.1,0) [-3276.8|3276.7] "DegC"  Project
 SG_ Temp2_ROM_8 m1423 : 56|16@1- (0.1,0) [-3276.8|3276.7] "DegC"  Project
 SG_ Temp3_ROM_8 m1423 : 72|16@1- (0.1,0) [-3276.8|3276.7] "DegC"  Project
 SG_ TimeOfCurrentCharge_ROM_8 m1424 : 40|32@1+ (1,0) [0|4294967295] "DateTime"  Project
 SG_ RSOC_ROM_8 m1424 : 72|8@1+ (1,0) [0|255] "%"  Project
 SG_ SafetyTemp_ROM_8 m1425 : 40|16@1- (0.1,0) [-3276.8|3276.7] "DegC"  Project
 SG_ FaultLogTime_ROM_9 m1536 : 40|32@1+ (1,0) [0|4294967295] "DateTime"  Project
 SG_ Event_Counter_ROM_9 m1537 : 40|32@1+ (1,0) [0|4294967295] "Time"  Project
 SG_ FW_Ver_ROM_9 m1538 : 40|16@1+ (1,0) [0|65535] "Ver"  Project
 SG_ BatteryStatus_ROM_9 m1539 : 40|16@1+ (1,0) [0|65535] "Hex"  Project
 SG_ SafetyStatus_ROM_9 m1540 : 40|16@1+ (1,0) [0|65535] "Hex"  Project
 SG_ PackStatus_ROM_9 m1541 : 40|16@1+ (1,0) [0|65535] "Hex"  Project
 SG_ PFStatus_ROM_9 m1542 : 40|16@1+ (1,0) [0|65535] "Hex"  Project
 SG_ SafetyStatus2_ROM_9 m1543 : 40|8@1+ (1,0) [0|255] "Hex"  Project
 SG_ Current_ROM_9 m1544 : 40|32@1- (1,0) [-2147483648|2147483647] "mA"  Project
 SG_ CellVolt1_ROM_9 m1545 : 40|16@1+ (1,0) [0|65535] "mV"  Project
 SG_ CellVolt2_ROM_9 m1545 : 56|16@1+ (1,0) [0|65535] "mV"  Project
 SG_ CellVolt3_ROM_9 m1545 : 72|16@1+ (1,0) [0|65535] "mV"  Project
 SG_ CellVolt4_ROM_9 m1546 : 40|16@1+ (1,0) [0|65535] "mV"  Project
 SG_ CellVolt5_ROM_9 m1546 : 56|16@1+ (1,0) [0|65535] "mV"  Project
 SG_ CellVolt6_ROM_9 m1546 : 72|16@1+ (1,0) [0|65535] "mV"  Project
 SG_ CellVolt7_ROM_9 m1547 : 40|16@1+ (1,0) [0|65535] "mV"  Project
 SG_ CellVolt8_ROM_9 m1547 : 56|16@1+ (1,0) [0|65535] "mV"  Project
 SG_ CellVolt9_ROM_9 m1547 : 72|16@1+ (1,0) [0|65535] "mV"  Project
 SG_ CellVolt10_ROM_9 m1548 : 40|16@1+ (1,0) [0|65535] "mV"  Project
 SG_ CellVolt11_ROM_9 m1548 : 56|16@1+ (1,0) [0|65535] "mV"  Project
 SG_ CellVolt12_ROM_9 m1548 : 72|16@1+ (1,0) [0|65535] "mV"  Project
 SG_ CellVolt13_ROM_9 m1549 : 40|16@1+ (1,0) [0|65535] "mV"  Project
 SG_ CellVolt14_ROM_9 m1549 : 56|16@1+ (1,0) [0|65535] "mV"  Project
 SG_ CellVolt15_ROM_9 m1549 : 72|16@1+ (1,0) [0|65535] "mV"  Project
 SG_ CellVolt16_ROM_9 m1550 : 40|16@1+ (1,0) [0|65535] "mV"  Project
 SG_ Temp1_ROM_9 m1551 : 40|16@1- (0.1,0) [-3276.8|3276.7] "DegC"  Project
 SG_ Temp2_ROM_9 m1551 : 56|16@1- (0.1,0) [-3276.8|3276.7] "DegC"  Project
 SG_ Temp3_ROM_9 m1551 : 72|16@1- (0.1,0) [-3276.8|3276.7] "DegC"  Project
 SG_ TimeOfCurrentCharge_ROM_9 m1552 : 40|32@1+ (1,0) [0|4294967295] "DateTime"  Project
 SG_ RSOC_ROM_9 m1552 : 72|8@1+ (1,0) [0|255] "%"  Project
 SG_ SafetyTemp_ROM_9 m1553 : 40|16@1- (0.1,0) [-3276.8|3276.7] "DegC"  Project
 SG_ FaultLogTime_ROM_10 m1664 : 40|32@1+ (1,0) [0|4294967295] "DateTime"  Project
 SG_ Event_Counter_ROM_10 m1665 : 40|32@1+ (1,0) [0|4294967295] "Time"  Project
 SG_ FW_Ver_ROM_10 m1666 : 40|16@1+ (1,0) [0|65535] "Ver"  Project
 SG_ BatteryStatus_ROM_10 m1667 : 40|16@1+ (1,0) [0|65535] "Hex"  Project
 SG_ SafetyStatus_ROM_10 m1668 : 40|16@1+ (1,0) [0|65535] "Hex"  Project
 SG_ PackStatus_ROM_10 m1669 : 40|16@1+ (1,0) [0|65535] "Hex"  Project
 SG_ PFStatus_ROM_10 m1670 : 40|16@1+ (1,0) [0|65535] "Hex"  Project
 SG_ SafetyStatus2_ROM_10 m1671 : 40|8@1+ (1,0) [0|255] "Hex"  Project
 SG_ Current_ROM_10 m1672 : 40|32@1- (1,0) [-2147483648|2147483647] "mA"  Project
 SG_ CellVolt1_ROM_10 m1673 : 40|16@1+ (1,0) [0|65535] "mV"  Project
 SG_ CellVolt2_ROM_10 m1673 : 56|16@1+ (1,0) [0|65535] "mV"  Project
 SG_ CellVolt3_ROM_10 m1673 : 72|16@1+ (1,0) [0|65535] "mV"  Project
 SG_ CellVolt4_ROM_10 m1674 : 40|16@1+ (1,0) [0|65535] "mV"  Project
 SG_ CellVolt5_ROM_10 m1674 : 56|16@1+ (1,0) [0|65535] "mV"  Project
 SG_ CellVolt6_ROM_10 m1674 : 72|16@1+ (1,0) [0|65535] "mV"  Project
 SG_ CellVolt7_ROM_10 m1675 : 40|16@1+ (1,0) [0|65535] "mV"  Project
 SG_ CellVolt8_ROM_10 m1675 : 56|16@1+ (1,0) [0|65535] "mV"  Project
 SG_ CellVolt9_ROM_10 m1675 : 72|16@1+ (1,0) [0|65535] "mV"  Project
 SG_ CellVolt10_ROM_10 m1676 : 40|16@1+ (1,0) [0|65535] "mV"  Project
 SG_ CellVolt11_ROM_10 m1676 : 56|16@1+ (1,0) [0|65535] "mV"  Project
 SG_ CellVolt12_ROM_10 m1676 : 72|16@1+ (1,0) [0|65535] "mV"  Project
 SG_ CellVolt13_ROM_10 m1677 : 40|16@1+ (1,0) [0|65535] "mV"  Project
 SG_ CellVolt14_ROM_10 m1677 : 56|16@1+ (1,0) [0|65535] "mV"  Project
 SG_ CellVolt15_ROM_10 m1677 : 72|16@1+ (1,0) [0|65535] "mV"  Project
 SG_ CellVolt16_ROM_10 m1678 : 40|16@1+ (1,0) [0|65535] "mV"  Project
 SG_ Temp1_ROM_10 m1679 : 40|16@1- (0.1,0) [-3276.8|3276.7] "DegC"  Project
 SG_ Temp2_ROM_10 m1679 : 56|16@1- (0.1,0) [-3276.8|3276.7] "DegC"  Project
 SG_ Temp3_ROM_10 m1679 : 72|16@1- (0.1,0) [-3276.8|3276.7] "DegC"  Project
 SG_ TimeOfCurrentCharge_ROM_10 m1680 : 40|32@1+ (1,0) [0|4294967295] "DateTime"  Project
 SG_ RSOC_ROM_10 m1680 : 72|8@1+ (1,0) [0|255] "%"  Project
 SG_ SafetyTemp_ROM_10 m1681 : 40|16@1- (0.1,0) [-3276.8|3276.7] "DegC"  Project
 SG_ FaultLogTime_ROM_11 m1792 : 40|32@1+ (1,0) [0|4294967295] "DateTime"  Project
 SG_ Event_Counter_ROM_11 m1793 : 40|32@1+ (1,0) [0|4294967295] "Time"  Project
 SG_ FW_Ver_ROM_11 m1794 : 40|16@1+ (1,0) [0|65535] "Ver"  Project
 SG_ BatteryStatus_ROM_11 m1795 : 40|16@1+ (1,0) [0|65535] "Hex"  Project
 SG_ SafetyStatus_ROM_11 m1796 : 40|16@1+ (1,0) [0|65535] "Hex"  Project
 SG_ PackStatus_ROM_11 m1797 : 40|16@1+ (1,0) [0|65535] "Hex"  Project
 SG_ PFStatus_ROM_11 m1798 : 40|16@1+ (1,0) [0|65535] "Hex"  Project
 SG_ SafetyStatus2_ROM_11 m1799 : 40|8@1+ (1,0) [0|255] "Hex"  Project
 SG_ Current_ROM_11 m1800 : 40|32@1- (1,0) [-2147483648|2147483647] "mA"  Project
 SG_ CellVolt1_ROM_11 m1801 : 40|16@1+ (1,0) [0|65535] "mV"  Project
 SG_ CellVolt2_ROM_11 m1801 : 56|16@1+ (1,0) [0|65535] "mV"  Project
 SG_ CellVolt3_ROM_11 m1801 : 72|16@1+ (1,0) [0|65535] "mV"  Project
 SG_ CellVolt4_ROM_11 m1802 : 40|16@1+ (1,0) [0|65535] "mV"  Project
 SG_ CellVolt5_ROM_11 m1802 : 56|16@1+ (1,0) [0|65535] "mV"  Project
 SG_ CellVolt6_ROM_11 m1802 : 72|16@1+ (1,0) [0|65535] "mV"  Project
 SG_ CellVolt7_ROM_11 m1803 : 40|16@1+ (1,0) [0|65535] "mV"  Project
 SG_ CellVolt8_ROM_11 m1803 : 56|16@1+ (1,0) [0|65535] "mV"  Project
 SG_ CellVolt9_ROM_11 m1803 : 72|16@1+ (1,0) [0|65535] "mV"  Project
 SG_ CellVolt10_ROM_11 m1804 : 40|16@1+ (1,0) [0|65535] "mV"  Project
 SG_ CellVolt11_ROM_11 m1804 : 56|16@1+ (1,0) [0|65535] "mV"  Project
 SG_ CellVolt12_ROM_11 m1804 : 72|16@1+ (1,0) [0|65535] "mV"  Project
 SG_ CellVolt13_ROM_11 m1805 : 40|16@1+ (1,0) [0|65535] "mV"  Project
 SG_ CellVolt14_ROM_11 m1805 : 56|16@1+ (1,0) [0|65535] "mV"  Project
 SG_ CellVolt15_ROM_11 m1805 : 72|16@1+ (1,0) [0|65535] "mV"  Project
 SG_ CellVolt16_ROM_11 m1806 : 40|16@1+ (1,0) [0|65535] "mV"  Project
 SG_ Temp1_ROM_11 m1807 : 40|16@1- (0.1,0) [-3276.8|3276.7] "DegC"  Project
 SG_ Temp2_ROM_11 m1807 : 56|16@1- (0.1,0) [-3276.8|3276.7] "DegC"  Project
 SG_ Temp3_ROM_11 m1807 : 72|16@1- (0.1,0) [-3276.8|3276.7] "DegC"  Project
 SG_ TimeOfCurrentCharge_ROM_11 m1808 : 40|32@1+ (1,0) [0|4294967295] "DateTime"  Project
 SG_ RSOC_ROM_11 m1808 : 72|8@1+ (1,0) [0|255] "%"  Project
 SG_ SafetyTemp_ROM_11 m1809 : 40|16@1- (0.1,0) [-3276.8|3276.7] "DegC"  Project
 SG_ FaultLogTime_ROM_12 m1920 : 40|32@1+ (1,0) [0|4294967295] "DateTime"  Project
 SG_ Event_Counter_ROM_12 m1921 : 40|32@1+ (1,0) [0|4294967295] "Time"  Project
 SG_ FW_Ver_ROM_12 m1922 : 40|16@1+ (1,0) [0|65535] "Ver"  Project
 SG_ BatteryStatus_ROM_12 m1923 : 40|16@1+ (1,0) [0|65535] "Hex"  Project
 SG_ SafetyStatus_ROM_12 m1924 : 40|16@1+ (1,0) [0|65535] "Hex"  Project
 SG_ PackStatus_ROM_12 m1925 : 40|16@1+ (1,0) [0|65535] "Hex"  Project
 SG_ PFStatus_ROM_12 m1926 : 40|16@1+ (1,0) [0|65535] "Hex"  Project
 SG_ SafetyStatus2_ROM_12 m1927 : 40|8@1+ (1,0) [0|255] "Hex"  Project
 SG_ Current_ROM_12 m1928 : 40|32@1- (1,0) [-2147483648|2147483647] "mA"  Project
 SG_ CellVolt1_ROM_12 m1929 : 40|16@1+ (1,0) [0|65535] "mV"  Project
 SG_ CellVolt2_ROM_12 m1929 : 56|16@1+ (1,0) [0|65535] "mV"  Project
 SG_ CellVolt3_ROM_12 m1929 : 72|16@1+ (1,0) [0|65535] "mV"  Project
 SG_ CellVolt4_ROM_12 m1930 : 40|16@1+ (1,0) [0|65535] "mV"  Project
 SG_ CellVolt5_ROM_12 m1930 : 56|16@1+ (1,0) [0|65535] "mV"  Project
 SG_ CellVolt6_ROM_12 m1930 : 72|16@1+ (1,0) [0|65535] "mV"  Project
 SG_ CellVolt7_ROM_12 m1931 : 40|16@1+ (1,0) [0|65535] "mV"  Project
 SG_ CellVolt8_ROM_12 m1931 : 56|16@1+ (1,0) [0|65535] "mV"  Project
 SG_ CellVolt9_ROM_12 m1931 : 72|16@1+ (1,0) [0|65535] "mV"  Project
 SG_ CellVolt10_ROM_12 m1932 : 40|16@1+ (1,0) [0|65535] "mV"  Project
 SG_ CellVolt11_ROM_12 m1932 : 56|16@1+ (1,0) [0|65535] "mV"  Project
 SG_ CellVolt12_ROM_12 m1932 : 72|16@1+ (1,0) [0|65535] "mV"  Project
 SG_ CellVolt13_ROM_12 m1933 : 40|16@1+ (1,0) [0|65535] "mV"  Project
 SG_ CellVolt14_ROM_12 m1933 : 56|16@1+ (1,0) [0|65535] "mV"  Project
 SG_ CellVolt15_ROM_12 m1933 : 72|16@1+ (1,0) [0|65535] "mV"  Project
 SG_ CellVolt16_ROM_12 m1934 : 40|16@1+ (1,0) [0|65535] "mV"  Project
 SG_ Temp1_ROM_12 m1935 : 40|16@1- (0.1,0) [-3276.8|3276.7] "DegC"  Project
 SG_ Temp2_ROM_12 m1935 : 56|16@1- (0.1,0) [-3276.8|3276.7] "DegC"  Project
 SG_ Temp3_ROM_12 m1935 : 72|16@1- (0.1,0) [-3276.8|3276.7] "DegC"  Project
 SG_ TimeOfCurrentCharge_ROM_12 m1936 : 40|32@1+ (1,0) [0|4294967295] "DateTime"  Project
 SG_ RSOC_ROM_12 m1936 : 72|8@1+ (1,0) [0|255] "%"  Project
 SG_ SafetyTemp_ROM_12 m1937 : 40|16@1- (0.1,0) [-3276.8|3276.7] "DegC"  Project
 SG_ FaultLogTime_ROM_13 m2048 : 40|32@1+ (1,0) [0|4294967295] "DateTime"  Project
 SG_ Event_Counter_ROM_13 m2049 : 40|32@1+ (1,0) [0|4294967295] "Time"  Project
 SG_ FW_Ver_ROM_13 m2050 : 40|16@1+ (1,0) [0|65535] "Ver"  Project
 SG_ BatteryStatus_ROM_13 m2051 : 40|16@1+ (1,0) [0|65535] "Hex"  Project
 SG_ SafetyStatus_ROM_13 m2052 : 40|16@1+ (1,0) [0|65535] "Hex"  Project
 SG_ PackStatus_ROM_13 m2053 : 40|16@1+ (1,0) [0|65535] "Hex"  Project
 SG_ PFStatus_ROM_13 m2054 : 40|16@1+ (1,0) [0|65535] "Hex"  Project
 SG_ SafetyStatus2_ROM_13 m2055 : 40|8@1+ (1,0) [0|255] "Hex"  Project
 SG_ Current_ROM_13 m2056 : 40|32@1- (1,0) [-2147483648|2147483647] "mA"  Project
 SG_ CellVolt1_ROM_13 m2057 : 40|16@1+ (1,0) [0|65535] "mV"  Project
 SG_ CellVolt2_ROM_13 m2057 : 56|16@1+ (1,0) [0|65535] "mV"  Project
 SG_ CellVolt3_ROM_13 m2057 : 72|16@1+ (1,0) [0|65535] "mV"  Project
 SG_ CellVolt4_ROM_13 m2058 : 40|16@1+ (1,0) [0|65535] "mV"  Project
 SG_ CellVolt5_ROM_13 m2058 : 56|16@1+ (1,0) [0|65535] "mV"  Project
 SG_ CellVolt6_ROM_13 m2058 : 72|16@1+ (1,0) [0|65535] "mV"  Project
 SG_ CellVolt7_ROM_13 m2059 : 40|16@1+ (1,0) [0|65535] "mV"  Project
 SG_ CellVolt8_ROM_13 m2059 : 56|16@1+ (1,0) [0|65535] "mV"  Project
 SG_ CellVolt9_ROM_13 m2059 : 72|16@1+ (1,0) [0|65535] "mV"  Project
 SG_ CellVolt10_ROM_13 m2060 : 40|16@1+ (1,0) [0|65535] "mV"  Project
 SG_ CellVolt11_ROM_13 m2060 : 56|16@1+ (1,0) [0|65535] "mV"  Project
 SG_ CellVolt12_ROM_13 m2060 : 72|16@1+ (1,0) [0|65535] "mV"  Project
 SG_ CellVolt13_ROM_13 m2061 : 40|16@1+ (1,0) [0|65535] "mV"  Project
 SG_ CellVolt14_ROM_13 m2061 : 56|16@1+ (1,0) [0|65535] "mV"  Project
 SG_ CellVolt15_ROM_13 m2061 : 72|16@1+ (1,0) [0|65535] "mV"  Project
 SG_ CellVolt16_ROM_13 m2062 : 40|16@1+ (1,0) [0|65535] "mV"  Project
 SG_ Temp1_ROM_13 m2063 : 40|16@1- (0.1,0) [-3276.8|3276.7] "DegC"  Project
 SG_ Temp2_ROM_13 m2063 : 56|16@1- (0.1,0) [-3276.8|3276.7] "DegC"  Project
 SG_ Temp3_ROM_13 m2063 : 72|16@1- (0.1,0) [-3276.8|3276.7] "DegC"  Project
 SG_ TimeOfCurrentCharge_ROM_13 m2064 : 40|32@1+ (1,0) [0|4294967295] "DateTime"  Project
 SG_ RSOC_ROM_13 m2064 : 72|8@1+ (1,0) [0|255] "%"  Project
 SG_ SafetyTemp_ROM_13 m2065 : 40|16@1- (0.1,0) [-3276.8|3276.7] "DegC"  Project
 SG_ FaultLogTime_ROM_14 m2176 : 40|32@1+ (1,0) [0|4294967295] "DateTime"  Project
 SG_ Event_Counter_ROM_14 m2177 : 40|32@1+ (1,0) [0|4294967295] "Time"  Project
 SG_ FW_Ver_ROM_14 m2178 : 40|16@1+ (1,0) [0|65535] "Ver"  Project
 SG_ BatteryStatus_ROM_14 m2179 : 40|16@1+ (1,0) [0|65535] "Hex"  Project
 SG_ SafetyStatus_ROM_14 m2180 : 40|16@1+ (1,0) [0|65535] "Hex"  Project
 SG_ PackStatus_ROM_14 m2181 : 40|16@1+ (1,0) [0|65535] "Hex"  Project
 SG_ PFStatus_ROM_14 m2182 : 40|16@1+ (1,0) [0|65535] "Hex"  Project
 SG_ SafetyStatus2_ROM_14 m2183 : 40|8@1+ (1,0) [0|255] "Hex"  Project
 SG_ Current_ROM_14 m2184 : 40|32@1- (1,0) [-2147483648|2147483647] "mA"  Project
 SG_ CellVolt1_ROM_14 m2185 : 40|16@1+ (1,0) [0|65535] "mV"  Project
 SG_ CellVolt2_ROM_14 m2185 : 56|16@1+ (1,0) [0|65535] "mV"  Project
 SG_ CellVolt3_ROM_14 m2185 : 72|16@1+ (1,0) [0|65535] "mV"  Project
 SG_ CellVolt4_ROM_14 m2186 : 40|16@1+ (1,0) [0|65535] "mV"  Project
 SG_ CellVolt5_ROM_14 m2186 : 56|16@1+ (1,0) [0|65535] "mV"  Project
 SG_ CellVolt6_ROM_14 m2186 : 72|16@1+ (1,0) [0|65535] "mV"  Project
 SG_ CellVolt7_ROM_14 m2187 : 40|16@1+ (1,0) [0|65535] "mV"  Project
 SG_ CellVolt8_ROM_14 m2187 : 56|16@1+ (1,0) [0|65535] "mV"  Project
 SG_ CellVolt9_ROM_14 m2187 : 72|16@1+ (1,0) [0|65535] "mV"  Project
 SG_ CellVolt10_ROM_14 m2188 : 40|16@1+ (1,0) [0|65535] "mV"  Project
 SG_ CellVolt11_ROM_14 m2188 : 56|16@1+ (1,0) [0|65535] "mV"  Project
 SG_ CellVolt12_ROM_14 m2188 : 72|16@1+ (1,0) [0|65535] "mV"  Project
 SG_ CellVolt13_ROM_14 m2189 : 40|16@1+ (1,0) [0|65535] "mV"  Project
 SG_ CellVolt14_ROM_14 m2189 : 56|16@1+ (1,0) [0|65535] "mV"  Project
 SG_ CellVolt15_ROM_14 m2189 : 72|16@1+ (1,0) [0|65535] "mV"  Project
 SG_ CellVolt16_ROM_14 m2190 : 40|16@1+ (1,0) [0|65535] "mV"  Project
 SG_ Temp1_ROM_14 m2191 : 40|16@1- (0.1,0) [-3276.8|3276.7] "DegC"  Project
 SG_ Temp2_ROM_14 m2191 : 56|16@1- (0.1,0) [-3276.8|3276.7] "DegC"  Project
 SG_ Temp3_ROM_14 m2191 : 72|16@1- (0.1,0) [-3276.8|3276.7] "DegC"  Project
 SG_ TimeOfCurrentCharge_ROM_14 m2192 : 40|32@1+ (1,0) [0|4294967295] "DateTime"  Project
 SG_ RSOC_ROM_14 m2192 : 72|8@1+ (1,0) [0|255] "%"  Project
 SG_ SafetyTemp_ROM_14 m2193 : 40|16@1- (0.1,0) [-3276.8|3276.7] "DegC"  Project
 SG_ FaultLogTime_ROM_15 m2304 : 40|32@1+ (1,0) [0|4294967295] "DateTime"  Project
 SG_ Event_Counter_ROM_15 m2305 : 40|32@1+ (1,0) [0|4294967295] "Time"  Project
 SG_ FW_Ver_ROM_15 m2306 : 40|16@1+ (1,0) [0|65535] "Ver"  Project
 SG_ BatteryStatus_ROM_15 m2307 : 40|16@1+ (1,0) [0|65535] "Hex"  Project
 SG_ SafetyStatus_ROM_15 m2308 : 40|16@1+ (1,0) [0|65535] "Hex"  Project
 SG_ PackStatus_ROM_15 m2309 : 40|16@1+ (1,0) [0|65535] "Hex"  Project
 SG_ PFStatus_ROM_15 m2310 : 40|16@1+ (1,0) [0|65535] "Hex"  Project
 SG_ SafetyStatus2_ROM_15 m2311 : 40|8@1+ (1,0) [0|255] "Hex"  Project
 SG_ Current_ROM_15 m2312 : 40|32@1- (1,0) [-2147483648|2147483647] "mA"  Project
 SG_ CellVolt1_ROM_15 m2313 : 40|16@1+ (1,0) [0|65535] "mV"  Project
 SG_ CellVolt2_ROM_15 m2313 : 56|16@1+ (1,0) [0|65535] "mV"  Project
 SG_ CellVolt3_ROM_15 m2313 : 72|16@1+ (1,0) [0|65535] "mV"  Project
 SG_ CellVolt4_ROM_15 m2314 : 40|16@1+ (1,0) [0|65535] "mV"  Project
 SG_ CellVolt5_ROM_15 m2314 : 56|16@1+ (1,0) [0|65535] "mV"  Project
 SG_ CellVolt6_ROM_15 m2314 : 72|16@1+ (1,0) [0|65535] "mV"  Project
 SG_ CellVolt7_ROM_15 m2315 : 40|16@1+ (1,0) [0|65535] "mV"  Project
 SG_ CellVolt8_ROM_15 m2315 : 56|16@1+ (1,0) [0|65535] "mV"  Project
 SG_ CellVolt9_ROM_15 m2315 : 72|16@1+ (1,0) [0|65535] "mV"  Project
 SG_ CellVolt10_ROM_15 m2316 : 40|16@1+ (1,0) [0|65535] "mV"  Project
 SG_ CellVolt11_ROM_15 m2316 : 56|16@1+ (1,0) [0|65535] "mV"  Project
 SG_ CellVolt12_ROM_15 m2316 : 72|16@1+ (1,0) [0|65535] "mV"  Project
 SG_ CellVolt13_ROM_15 m2317 : 40|16@1+ (1,0) [0|65535] "mV"  Project
 SG_ CellVolt14_ROM_15 m2317 : 56|16@1+ (1,0) [0|65535] "mV"  Project
 SG_ CellVolt15_ROM_15 m2317 : 72|16@1+ (1,0) [0|65535] "mV"  Project
 SG_ CellVolt16_ROM_15 m2318 : 40|16@1+ (1,0) [0|65535] "mV"  Project
 SG_ Temp1_ROM_15 m2319 : 40|16@1- (0.1,0) [-3276.8|3276.7] "DegC"  Project
 SG_ Temp2_ROM_15 m2319 : 56|16@1- (0.1,0) [-3276.8|3276.7] "DegC"  Project
 SG_ Temp3_ROM_15 m2319 : 72|16@1- (0.1,0) [-3276.8|3276.7] "DegC"  Project
 SG_ TimeOfCurrentCharge_ROM_15 m2320 : 40|32@1+ (1,0) [0|4294967295] "DateTime"  Project
 SG_ RSOC_ROM_15 m2320 : 72|8@1+ (1,0) [0|255] "%"  Project
 SG_ SafetyTemp_ROM_15 m2321 : 40|16@1- (0.1,0) [-3276.8|3276.7] "DegC"  Project
 SG_ FaultLogTime_ROM_16 m2432 : 40|32@1+ (1,0) [0|4294967295] "DateTime"  Project
 SG_ Event_Counter_ROM_16 m2433 : 40|32@1+ (1,0) [0|4294967295] "Time"  Project
 SG_ FW_Ver_ROM_16 m2434 : 40|16@1+ (1,0) [0|65535] "Ver"  Project
 SG_ BatteryStatus_ROM_16 m2435 : 40|16@1+ (1,0) [0|65535] "Hex"  Project
 SG_ SafetyStatus_ROM_16 m2436 : 40|16@1+ (1,0) [0|65535] "Hex"  Project
 SG_ PackStatus_ROM_16 m2437 : 40|16@1+ (1,0) [0|65535] "Hex"  Project
 SG_ PFStatus_ROM_16 m2438 : 40|16@1+ (1,0) [0|65535] "Hex"  Project
 SG_ SafetyStatus2_ROM_16 m2439 : 40|8@1+ (1,0) [0|255] "Hex"  Project
 SG_ Current_ROM_16 m2440 : 40|32@1- (1,0) [-2147483648|2147483647] "mA"  Project
 SG_ CellVolt1_ROM_16 m2441 : 40|16@1+ (1,0) [0|65535] "mV"  Project
 SG_ CellVolt2_ROM_16 m2441 : 56|16@1+ (1,0) [0|65535] "mV"  Project
 SG_ CellVolt3_ROM_16 m2441 : 72|16@1+ (1,0) [0|65535] "mV"  Project
 SG_ CellVolt4_ROM_16 m2442 : 40|16@1+ (1,0) [0|65535] "mV"  Project
 SG_ CellVolt5_ROM_16 m2442 : 56|16@1+ (1,0) [0|65535] "mV"  Project
 SG_ CellVolt6_ROM_16 m2442 : 72|16@1+ (1,0) [0|65535] "mV"  Project
 SG_ CellVolt7_ROM_16 m2443 : 40|16@1+ (1,0) [0|65535] "mV"  Project
 SG_ CellVolt8_ROM_16 m2443 : 56|16@1+ (1,0) [0|65535] "mV"  Project
 SG_ CellVolt9_ROM_16 m2443 : 72|16@1+ (1,0) [0|65535] "mV"  Project
 SG_ CellVolt10_ROM_16 m2444 : 40|16@1+ (1,0) [0|65535] "mV"  Project
 SG_ CellVolt11_ROM_16 m2444 : 56|16@1+ (1,0) [0|65535] "mV"  Project
 SG_ CellVolt12_ROM_16 m2444 : 72|16@1+ (1,0) [0|65535] "mV"  Project
 SG_ CellVolt13_ROM_16 m2445 : 40|16@1+ (1,0) [0|65535] "mV"  Project
 SG_ CellVolt14_ROM_16 m2445 : 56|16@1+ (1,0) [0|65535] "mV"  Project
 SG_ CellVolt15_ROM_16 m2445 : 72|16@1+ (1,0) [0|65535] "mV"  Project
 SG_ CellVolt16_ROM_16 m2446 : 40|16@1+ (1,0) [0|65535] "mV"  Project
 SG_ Temp1_ROM_16 m2447 : 40|16@1- (0.1,0) [-3276.8|3276.7] "DegC"  Project
 SG_ Temp2_ROM_16 m2447 : 56|16@1- (0.1,0) [-3276.8|3276.7] "DegC"  Project
 SG_ Temp3_ROM_16 m2447 : 72|16@1- (0.1,0) [-3276.8|3276.7] "DegC"  Project
 SG_ TimeOfCurrentCharge_ROM_16 m2448 : 40|32@1+ (1,0) [0|4294967295] "DateTime"  Project
 SG_ RSOC_ROM_16 m2448 : 72|8@1+ (1,0) [0|255] "%"  Project
 SG_ SafetyTemp_ROM_16 m2449 : 40|16@1- (0.1,0) [-3276.8|3276.7] "DegC"  Project
 SG_ FaultLogTime_ROM_17 m2560 : 40|32@1+ (1,0) [0|4294967295] "DateTime"  Project
 SG_ Event_Counter_ROM_17 m2561 : 40|32@1+ (1,0) [0|4294967295] "Time"  Project
 SG_ FW_Ver_ROM_17 m2562 : 40|16@1+ (1,0) [0|65535] "Ver"  Project
 SG_ BatteryStatus_ROM_17 m2563 : 40|16@1+ (1,0) [0|65535] "Hex"  Project
 SG_ SafetyStatus_ROM_17 m2564 : 40|16@1+ (1,0) [0|65535] "Hex"  Project
 SG_ PackStatus_ROM_17 m2565 : 40|16@1+ (1,0) [0|65535] "Hex"  Project
 SG_ PFStatus_ROM_17 m2566 : 40|16@1+ (1,0) [0|65535] "Hex"  Project
 SG_ SafetyStatus2_ROM_17 m2567 : 40|8@1+ (1,0) [0|255] "Hex"  Project
 SG_ Current_ROM_17 m2568 : 40|32@1- (1,0) [-2147483648|2147483647] "mA"  Project
 SG_ CellVolt1_ROM_17 m2569 : 40|16@1+ (1,0) [0|65535] "mV"  Project
 SG_ CellVolt2_ROM_17 m2569 : 56|16@1+ (1,0) [0|65535] "mV"  Project
 SG_ CellVolt3_ROM_17 m2569 : 72|16@1+ (1,0) [0|65535] "mV"  Project
 SG_ CellVolt4_ROM_17 m2570 : 40|16@1+ (1,0) [0|65535] "mV"  Project
 SG_ CellVolt5_ROM_17 m2570 : 56|16@1+ (1,0) [0|65535] "mV"  Project
 SG_ CellVolt6_ROM_17 m2570 : 72|16@1+ (1,0) [0|65535] "mV"  Project
 SG_ CellVolt7_ROM_17 m2571 : 40|16@1+ (1,0) [0|65535] "mV"  Project
 SG_ CellVolt8_ROM_17 m2571 : 56|16@1+ (1,0) [0|65535] "mV"  Project
 SG_ CellVolt9_ROM_17 m2571 : 72|16@1+ (1,0) [0|65535] "mV"  Project
 SG_ CellVolt10_ROM_17 m2572 : 40|16@1+ (1,0) [0|65535] "mV"  Project
 SG_ CellVolt11_ROM_17 m2572 : 56|16@1+ (1,0) [0|65535] "mV"  Project
 SG_ CellVolt12_ROM_17 m2572 : 72|16@1+ (1,0) [0|65535] "mV"  Project
 SG_ CellVolt13_ROM_17 m2573 : 40|16@1+ (1,0) [0|65535] "mV"  Project
 SG_ CellVolt14_ROM_17 m2573 : 56|16@1+ (1,0) [0|65535] "mV"  Project
 SG_ CellVolt15_ROM_17 m2573 : 72|16@1+ (1,0) [0|65535] "mV"  Project
 SG_ CellVolt16_ROM_17 m2574 : 40|16@1+ (1,0) [0|65535] "mV"  Project
 SG_ Temp1_ROM_17 m2575 : 40|16@1- (0.1,0) [-3276.8|3276.7] "DegC"  Project
 SG_ Temp2_ROM_17 m2575 : 56|16@1- (0.1,0) [-3276.8|3276.7] "DegC"  Project
 SG_ Temp3_ROM_17 m2575 : 72|16@1- (0.1,0) [-3276.8|3276.7] "DegC"  Project
 SG_ TimeOfCurrentCharge_ROM_17 m2576 : 40|32@1+ (1,0) [0|4294967295] "DateTime"  Project
 SG_ RSOC_ROM_17 m2576 : 72|8@1+ (1,0) [0|255] "%"  Project
 SG_ SafetyTemp_ROM_17 m2577 : 40|16@1- (0.1,0) [-3276.8|3276.7] "DegC"  Project
 SG_ FaultLogTime_ROM_18 m2688 : 40|32@1+ (1,0) [0|4294967295] "DateTime"  Project
 SG_ Event_Counter_ROM_18 m2689 : 40|32@1+ (1,0) [0|4294967295] "Time"  Project
 SG_ FW_Ver_ROM_18 m2690 : 40|16@1+ (1,0) [0|65535] "Ver"  Project
 SG_ BatteryStatus_ROM_18 m2691 : 40|16@1+ (1,0) [0|65535] "Hex"  Project
 SG_ SafetyStatus_ROM_18 m2692 : 40|16@1+ (1,0) [0|65535] "Hex"  Project
 SG_ PackStatus_ROM_18 m2693 : 40|16@1+ (1,0) [0|65535] "Hex"  Project
 SG_ PFStatus_ROM_18 m2694 : 40|16@1+ (1,0) [0|65535] "Hex"  Project
 SG_ SafetyStatus2_ROM_18 m2695 : 40|8@1+ (1,0) [0|255] "Hex"  Project
 SG_ Current_ROM_18 m2696 : 40|32@1- (1,0) [-2147483648|2147483647] "mA"  Project
 SG_ CellVolt1_ROM_18 m2697 : 40|16@1+ (1,0) [0|65535] "mV"  Project
 SG_ CellVolt2_ROM_18 m2697 : 56|16@1+ (1,0) [0|65535] "mV"  Project
 SG_ CellVolt3_ROM_18 m2697 : 72|16@1+ (1,0) [0|65535] "mV"  Project
 SG_ CellVolt4_ROM_18 m2698 : 40|16@1+ (1,0) [0|65535] "mV"  Project
 SG_ CellVolt5_ROM_18 m2698 : 56|16@1+ (1,0) [0|65535] "mV"  Project
 SG_ CellVolt6_ROM_18 m2698 : 72|16@1+ (1,0) [0|65535] "mV"  Project
 SG_ CellVolt7_ROM_18 m2699 : 40|16@1+ (1,0) [0|65535] "mV"  Project
 SG_ CellVolt8_ROM_18 m2699 : 56|16@1+ (1,0) [0|65535] "mV"  Project
 SG_ CellVolt9_ROM_18 m2699 : 72|16@1+ (1,0) [0|65535] "mV"  Project
 SG_ CellVolt10_ROM_18 m2700 : 40|16@1+ (1,0) [0|65535] "mV"  Project
 SG_ CellVolt11_ROM_18 m2700 : 56|16@1+ (1,0) [0|65535] "mV"  Project
 SG_ CellVolt12_ROM_18 m2700 : 72|16@1+ (1,0) [0|65535] "mV"  Project
 SG_ CellVolt13_ROM_18 m2701 : 40|16@1+ (1,0) [0|65535] "mV"  Project
 SG_ CellVolt14_ROM_18 m2701 : 56|16@1+ (1,0) [0|65535] "mV"  Project
 SG_ CellVolt15_ROM_18 m2701 : 72|16@1+ (1,0) [0|65535] "mV"  Project
 SG_ CellVolt16_ROM_18 m2702 : 40|16@1+ (1,0) [0|65535] "mV"  Project
 SG_ Temp1_ROM_18 m2703 : 40|16@1- (0.1,0) [-3276.8|3276.7] "DegC"  Project
 SG_ Temp2_ROM_18 m2703 : 56|16@1- (0.1,0) [-3276.8|3276.7] "DegC"  Project
 SG_ Temp3_ROM_18 m2703 : 72|16@1- (0.1,0) [-3276.8|3276.7] "DegC"  Project
 SG_ TimeOfCurrentCharge_ROM_18 m2704 : 40|32@1+ (1,0) [0|4294967295] "DateTime"  Project
 SG_ RSOC_ROM_18 m2704 : 72|8@1+ (1,0) [0|255] "%"  Project
 SG_ SafetyTemp_ROM_18 m2705 : 40|16@1- (0.1,0) [-3276.8|3276.7] "DegC"  Project
 SG_ FaultLogTime_ROM_19 m2816 : 40|32@1+ (1,0) [0|4294967295] "DateTime"  Project
 SG_ Event_Counter_ROM_19 m2817 : 40|32@1+ (1,0) [0|4294967295] "Time"  Project
 SG_ FW_Ver_ROM_19 m2818 : 40|16@1+ (1,0) [0|65535] "Ver"  Project
 SG_ BatteryStatus_ROM_19 m2819 : 40|16@1+ (1,0) [0|65535] "Hex"  Project
 SG_ SafetyStatus_ROM_19 m2820 : 40|16@1+ (1,0) [0|65535] "Hex"  Project
 SG_ PackStatus_ROM_19 m2821 : 40|16@1+ (1,0) [0|65535] "Hex"  Project
 SG_ PFStatus_ROM_19 m2822 : 40|16@1+ (1,0) [0|65535] "Hex"  Project
 SG_ SafetyStatus2_ROM_19 m2823 : 40|8@1+ (1,0) [0|255] "Hex"  Project
 SG_ Current_ROM_19 m2824 : 40|32@1- (1,0) [-2147483648|2147483647] "mA"  Project
 SG_ CellVolt1_ROM_19 m2825 : 40|16@1+ (1,0) [0|65535] "mV"  Project
 SG_ CellVolt2_ROM_19 m2825 : 56|16@1+ (1,0) [0|65535] "mV"  Project
 SG_ CellVolt3_ROM_19 m2825 : 72|16@1+ (1,0) [0|65535] "mV"  Project
 SG_ CellVolt4_ROM_19 m2826 : 40|16@1+ (1,0) [0|65535] "mV"  Project
 SG_ CellVolt5_ROM_19 m2826 : 56|16@1+ (1,0) [0|65535] "mV"  Project
 SG_ CellVolt6_ROM_19 m2826 : 72|16@1+ (1,0) [0|65535] "mV"  Project
 SG_ CellVolt7_ROM_19 m2827 : 40|16@1+ (1,0) [0|65535] "mV"  Project
 SG_ CellVolt8_ROM_19 m2827 : 56|16@1+ (1,0) [0|65535] "mV"  Project
 SG_ CellVolt9_ROM_19 m2827 : 72|16@1+ (1,0) [0|65535] "mV"  Project
 SG_ CellVolt10_ROM_19 m2828 : 40|16@1+ (1,0) [0|65535] "mV"  Project
 SG_ CellVolt11_ROM_19 m2828 : 56|16@1+ (1,0) [0|65535] "mV"  Project
 SG_ CellVolt12_ROM_19 m2828 : 72|16@1+ (1,0) [0|65535] "mV"  Project
 SG_ CellVolt13_ROM_19 m2829 : 40|16@1+ (1,0) [0|65535] "mV"  Project
 SG_ CellVolt14_ROM_19 m2829 : 56|16@1+ (1,0) [0|65535] "mV"  Project
 SG_ CellVolt15_ROM_19 m2829 : 72|16@1+ (1,0) [0|65535] "mV"  Project
 SG_ CellVolt16_ROM_19 m2830 : 40|16@1+ (1,0) [0|65535] "mV"  Project
 SG_ Temp1_ROM_19 m2831 : 40|16@1- (0.1,0) [-3276.8|3276.7] "DegC"  Project
 SG_ Temp2_ROM_19 m2831 : 56|16@1- (0.1,0) [-3276.8|3276.7] "DegC"  Project
 SG_ Temp3_ROM_19 m2831 : 72|16@1- (0.1,0) [-3276.8|3276.7] "DegC"  Project
 SG_ TimeOfCurrentCharge_ROM_19 m2832 : 40|32@1+ (1,0) [0|4294967295] "DateTime"  Project
 SG_ RSOC_ROM_19 m2832 : 72|8@1+ (1,0) [0|255] "%"  Project
 SG_ SafetyTemp_ROM_19 m2833 : 40|16@1- (0.1,0) [-3276.8|3276.7] "DegC"  Project
 SG_ FaultLogTime_ROM_20 m2944 : 40|32@1+ (1,0) [0|4294967295] "DateTime"  Project
 SG_ Event_Counter_ROM_20 m2945 : 40|32@1+ (1,0) [0|4294967295] "Time"  Project
 SG_ FW_Ver_ROM_20 m2946 : 40|16@1+ (1,0) [0|65535] "Ver"  Project
 SG_ BatteryStatus_ROM_20 m2947 : 40|16@1+ (1,0) [0|65535] "Hex"  Project
 SG_ SafetyStatus_ROM_20 m2948 : 40|16@1+ (1,0) [0|65535] "Hex"  Project
 SG_ PackStatus_ROM_20 m2949 : 40|16@1+ (1,0) [0|65535] "Hex"  Project
 SG_ PFStatus_ROM_20 m2950 : 40|16@1+ (1,0) [0|65535] "Hex"  Project
 SG_ SafetyStatus2_ROM_20 m2951 : 40|8@1+ (1,0) [0|255] "Hex"  Project
 SG_ Current_ROM_20 m2952 : 40|32@1- (1,0) [-2147483648|2147483647] "mA"  Project
 SG_ CellVolt1_ROM_20 m2953 : 40|16@1+ (1,0) [0|65535] "mV"  Project
 SG_ CellVolt2_ROM_20 m2953 : 56|16@1+ (1,0) [0|65535] "mV"  Project
 SG_ CellVolt3_ROM_20 m2953 : 72|16@1+ (1,0) [0|65535] "mV"  Project
 SG_ CellVolt4_ROM_20 m2954 : 40|16@1+ (1,0) [0|65535] "mV"  Project
 SG_ CellVolt5_ROM_20 m2954 : 56|16@1+ (1,0) [0|65535] "mV"  Project
 SG_ CellVolt6_ROM_20 m2954 : 72|16@1+ (1,0) [0|65535] "mV"  Project
 SG_ CellVolt7_ROM_20 m2955 : 40|16@1+ (1,0) [0|65535] "mV"  Project
 SG_ CellVolt8_ROM_20 m2955 : 56|16@1+ (1,0) [0|65535] "mV"  Project
 SG_ CellVolt9_ROM_20 m2955 : 72|16@1+ (1,0) [0|65535] "mV"  Project
 SG_ CellVolt10_ROM_20 m2956 : 40|16@1+ (1,0) [0|65535] "mV"  Project
 SG_ CellVolt11_ROM_20 m2956 : 56|16@1+ (1,0) [0|65535] "mV"  Project
 SG_ CellVolt12_ROM_20 m2956 : 72|16@1+ (1,0) [0|65535] "mV"  Project
 SG_ CellVolt13_ROM_20 m2957 : 40|16@1+ (1,0) [0|65535] "mV"  Project
 SG_ CellVolt14_ROM_20 m2957 : 56|16@1+ (1,0) [0|65535] "mV"  Project
 SG_ CellVolt15_ROM_20 m2957 : 72|16@1+ (1,0) [0|65535] "mV"  Project
 SG_ CellVolt16_ROM_20 m2958 : 40|16@1+ (1,0) [0|65535] "mV"  Project
 SG_ Temp1_ROM_20 m2959 : 40|16@1- (0.1,0) [-3276.8|3276.7] "DegC"  Project
 SG_ Temp2_ROM_20 m2959 : 56|16@1- (0.1,0) [-3276.8|3276.7] "DegC"  Project
 SG_ Temp3_ROM_20 m2959 : 72|16@1- (0.1,0) [-3276.8|3276.7] "DegC"  Project
 SG_ TimeOfCurrentCharge_ROM_20 m2960 : 40|32@1+ (1,0) [0|4294967295] "DateTime"  Project
 SG_ RSOC_ROM_20 m2960 : 72|8@1+ (1,0) [0|255] "%"  Project
 SG_ SafetyTemp_ROM_20 m2961 : 40|16@1- (0.1,0) [-3276.8|3276.7] "DegC"  Project
 SG_ FaultLogTime_ROM_21 m3072 : 40|32@1+ (1,0) [0|4294967295] "DateTime"  Project
 SG_ Event_Counter_ROM_21 m3073 : 40|32@1+ (1,0) [0|4294967295] "Time"  Project
 SG_ FW_Ver_ROM_21 m3074 : 40|16@1+ (1,0) [0|65535] "Ver"  Project
 SG_ BatteryStatus_ROM_21 m3075 : 40|16@1+ (1,0) [0|65535] "Hex"  Project
 SG_ SafetyStatus_ROM_21 m3076 : 40|16@1+ (1,0) [0|65535] "Hex"  Project
 SG_ PackStatus_ROM_21 m3077 : 40|16@1+ (1,0) [0|65535] "Hex"  Project
 SG_ PFStatus_ROM_21 m3078 : 40|16@1+ (1,0) [0|65535] "Hex"  Project
 SG_ SafetyStatus2_ROM_21 m3079 : 40|8@1+ (1,0) [0|255] "Hex"  Project
 SG_ Current_ROM_21 m3080 : 40|32@1- (1,0) [-2147483648|2147483647] "mA"  Project
 SG_ CellVolt1_ROM_21 m3081 : 40|16@1+ (1,0) [0|65535] "mV"  Project
 SG_ CellVolt2_ROM_21 m3081 : 56|16@1+ (1,0) [0|65535] "mV"  Project
 SG_ CellVolt3_ROM_21 m3081 : 72|16@1+ (1,0) [0|65535] "mV"  Project
 SG_ CellVolt4_ROM_21 m3082 : 40|16@1+ (1,0) [0|65535] "mV"  Project
 SG_ CellVolt5_ROM_21 m3082 : 56|16@1+ (1,0) [0|65535] "mV"  Project
 SG_ CellVolt6_ROM_21 m3082 : 72|16@1+ (1,0) [0|65535] "mV"  Project
 SG_ CellVolt7_ROM_21 m3083 : 40|16@1+ (1,0) [0|65535] "mV"  Project
 SG_ CellVolt8_ROM_21 m3083 : 56|16@1+ (1,0) [0|65535] "mV"  Project
 SG_ CellVolt9_ROM_21 m3083 : 72|16@1+ (1,0) [0|65535] "mV"  Project
 SG_ CellVolt10_ROM_21 m3084 : 40|16@1+ (1,0) [0|65535] "mV"  Project
 SG_ CellVolt11_ROM_21 m3084 : 56|16@1+ (1,0) [0|65535] "mV"  Project
 SG_ CellVolt12_ROM_21 m3084 : 72|16@1+ (1,0) [0|65535] "mV"  Project
 SG_ CellVolt13_ROM_21 m3085 : 40|16@1+ (1,0) [0|65535] "mV"  Project
 SG_ CellVolt14_ROM_21 m3085 : 56|16@1+ (1,0) [0|65535] "mV"  Project
 SG_ CellVolt15_ROM_21 m3085 : 72|16@1+ (1,0) [0|65535] "mV"  Project
 SG_ CellVolt16_ROM_21 m3086 : 40|16@1+ (1,0) [0|65535] "mV"  Project
 SG_ Temp1_ROM_21 m3087 : 40|16@1- (0.1,0) [-3276.8|3276.7] "DegC"  Project
 SG_ Temp2_ROM_21 m3087 : 56|16@1- (0.1,0) [-3276.8|3276.7] "DegC"  Project
 SG_ Temp3_ROM_21 m3087 : 72|16@1- (0.1,0) [-3276.8|3276.7] "DegC"  Project
 SG_ TimeOfCurrentCharge_ROM_21 m3088 : 40|32@1+ (1,0) [0|4294967295] "DateTime"  Project
 SG_ RSOC_ROM_21 m3088 : 72|8@1+ (1,0) [0|255] "%"  Project
 SG_ SafetyTemp_ROM_21 m3089 : 40|16@1- (0.1,0) [-3276.8|3276.7] "DegC"  Project
 SG_ FaultLogTime_ROM_22 m3200 : 40|32@1+ (1,0) [0|4294967295] "DateTime"  Project
 SG_ Event_Counter_ROM_22 m3201 : 40|32@1+ (1,0) [0|4294967295] "Time"  Project
 SG_ FW_Ver_ROM_22 m3202 : 40|16@1+ (1,0) [0|65535] "Ver"  Project
 SG_ BatteryStatus_ROM_22 m3203 : 40|16@1+ (1,0) [0|65535] "Hex"  Project
 SG_ SafetyStatus_ROM_22 m3204 : 40|16@1+ (1,0) [0|65535] "Hex"  Project
 SG_ PackStatus_ROM_22 m3205 : 40|16@1+ (1,0) [0|65535] "Hex"  Project
 SG_ PFStatus_ROM_22 m3206 : 40|16@1+ (1,0) [0|65535] "Hex"  Project
 SG_ SafetyStatus2_ROM_22 m3207 : 40|8@1+ (1,0) [0|255] "Hex"  Project
 SG_ Current_ROM_22 m3208 : 40|32@1- (1,0) [-2147483648|2147483647] "mA"  Project
 SG_ CellVolt1_ROM_22 m3209 : 40|16@1+ (1,0) [0|65535] "mV"  Project
 SG_ CellVolt2_ROM_22 m3209 : 56|16@1+ (1,0) [0|65535] "mV"  Project
 SG_ CellVolt3_ROM_22 m3209 : 72|16@1+ (1,0) [0|65535] "mV"  Project
 SG_ CellVolt4_ROM_22 m3210 : 40|16@1+ (1,0) [0|65535] "mV"  Project
 SG_ CellVolt5_ROM_22 m3210 : 56|16@1+ (1,0) [0|65535] "mV"  Project
 SG_ CellVolt6_ROM_22 m3210 : 72|16@1+ (1,0) [0|65535] "mV"  Project
 SG_ CellVolt7_ROM_22 m3211 : 40|16@1+ (1,0) [0|65535] "mV"  Project
 SG_ CellVolt8_ROM_22 m3211 : 56|16@1+ (1,0) [0|65535] "mV"  Project
 SG_ CellVolt9_ROM_22 m3211 : 72|16@1+ (1,0) [0|65535] "mV"  Project
 SG_ CellVolt10_ROM_22 m3212 : 40|16@1+ (1,0) [0|65535] "mV"  Project
 SG_ CellVolt11_ROM_22 m3212 : 56|16@1+ (1,0) [0|65535] "mV"  Project
 SG_ CellVolt12_ROM_22 m3212 : 72|16@1+ (1,0) [0|65535] "mV"  Project
 SG_ CellVolt13_ROM_22 m3213 : 40|16@1+ (1,0) [0|65535] "mV"  Project
 SG_ CellVolt14_ROM_22 m3213 : 56|16@1+ (1,0) [0|65535] "mV"  Project
 SG_ CellVolt15_ROM_22 m3213 : 72|16@1+ (1,0) [0|65535] "mV"  Project
 SG_ CellVolt16_ROM_22 m3214 : 40|16@1+ (1,0) [0|65535] "mV"  Project
 SG_ Temp1_ROM_22 m3215 : 40|16@1- (0.1,0) [-3276.8|3276.7] "DegC"  Project
 SG_ Temp2_ROM_22 m3215 : 56|16@1- (0.1,0) [-3276.8|3276.7] "DegC"  Project
 SG_ Temp3_ROM_22 m3215 : 72|16@1- (0.1,0) [-3276.8|3276.7] "DegC"  Project
 SG_ TimeOfCurrentCharge_ROM_22 m3216 : 40|32@1+ (1,0) [0|4294967295] "DateTime"  Project
 SG_ RSOC_ROM_22 m3216 : 72|8@1+ (1,0) [0|255] "%"  Project
 SG_ SafetyTemp_ROM_22 m3217 : 40|16@1- (0.1,0) [-3276.8|3276.7] "DegC"  Project
 SG_ FaultLogTime_ROM_23 m3328 : 40|32@1+ (1,0) [0|4294967295] "DateTime"  Project
 SG_ Event_Counter_ROM_23 m3329 : 40|32@1+ (1,0) [0|4294967295] "Time"  Project
 SG_ FW_Ver_ROM_23 m3330 : 40|16@1+ (1,0) [0|65535] "Ver"  Project
 SG_ BatteryStatus_ROM_23 m3331 : 40|16@1+ (1,0) [0|65535] "Hex"  Project
 SG_ SafetyStatus_ROM_23 m3332 : 40|16@1+ (1,0) [0|65535] "Hex"  Project
 SG_ PackStatus_ROM_23 m3333 : 40|16@1+ (1,0) [0|65535] "Hex"  Project
 SG_ PFStatus_ROM_23 m3334 : 40|16@1+ (1,0) [0|65535] "Hex"  Project
 SG_ SafetyStatus2_ROM_23 m3335 : 40|8@1+ (1,0) [0|255] "Hex"  Project
 SG_ Current_ROM_23 m3336 : 40|32@1- (1,0) [-2147483648|2147483647] "mA"  Project
 SG_ CellVolt1_ROM_23 m3337 : 40|16@1+ (1,0) [0|65535] "mV"  Project
 SG_ CellVolt2_ROM_23 m3337 : 56|16@1+ (1,0) [0|65535] "mV"  Project
 SG_ CellVolt3_ROM_23 m3337 : 72|16@1+ (1,0) [0|65535] "mV"  Project
 SG_ CellVolt4_ROM_23 m3338 : 40|16@1+ (1,0) [0|65535] "mV"  Project
 SG_ CellVolt5_ROM_23 m3338 : 56|16@1+ (1,0) [0|65535] "mV"  Project
 SG_ CellVolt6_ROM_23 m3338 : 72|16@1+ (1,0) [0|65535] "mV"  Project
 SG_ CellVolt7_ROM_23 m3339 : 40|16@1+ (1,0) [0|65535] "mV"  Project
 SG_ CellVolt8_ROM_23 m3339 : 56|16@1+ (1,0) [0|65535] "mV"  Project
 SG_ CellVolt9_ROM_23 m3339 : 72|16@1+ (1,0) [0|65535] "mV"  Project
 SG_ CellVolt10_ROM_23 m3340 : 40|16@1+ (1,0) [0|65535] "mV"  Project
 SG_ CellVolt11_ROM_23 m3340 : 56|16@1+ (1,0) [0|65535] "mV"  Project
 SG_ CellVolt12_ROM_23 m3340 : 72|16@1+ (1,0) [0|65535] "mV"  Project
 SG_ CellVolt13_ROM_23 m3341 : 40|16@1+ (1,0) [0|65535] "mV"  Project
 SG_ CellVolt14_ROM_23 m3341 : 56|16@1+ (1,0) [0|65535] "mV"  Project
 SG_ CellVolt15_ROM_23 m3341 : 72|16@1+ (1,0) [0|65535] "mV"  Project
 SG_ CellVolt16_ROM_23 m3342 : 40|16@1+ (1,0) [0|65535] "mV"  Project
 SG_ Temp1_ROM_23 m3343 : 40|16@1- (0.1,0) [-3276.8|3276.7] "DegC"  Project
 SG_ Temp2_ROM_23 m3343 : 56|16@1- (0.1,0) [-3276.8|3276.7] "DegC"  Project
 SG_ Temp3_ROM_23 m3343 : 72|16@1- (0.1,0) [-3276.8|3276.7] "DegC"  Project
 SG_ TimeOfCurrentCharge_ROM_23 m3344 : 40|32@1+ (1,0) [0|4294967295] "DateTime"  Project
 SG_ RSOC_ROM_23 m3344 : 72|8@1+ (1,0) [0|255] "%"  Project
 SG_ SafetyTemp_ROM_23 m3345 : 40|16@1- (0.1,0) [-3276.8|3276.7] "DegC"  Project
 SG_ FaultLogTime_ROM_24 m3456 : 40|32@1+ (1,0) [0|4294967295] "DateTime"  Project
 SG_ Event_Counter_ROM_24 m3457 : 40|32@1+ (1,0) [0|4294967295] "Time"  Project
 SG_ FW_Ver_ROM_24 m3458 : 40|16@1+ (1,0) [0|65535] "Ver"  Project
 SG_ BatteryStatus_ROM_24 m3459 : 40|16@1+ (1,0) [0|65535] "Hex"  Project
 SG_ SafetyStatus_ROM_24 m3460 : 40|16@1+ (1,0) [0|65535] "Hex"  Project
 SG_ PackStatus_ROM_24 m3461 : 40|16@1+ (1,0) [0|65535] "Hex"  Project
 SG_ PFStatus_ROM_24 m3462 : 40|16@1+ (1,0) [0|65535] "Hex"  Project
 SG_ SafetyStatus2_ROM_24 m3463 : 40|8@1+ (1,0) [0|255] "Hex"  Project
 SG_ Current_ROM_24 m3464 : 40|32@1- (1,0) [-2147483648|2147483647] "mA"  Project
 SG_ CellVolt1_ROM_24 m3465 : 40|16@1+ (1,0) [0|65535] "mV"  Project
 SG_ CellVolt2_ROM_24 m3465 : 56|16@1+ (1,0) [0|65535] "mV"  Project
 SG_ CellVolt3_ROM_24 m3465 : 72|16@1+ (1,0) [0|65535] "mV"  Project
 SG_ CellVolt4_ROM_24 m3466 : 40|16@1+ (1,0) [0|65535] "mV"  Project
 SG_ CellVolt5_ROM_24 m3466 : 56|16@1+ (1,0) [0|65535] "mV"  Project
 SG_ CellVolt6_ROM_24 m3466 : 72|16@1+ (1,0) [0|65535] "mV"  Project
 SG_ CellVolt7_ROM_24 m3467 : 40|16@1+ (1,0) [0|65535] "mV"  Project
 SG_ CellVolt8_ROM_24 m3467 : 56|16@1+ (1,0) [0|65535] "mV"  Project
 SG_ CellVolt9_ROM_24 m3467 : 72|16@1+ (1,0) [0|65535] "mV"  Project
 SG_ CellVolt10_ROM_24 m3468 : 40|16@1+ (1,0) [0|65535] "mV"  Project
 SG_ CellVolt11_ROM_24 m3468 : 56|16@1+ (1,0) [0|65535] "mV"  Project
 SG_ CellVolt12_ROM_24 m3468 : 72|16@1+ (1,0) [0|65535] "mV"  Project
 SG_ CellVolt13_ROM_24 m3469 : 40|16@1+ (1,0) [0|65535] "mV"  Project
 SG_ CellVolt14_ROM_24 m3469 : 56|16@1+ (1,0) [0|65535] "mV"  Project
 SG_ CellVolt15_ROM_24 m3469 : 72|16@1+ (1,0) [0|65535] "mV"  Project
 SG_ CellVolt16_ROM_24 m3470 : 40|16@1+ (1,0) [0|65535] "mV"  Project
 SG_ Temp1_ROM_24 m3471 : 40|16@1- (0.1,0) [-3276.8|3276.7] "DegC"  Project
 SG_ Temp2_ROM_24 m3471 : 56|16@1- (0.1,0) [-3276.8|3276.7] "DegC"  Project
 SG_ Temp3_ROM_24 m3471 : 72|16@1- (0.1,0) [-3276.8|3276.7] "DegC"  Project
 SG_ TimeOfCurrentCharge_ROM_24 m3472 : 40|32@1+ (1,0) [0|4294967295] "DateTime"  Project
 SG_ RSOC_ROM_24 m3472 : 72|8@1+ (1,0) [0|255] "%"  Project
 SG_ SafetyTemp_ROM_24 m3473 : 40|16@1- (0.1,0) [-3276.8|3276.7] "DegC"  Project
 SG_ FaultLogTime_ROM_25 m3584 : 40|32@1+ (1,0) [0|4294967295] "DateTime"  Project
 SG_ Event_Counter_ROM_25 m3585 : 40|32@1+ (1,0) [0|4294967295] "Time"  Project
 SG_ FW_Ver_ROM_25 m3586 : 40|16@1+ (1,0) [0|65535] "Ver"  Project
 SG_ BatteryStatus_ROM_25 m3587 : 40|16@1+ (1,0) [0|65535] "Hex"  Project
 SG_ SafetyStatus_ROM_25 m3588 : 40|16@1+ (1,0) [0|65535] "Hex"  Project
 SG_ PackStatus_ROM_25 m3589 : 40|16@1+ (1,0) [0|65535] "Hex"  Project
 SG_ PFStatus_ROM_25 m3590 : 40|16@1+ (1,0) [0|65535] "Hex"  Project
 SG_ SafetyStatus2_ROM_25 m3591 : 40|8@1+ (1,0) [0|255] "Hex"  Project
 SG_ Current_ROM_25 m3592 : 40|32@1- (1,0) [-2147483648|2147483647] "mA"  Project
 SG_ CellVolt1_ROM_25 m3593 : 40|16@1+ (1,0) [0|65535] "mV"  Project
 SG_ CellVolt2_ROM_25 m3593 : 56|16@1+ (1,0) [0|65535] "mV"  Project
 SG_ CellVolt3_ROM_25 m3593 : 72|16@1+ (1,0) [0|65535] "mV"  Project
 SG_ CellVolt4_ROM_25 m3594 : 40|16@1+ (1,0) [0|65535] "mV"  Project
 SG_ CellVolt5_ROM_25 m3594 : 56|16@1+ (1,0) [0|65535] "mV"  Project
 SG_ CellVolt6_ROM_25 m3594 : 72|16@1+ (1,0) [0|65535] "mV"  Project
 SG_ CellVolt7_ROM_25 m3595 : 40|16@1+ (1,0) [0|65535] "mV"  Project
 SG_ CellVolt8_ROM_25 m3595 : 56|16@1+ (1,0) [0|65535] "mV"  Project
 SG_ CellVolt9_ROM_25 m3595 : 72|16@1+ (1,0) [0|65535] "mV"  Project
 SG_ CellVolt10_ROM_25 m3596 : 40|16@1+ (1,0) [0|65535] "mV"  Project
 SG_ CellVolt11_ROM_25 m3596 : 56|16@1+ (1,0) [0|65535] "mV"  Project
 SG_ CellVolt12_ROM_25 m3596 : 72|16@1+ (1,0) [0|65535] "mV"  Project
 SG_ CellVolt13_ROM_25 m3597 : 40|16@1+ (1,0) [0|65535] "mV"  Project
 SG_ CellVolt14_ROM_25 m3597 : 56|16@1+ (1,0) [0|65535] "mV"  Project
 SG_ CellVolt15_ROM_25 m3597 : 72|16@1+ (1,0) [0|65535] "mV"  Project
 SG_ CellVolt16_ROM_25 m3598 : 40|16@1+ (1,0) [0|65535] "mV"  Project
 SG_ Temp1_ROM_25 m3599 : 40|16@1- (0.1,0) [-3276.8|3276.7] "DegC"  Project
 SG_ Temp2_ROM_25 m3599 : 56|16@1- (0.1,0) [-3276.8|3276.7] "DegC"  Project
 SG_ Temp3_ROM_25 m3599 : 72|16@1- (0.1,0) [-3276.8|3276.7] "DegC"  Project
 SG_ TimeOfCurrentCharge_ROM_25 m3600 : 40|32@1+ (1,0) [0|4294967295] "DateTime"  Project
 SG_ RSOC_ROM_25 m3600 : 72|8@1+ (1,0) [0|255] "%"  Project
 SG_ SafetyTemp_ROM_25 m3601 : 40|16@1- (0.1,0) [-3276.8|3276.7] "DegC"  Project
 SG_ FaultLogTime_ROM_26 m3712 : 40|32@1+ (1,0) [0|4294967295] "DateTime"  Project
 SG_ Event_Counter_ROM_26 m3713 : 40|32@1+ (1,0) [0|4294967295] "Time"  Project
 SG_ FW_Ver_ROM_26 m3714 : 40|16@1+ (1,0) [0|65535] "Ver"  Project
 SG_ BatteryStatus_ROM_26 m3715 : 40|16@1+ (1,0) [0|65535] "Hex"  Project
 SG_ SafetyStatus_ROM_26 m3716 : 40|16@1+ (1,0) [0|65535] "Hex"  Project
 SG_ PackStatus_ROM_26 m3717 : 40|16@1+ (1,0) [0|65535] "Hex"  Project
 SG_ PFStatus_ROM_26 m3718 : 40|16@1+ (1,0) [0|65535] "Hex"  Project
 SG_ SafetyStatus2_ROM_26 m3719 : 40|8@1+ (1,0) [0|255] "Hex"  Project
 SG_ Current_ROM_26 m3720 : 40|32@1- (1,0) [-2147483648|2147483647] "mA"  Project
 SG_ CellVolt1_ROM_26 m3721 : 40|16@1+ (1,0) [0|65535] "mV"  Project
 SG_ CellVolt2_ROM_26 m3721 : 56|16@1+ (1,0) [0|65535] "mV"  Project
 SG_ CellVolt3_ROM_26 m3721 : 72|16@1+ (1,0) [0|65535] "mV"  Project
 SG_ CellVolt4_ROM_26 m3722 : 40|16@1+ (1,0) [0|65535] "mV"  Project
 SG_ CellVolt5_ROM_26 m3722 : 56|16@1+ (1,0) [0|65535] "mV"  Project
 SG_ CellVolt6_ROM_26 m3722 : 72|16@1+ (1,0) [0|65535] "mV"  Project
 SG_ CellVolt7_ROM_26 m3723 : 40|16@1+ (1,0) [0|65535] "mV"  Project
 SG_ CellVolt8_ROM_26 m3723 : 56|16@1+ (1,0) [0|65535] "mV"  Project
 SG_ CellVolt9_ROM_26 m3723 : 72|16@1+ (1,0) [0|65535] "mV"  Project
 SG_ CellVolt10_ROM_26 m3724 : 40|16@1+ (1,0) [0|65535] "mV"  Project
 SG_ CellVolt11_ROM_26 m3724 : 56|16@1+ (1,0) [0|65535] "mV"  Project
 SG_ CellVolt12_ROM_26 m3724 : 72|16@1+ (1,0) [0|65535] "mV"  Project
 SG_ CellVolt13_ROM_26 m3725 : 40|16@1+ (1,0) [0|65535] "mV"  Project
 SG_ CellVolt14_ROM_26 m3725 : 56|16@1+ (1,0) [0|65535] "mV"  Project
 SG_ CellVolt15_ROM_26 m3725 : 72|16@1+ (1,0) [0|65535] "mV"  Project
 SG_ CellVolt16_ROM_26 m3726 : 40|16@1+ (1,0) [0|65535] "mV"  Project
 SG_ Temp1_ROM_26 m3727 : 40|16@1- (0.1,0) [-3276.8|3276.7] "DegC"  Project
 SG_ Temp2_ROM_26 m3727 : 56|16@1- (0.1,0) [-3276.8|3276.7] "DegC"  Project
 SG_ Temp3_ROM_26 m3727 : 72|16@1- (0.1,0) [-3276.8|3276.7] "DegC"  Project
 SG_ TimeOfCurrentCharge_ROM_26 m3728 : 40|32@1+ (1,0) [0|4294967295] "DateTime"  Project
 SG_ RSOC_ROM_26 m3728 : 72|8@1+ (1,0) [0|255] "%"  Project
 SG_ SafetyTemp_ROM_26 m3729 : 40|16@1- (0.1,0) [-3276.8|3276.7] "DegC"  Project
 SG_ FaultLogTime_ROM_27 m3840 : 40|32@1+ (1,0) [0|4294967295] "DateTime"  Project
 SG_ Event_Counter_ROM_27 m3841 : 40|32@1+ (1,0) [0|4294967295] "Time"  Project
 SG_ FW_Ver_ROM_27 m3842 : 40|16@1+ (1,0) [0|65535] "Ver"  Project
 SG_ BatteryStatus_ROM_27 m3843 : 40|16@1+ (1,0) [0|65535] "Hex"  Project
 SG_ SafetyStatus_ROM_27 m3844 : 40|16@1+ (1,0) [0|65535] "Hex"  Project
 SG_ PackStatus_ROM_27 m3845 : 40|16@1+ (1,0) [0|65535] "Hex"  Project
 SG_ PFStatus_ROM_27 m3846 : 40|16@1+ (1,0) [0|65535] "Hex"  Project
 SG_ SafetyStatus2_ROM_27 m3847 : 40|8@1+ (1,0) [0|255] "Hex"  Project
 SG_ Current_ROM_27 m3848 : 40|32@1- (1,0) [-2147483648|2147483647] "mA"  Project
 SG_ CellVolt1_ROM_27 m3849 : 40|16@1+ (1,0) [0|65535] "mV"  Project
 SG_ CellVolt2_ROM_27 m3849 : 56|16@1+ (1,0) [0|65535] "mV"  Project
 SG_ CellVolt3_ROM_27 m3849 : 72|16@1+ (1,0) [0|65535] "mV"  Project
 SG_ CellVolt4_ROM_27 m3850 : 40|16@1+ (1,0) [0|65535] "mV"  Project
 SG_ CellVolt5_ROM_27 m3850 : 56|16@1+ (1,0) [0|65535] "mV"  Project
 SG_ CellVolt6_ROM_27 m3850 : 72|16@1+ (1,0) [0|65535] "mV"  Project
 SG_ CellVolt7_ROM_27 m3851 : 40|16@1+ (1,0) [0|65535] "mV"  Project
 SG_ CellVolt8_ROM_27 m3851 : 56|16@1+ (1,0) [0|65535] "mV"  Project
 SG_ CellVolt9_ROM_27 m3851 : 72|16@1+ (1,0) [0|65535] "mV"  Project
 SG_ CellVolt10_ROM_27 m3852 : 40|16@1+ (1,0) [0|65535] "mV"  Project
 SG_ CellVolt11_ROM_27 m3852 : 56|16@1+ (1,0) [0|65535] "mV"  Project
 SG_ CellVolt12_ROM_27 m3852 : 72|16@1+ (1,0) [0|65535] "mV"  Project
 SG_ CellVolt13_ROM_27 m3853 : 40|16@1+ (1,0) [0|65535] "mV"  Project
 SG_ CellVolt14_ROM_27 m3853 : 56|16@1+ (1,0) [0|65535] "mV"  Project
 SG_ CellVolt15_ROM_27 m3853 : 72|16@1+ (1,0) [0|65535] "mV"  Project
 SG_ CellVolt16_ROM_27 m3854 : 40|16@1+ (1,0) [0|65535] "mV"  Project
 SG_ Temp1_ROM_27 m3855 : 40|16@1- (0.1,0) [-3276.8|3276.7] "DegC"  Project
 SG_ Temp2_ROM_27 m3855 : 56|16@1- (0.1,0) [-3276.8|3276.7] "DegC"  Project
 SG_ Temp3_ROM_27 m3855 : 72|16@1- (0.1,0) [-3276.8|3276.7] "DegC"  Project
 SG_ TimeOfCurrentCharge_ROM_27 m3856 : 40|32@1+ (1,0) [0|4294967295] "DateTime"  Project
 SG_ RSOC_ROM_27 m3856 : 72|8@1+ (1,0) [0|255] "%"  Project
 SG_ SafetyTemp_ROM_27 m3857 : 40|16@1- (0.1,0) [-3276.8|3276.7] "DegC"  Project
 SG_ FaultLogTime_ROM_28 m3968 : 40|32@1+ (1,0) [0|4294967295] "DateTime"  Project
 SG_ Event_Counter_ROM_28 m3969 : 40|32@1+ (1,0) [0|4294967295] "Time"  Project
 SG_ FW_Ver_ROM_28 m3970 : 40|16@1+ (1,0) [0|65535] "Ver"  Project
 SG_ BatteryStatus_ROM_28 m3971 : 40|16@1+ (1,0) [0|65535] "Hex"  Project
 SG_ SafetyStatus_ROM_28 m3972 : 40|16@1+ (1,0) [0|65535] "Hex"  Project
 SG_ PackStatus_ROM_28 m3973 : 40|16@1+ (1,0) [0|65535] "Hex"  Project
 SG_ PFStatus_ROM_28 m3974 : 40|16@1+ (1,0) [0|65535] "Hex"  Project
 SG_ SafetyStatus2_ROM_28 m3975 : 40|8@1+ (1,0) [0|255] "Hex"  Project
 SG_ Current_ROM_28 m3976 : 40|32@1- (1,0) [-2147483648|2147483647] "mA"  Project
 SG_ CellVolt1_ROM_28 m3977 : 40|16@1+ (1,0) [0|65535] "mV"  Project
 SG_ CellVolt2_ROM_28 m3977 : 56|16@1+ (1,0) [0|65535] "mV"  Project
 SG_ CellVolt3_ROM_28 m3977 : 72|16@1+ (1,0) [0|65535] "mV"  Project
 SG_ CellVolt4_ROM_28 m3978 : 40|16@1+ (1,0) [0|65535] "mV"  Project
 SG_ CellVolt5_ROM_28 m3978 : 56|16@1+ (1,0) [0|65535] "mV"  Project
 SG_ CellVolt6_ROM_28 m3978 : 72|16@1+ (1,0) [0|65535] "mV"  Project
 SG_ CellVolt7_ROM_28 m3979 : 40|16@1+ (1,0) [0|65535] "mV"  Project
 SG_ CellVolt8_ROM_28 m3979 : 56|16@1+ (1,0) [0|65535] "mV"  Project
 SG_ CellVolt9_ROM_28 m3979 : 72|16@1+ (1,0) [0|65535] "mV"  Project
 SG_ CellVolt10_ROM_28 m3980 : 40|16@1+ (1,0) [0|65535] "mV"  Project
 SG_ CellVolt11_ROM_28 m3980 : 56|16@1+ (1,0) [0|65535] "mV"  Project
 SG_ CellVolt12_ROM_28 m3980 : 72|16@1+ (1,0) [0|65535] "mV"  Project
 SG_ CellVolt13_ROM_28 m3981 : 40|16@1+ (1,0) [0|65535] "mV"  Project
 SG_ CellVolt14_ROM_28 m3981 : 56|16@1+ (1,0) [0|65535] "mV"  Project
 SG_ CellVolt15_ROM_28 m3981 : 72|16@1+ (1,0) [0|65535] "mV"  Project
 SG_ CellVolt16_ROM_28 m3982 : 40|16@1+ (1,0) [0|65535] "mV"  Project
 SG_ Temp1_ROM_28 m3983 : 40|16@1- (0.1,0) [-3276.8|3276.7] "DegC"  Project
 SG_ Temp2_ROM_28 m3983 : 56|16@1- (0.1,0) [-3276.8|3276.7] "DegC"  Project
 SG_ Temp3_ROM_28 m3983 : 72|16@1- (0.1,0) [-3276.8|3276.7] "DegC"  Project
 SG_ TimeOfCurrentCharge_ROM_28 m3984 : 40|32@1+ (1,0) [0|4294967295] "DateTime"  Project
 SG_ RSOC_ROM_28 m3984 : 72|8@1+ (1,0) [0|255] "%"  Project
 SG_ SafetyTemp_ROM_28 m3985 : 40|16@1- (0.1,0) [-3276.8|3276.7] "DegC"  Project

BA_DEF_  "BusType" STRING ;
BA_DEF_DEF_ "BusType" "";
BA_ "BusType" "CAN";
SIG_VALTYPE_ 1875 BMS_RSOC : 1;
SIG_VALTYPE_ 1875 BMS_ASOC : 1;
SIG_VALTYPE_ 1875 BMS_RC : 1;
SIG_VALTYPE_ 1875 BMS_DCR : 1;
SIG_VALTYPE_ 1875 BMS_FDCR : 1;
SIG_VALTYPE_ 1875 BMS_UserRC : 1;
SIG_VALTYPE_ 1875 BMS_UserRSOC : 1;
SIG_VALTYPE_ 1875 BMS_DeltaRC : 1;
SIG_VALTYPE_ 1875 BMS_StartRSOC : 1;
SIG_VALTYPE_ 1875 BMS_StartFDCR : 1;
SIG_VALTYPE_ 1875 BMS_RCminCutoff : 1;
SIG_VALTYPE_ 1875 BMS_StartRSOCmin : 1;
SIG_VALTYPE_ 1875 BMS_SuccChaCap : 1;
SIG_VALTYPE_ 1877 DFA_RC : 1;
SIG_VALTYPE_ 1877 DFA_DCR : 1;
SIG_VALTYPE_ 1877 DFA_UserRC : 1;
SIG_VALTYPE_ 1877 DFA_UserRSOC : 1;
SIG_VALTYPE_ 1877 DFA_ChargingCapacity : 1;
SIG_VALTYPE_ 1877 DFA_RCminCutoff : 1;
SIG_VALTYPE_ 1877 EEPROM_RC : 1;
SIG_VALTYPE_ 1877 EEPROM_DCR : 1;
SIG_VALTYPE_ 1877 EEPROM_RCminCutoff : 1;
SIG_VALTYPE_ 1881 DFC_OCV_DeltaRSOC : 1;
